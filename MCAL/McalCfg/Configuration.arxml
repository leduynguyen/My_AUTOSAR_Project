AUTOSAR XML (schema 4-2-1)
package /stm32f107
  ecuc value collection Collections: ecuc-values=[Can, Dio, Gpt, Mcu, Port]
