AUTOSAR XML (schema 4-2-1)
package /stm32f107
  module config Gpt: implementation-config-variant=VARIANT-PRE-COMPILE
    GptConfigurationOfOptApiServices:
      GptDeinitApi = true
      GptEnableDisableNotificationApi = true
      GptTimeElapsedApi = false
      GptTimeRemainingApi = false
      GptVersionInfoApi = false
      GptWakeupFunctionalityApi = false
    GptDriverConfiguration: GptDevErrorDetect=false, GptReportWakeupSource=false
      GptClockReferencePoint: GptClockReference=McuClockReferencePoint
    GptChannelConfigSet
      GptChannel_1 (GptChannelConfiguration):
        GptChannelId = 1
        GptChannelTickFrequency = 1
        GptChannelTickValueMax = 0
        GptEnableWakeup = false
        GptNotification = gpt_notification1
        GptChannelMode = GPT_CH_MODE_CONTINUOUS
        GptChannelClkSrcRef = GptClockReferencePoint
