AUTOSAR XML (schema 4-0-3)
package /stm32f107
  module config Dio: implementation-config-variant=VARIANT-PRE-COMPILE, module-description=Dio
    DioConfig
      D (DioPort): DioPortId=3
        LED1 (DioChannel): DioChannelId=55
        LED2 (DioChannel): DioChannelId=61
      E (DioPort): DioPortId=4
        D8 (DioChannel): DioChannelId=77
        D7 (DioChannel): DioChannelId=76
    DioGeneral: DioDevErrorDetect=false, DioFlipChannelApi=, DioVersionInfoApi=false
