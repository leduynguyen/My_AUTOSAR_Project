AUTOSAR XML (schema 4-2-2)
package /ArcCore/EcucDefs/mpc560x
  module definition CDD_LinSlv [0..*]: refined-module-def=CDD_LinSlv, variants post-build/pre-compile  # Configuration of the Lin slave complex device driver module.
    container LinSlvGeneral  # This container contains the parameters related to each Lin slave channel.
      boolean LinSlvDevErrorDetect: set at pre-compile, origin=ARCCORE  # Switches the Development Error Detection and Notification ON or OFF.
      boolean LinSlvVersionInfoApi: set at pre-compile, origin=ARCCORE  # Switches the Lin_GetVersionInfo function ON or OFF.
      float LinSlvTimeBase: 0..0.255, set at link in variant link-time / post-build in variant post-build / pre-compile in variant pre-compile  # Defines the interval of calls to main functions in seconds.
      boolean LinSlvTransceiverSupport: set at pre-compile, origin=ARCCORE  # Enable/disables the LinSlv transceiver support and the api:s LinSlv_SetTrcvMode and LinSlv_GetTrcvMode.
    container LinSlvConfig: multiple-configuration-container=true  # This container contains the channel configuration parameter of the Lin slave driver. This container is a MultipleConfigurationContainer, i.e. this container and its sub-containers exit once per configuration set.
      container LinSlvChannel [1..*]  # This container contains the configuration (parameters) of the Lin slave controller(s).
        integer LinSlvChannelBaudRate: 1000..20000, set at post-build in variant post-build / pre-compile in variant pre-compile, origin=ARCCORE  # Specifies the baud rate of the Lin slave channel
        integer LinSlvChannelId: 0..65535, set at pre-compile, origin=ARCCORE, symbolic-name-value=true  # Identifies the Lin slave channel.
        boolean LinSlvChannelWakeupSupport: set at pre-compile, origin=ARCCORE  # Specifies if the Lin slave hardware channel supports wake up functionality
        enumeration LinSlvStartupState: {NORMAL, SLEEP}, set at link in variant link-time+post-build / pre-compile in variant pre-compile, origin=ARCCORE  # Defines the state of each LIN channel after startup
        integer LinSlvResponseErrorBitOffset: 0..63, set at pre-compile, origin=ARCCORE, symbolic-name-value=true  # Bit index offset in the frame where the signal is defined.
        function name LinSlvSleepCallback [0..1]: set at link in variant link-time / post-build in variant post-build / pre-compile in variant pre-compile, origin=ARCCORE  # This parameter is a reference to a call-back function. It is called by the module on bus timeout or the reception of a Go To Sleep command.
        function name LinSlvWakeupConfirmation [0..1]: set at link in variant link-time / post-build in variant post-build / pre-compile in variant pre-compile, origin=ARCCORE  # This parameter is a reference to a call-back function. It is called by the module on bus timeout or the reception of a Go To Sleep command.
        integer LinSlvBusInactivityTimeout: 0..10, set at pre-compile, origin=ARCCORE, symbolic-name-value=true  # If no bus communication that the channel subscribes to is detected within the configured time-out, the driver will call the LinSlvSleepCallback function.
        symbolic name reference LinSlvChannelEcuMWakeupSource [0..1]: set at pre-compile, origin=ARCCORE, destination=EcuMWakeupSource  # This parameter contains a reference to the Wakeup Source for this controller as defined in the ECU State Manager.
        reference LinSlvResponseErrorFrame: set at link in variant link-time / post-build in variant post-build / pre-compile in variant pre-compile, origin=ARCCORE, destination=LinSlvFrame  # Reference to the assigned Frame triggering.
        container LinSlvFrame [0..*]  # Generic container for all types of LIN frames. The shortName of this container is used as LinIfFrameName.
          enumeration LinSlvChecksumType: {CLASSIC, ENHANCED}, set at link in variant link-time / post-build in variant post-build / pre-compile in variant pre-compile, origin=ARCCORE  # Type of checksum that the frame is using.
          enumeration LinSlvFrameType: {MRF, SRF, UNCONDITIONAL}, set at link in variant link-time / post-build in variant post-build / pre-compile in variant pre-compile, origin=ARCCORE  # Type of frame that is described (e.g. sporadic frame). | The sporadic slot is not found among the frame types. A sporadic slot is a set of sporadic frames.
          integer LinSlvLength: 1..8, set at link in variant link-time / post-build in variant post-build / pre-compile in variant pre-compile, origin=ARCCORE  # Length of the LIN SDU in bytes.
          integer LinSlvPid: 0..255, set at link in variant link-time / post-build in variant post-build / pre-compile in variant pre-compile, origin=ARCCORE  # Protected ID of the LIN frame. There is no reason to calculate the Parity in run-time.
          integer LinSlvFrameIdx [0..1]: 0..255, set at link in variant link-time / post-build in variant post-build / pre-compile in variant pre-compile, origin=ARCCORE  # Shall only be set for unconditional frames. Is used to specify the frame index which is defined under the configurable_frames for the node in the Lin Node Description file (ldf).
          choice container LinSlvPduDirection  # Direction of the frame
            container LinSlvInternalPdu [0..1]  # Represents a Diagnostic or Configuration frame : no Message ID (no PduId).
            container LinSlvRxPdu [0..1]  # represents a received PDU/frame
              reference LinSlvRxPduRef: set at link in variant link-time / post-build in variant post-build / pre-compile in variant pre-compile, origin=ARCCORE, destination=Pdu  # Reference to the PDU that is received in this frame.
            container LinSlvTxPdu [0..1]  # represents a transmitted PDU/frame
              reference LinSlvTxPduRef: set at link in variant link-time / post-build in variant post-build / pre-compile in variant pre-compile, origin=ARCCORE, destination=Pdu  # Reference to the PDU that is transmitted in this frame.
          container LinSlvFixedReadByIdentifierResp [0..*]: multiple-configuration-container=true  # In case this is a fixed frame this is the SDU (response). | This container represent an eight byte array. The Byte order shall be MSB first.
            integer LinSlvReadByIdentifierIdentifier: 0..255, set at link in variant link-time+post-build / pre-compile in variant pre-compile, origin=ARCCORE  # Definition of the initial node address
            function name LinSlvResponseCallback: set at link in variant link-time / post-build in variant post-build / pre-compile in variant pre-compile, origin=ARCCORE  # This parameter is a reference to a call-back function. It is called by the module to define the response for the ReadDataByIdentifier request. The response must be an array of 8 bytes.
        container LinSlvAttributes [0..1]  # The Node attributes of the Slaves are provided with these parameter. The ShortName of this container is used as LinIfNodeName.
          integer LinSlvConfiguredNad: 1..255, set at link in variant link-time+post-build / pre-compile in variant pre-compile, origin=ARCCORE  # Definition of the initial node address
          integer LinSlvFunctionId: 0..65535, set at link in variant link-time+post-build / pre-compile in variant pre-compile, origin=ARCCORE  # LIN function ID
          integer LinSlvSupplierId: 0..65535, set at link in variant link-time+post-build / pre-compile in variant pre-compile, origin=ARCCORE  # LIN Supplier ID
          integer LinSlvVariant: 0..255, set at link in variant link-time+post-build / pre-compile in variant pre-compile, origin=ARCCORE  # Specifies the Variant ID
        container LinSlvTrcv [0..1]  # Container gives LIN transceiver driver information about a single LIN transceiver channel. Any LIN transceiver driver has such LIN transceiver channels.
          enumeration LinSlvTrcvInitState: {LINTRCV_TRCV_MODE_NORMAL, LINTRCV_TRCV_MODE_SLEEP, LINTRCV_TRCV_MODE_STANDBY}, set at pre-compile, origin=ARCCORE  # State of LIN transceiver after call to LinTrcv_Init.
          choice container LinTrcvAccess  # Container gives LIN transceiver driver access about a single LIN transceiver channel.
            container LinSlvTrcvDioAccess  # Container gives LIN transceiver driver information about accessing ports and port pins. This configuration is adapted for the TJA1028.
              integer LinSlvTrcvTXDLowWaitCount: 0..4294967295, set at pre-compile, origin=ARCCORE, symbolic-name-value=true  # Bit index offset in the frame where the signal is defined.
              choice reference LinSlvTrcvDioRstnRefName: set at pre-compile, origin=ARCCORE, destination=DioChannel  # Dio reference to the reset input pin
              choice reference LinSlvTrcvDioEnableRefName: set at pre-compile, origin=ARCCORE, destination=DioChannel  # Reference to the enable output pin
              choice reference LinSlvTrcvDioTXDRefName: set at pre-compile, origin=ARCCORE, destination=DioChannel  # Dio reference to the reset input pin
              choice reference LinSlvTrcvPortTXDRefName: set at pre-compile, origin=ARCCORE, destination=[PortPin, PortPin]  # Dio reference to the reset input pin
