AUTOSAR XML (schema 4-2-2)
package /ArcCore/EcucDefs/Generic
  module definition CddPduR [0..1]: variants post-build/pre-compile/link-time  # This container includes all necessary configuration sub-containers according the CAN Interface configuration structure.
    container CddPduRConfig: multiple-configuration-container=true  # This container contains the configuration parameters and sub containers of the CddPduR module. This container is a MultipleConfigurationContainer, i.e. this container and its sub-containers exist once per configuration set.
      integer CddPduRConfigurationId: 0..4294967295, set at link in variant link-time / post-build in variant post-build / pre-compile in variant pre-compile, origin=ARCCORE_ECUC  # This ID is returned by a call to CddPduR_GetConfigurationId.
      container CddPduRIPdu [0..*]: post-build-changeable=true  # Contains the configuration parameters of the CddPduR module's I-PDUs.
        integer CddPduRIPduHandleId [0..1]: 0..65535, set at link in variant link-time / post-build in variant post-build / pre-compile in variant pre-compile, origin=ARCCORE_ECUC, symbolic-name-value=true  # The numerical value used as the ID of this I-PDU. The CddPduRIPduHandleId is required by the API calls to receive I-PDUs from the PduR (CddPduRIP-duDirection: Receive). For Tx-I-PDUs (CddPduRIPduDirection: Send) this handle Id is used by the PduR to confirm the transmission of the CddPduRIPdu. In case no Tx-Confirmation is configured for a Tx-I-PDU, the CddPduRIPduHandleId is not used.
        reference CddPduRPduIdRef: set at link in variant link-time / pre-compile in variant post-build+pre-compile, origin=ARCCORE_ECUC, destination=Pdu  # Reference to the "global" Pdu structure to allow harmonization of handle IDs in the COM-Stack.
package /ArcCore/EcucDefs/Generic/Implementations
  bsw implementation CddPduR: programming-language=C, sw-version=4.0.0, used-code-generator=cdd::PduR::generator::CddPduR::main, vendor-id=60, ar-release-version=4.0.3, vendor-specific-module-def=CddPduR
