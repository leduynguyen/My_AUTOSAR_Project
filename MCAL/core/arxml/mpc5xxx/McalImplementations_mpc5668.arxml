AUTOSAR XML (schema 4-2-2)
package /ArcCore/Implementations/mpc5668
  9 x bsw implementation, all with vendor-id=60, ar-release-version=4.1.2:
    Adc: programming-language=C, sw-version=2.0.0, used-code-generator=generators::mcal::mpc560x::Adc::main, vendor-specific-module-def=Adc
    Can: sw-version=5.0.0, used-code-generator=generators::mcal::mpc560x::Can::main, vendor-specific-module-def=Can
    Gpt: programming-language=C, sw-version=3.0.0, used-code-generator=generators::mcal::mpc560x::Gpt::main, vendor-specific-module-def=Gpt
    Mcu: programming-language=C, sw-version=2.0.0, used-code-generator=generators::mcal::mpc551x::Mcu::main, vendor-specific-module-def=Mcu
    Pwm: programming-language=CPP, sw-version=2.1.0, used-code-generator=generators::mcal::mpc560x::Pwm::main, vendor-specific-module-def=Pwm
    Spi: programming-language=C, sw-version=2.0.0, used-code-generator=generators::mcal::mpc560x::Spi::main, vendor-specific-module-def=Spi
    Lin: programming-language=C, sw-version=2.1.1, used-code-generator=generators::mcal::mpc551x::Lin::main, vendor-specific-module-def=Lin
    Dio: sw-version=5.0.0, used-code-generator=generators::mcal::mpc560x::Dio::main, vendor-specific-module-def=Dio
    Port: programming-language=C, sw-version=5.0.0, used-code-generator=generators::generic::Port::main, vendor-specific-module-def=Port
