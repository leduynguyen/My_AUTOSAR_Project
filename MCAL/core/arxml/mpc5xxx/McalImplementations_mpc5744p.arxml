AUTOSAR XML (schema 4-2-2)
package /ArcCore/Implementations/mpc5744p
  9 x bsw implementation, all with vendor-id=60:
    Adc: programming-language=C, sw-version=2.0.0, used-code-generator=generators::mcal::mpc560x::Adc::main, ar-release-version=4.1.2, vendor-specific-module-def=Adc
    Can: programming-language=C, sw-version=5.0.0, used-code-generator=generators::mcal::mpc560x::Can::main, ar-release-version=4.1.2, vendor-specific-module-def=Can
    Dio: sw-version=5.0.0, used-code-generator=generators::mcal::mpc560x::Dio::main, ar-release-version=4.1.2, vendor-specific-module-def=Dio
    Gpt: programming-language=C, sw-version=3.0.0, used-code-generator=generators::mcal::mpc560x::Gpt::main, ar-release-version=4.1.2, vendor-specific-module-def=Gpt
    Mcu: programming-language=C, sw-version=2.0.0, used-code-generator=generators::mcal::mpc560x::Mcu_mpc5744p::main, ar-release-version=4.1.2, vendor-specific-module-def=Mcu
    Pwm: programming-language=C, sw-version=2.1.0, used-code-generator=generators::mcal::mpc560x::PwmFlex::main, ar-release-version=4.1.2, vendor-specific-module-def=Pwm
    Spi: programming-language=C, sw-version=2.0.0, used-code-generator=generators::mcal::mpc560x::Spi::main, ar-release-version=4.1.2, vendor-specific-module-def=Spi
    Lin: programming-language=C, sw-version=2.1.1, used-code-generator=generators::mcal::mpc560x::Lin::main, ar-release-version=4.1.2, vendor-specific-module-def=Lin
    Fr: programming-language=C, sw-version=1.0.0, used-code-generator=generators::mcal::mpc560x::Fr::main, ar-release-version=4.0.3, vendor-specific-module-def=Fr
