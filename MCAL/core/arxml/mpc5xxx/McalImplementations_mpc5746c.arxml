AUTOSAR XML (schema 4-2-2)
package /ArcCore/Implementations/mpc5746c
  13 x bsw implementation:
    Adc: programming-language=C, sw-version=2.0.0, used-code-generator=generators::mcal::mpc560x::Adc::main, vendor-id=60, ar-release-version=4.1.2, vendor-specific-module-def=Adc
    Can: programming-language=C, sw-version=5.0.0, used-code-generator=generators::mcal::mpc560x::Can::main, vendor-id=60, ar-release-version=4.1.2, vendor-specific-module-def=Can
    Dio: sw-version=5.0.0, used-code-generator=generators::mcal::mpc560x::Dio::main, vendor-id=60, ar-release-version=4.1.2, vendor-specific-module-def=Dio
    Gpt: programming-language=C, sw-version=3.0.0, used-code-generator=generators::mcal::mpc560x::Gpt::main, vendor-id=60, ar-release-version=4.1.2, vendor-specific-module-def=Gpt
    Mcu: programming-language=C, sw-version=2.0.0, used-code-generator=generators::mcal::mpc560x::Mcu_mpc5748g::main, vendor-id=60, ar-release-version=4.1.2, vendor-specific-module-def=Mcu
    Pwm: programming-language=C, sw-version=2.1.0, used-code-generator=generators::mcal::mpc560x::Pwm::main, vendor-id=60, ar-release-version=4.1.2, vendor-specific-module-def=Pwm
    Spi: programming-language=C, sw-version=2.0.0, used-code-generator=generators::mcal::mpc560x::Spi::main, vendor-id=60, ar-release-version=4.1.2, vendor-specific-module-def=Spi
    Lin: programming-language=C, sw-version=2.1.1, used-code-generator=generators::mcal::mpc560x::Lin::main, vendor-id=60, ar-release-version=4.1.2, vendor-specific-module-def=Lin
    Port: programming-language=C, sw-version=5.0.0, used-code-generator=generators::generic::Port::main, vendor-id=60, ar-release-version=4.1.2, vendor-specific-module-def=Port
    Eth: sw-version=1.0.0, used-code-generator=generators::generic::Eth::main, vendor-id=60, ar-release-version=4.2.2, vendor-specific-module-def=Eth
    Wdg: programming-language=C, sw-version=2.0.0, used-code-generator=generators::mcal::mpc560x::Wdg::main, ar-release-version=4.1.2, vendor-specific-module-def=Wdg
    Fr: programming-language=C, sw-version=1.0.0, used-code-generator=generators::mcal::mpc560x::Fr::main, vendor-id=60, ar-release-version=4.0.3, vendor-specific-module-def=Fr
    Icu: programming-language=C, sw-version=2.0.0, used-code-generator=generators::mcal::mpc560x::Icu::main, vendor-id=60, ar-release-version=4.1.2, vendor-specific-module-def=Icu
