AUTOSAR XML (schema 4-1-1)
package /AUTOSAR/EcucDefs
  ecuc definition collection AUTOSARParameterDefinition: module=[Can, Lin, Mcu, Port]
  module definition Mcu [0..1]: variants post-build/pre-compile  # Configuration of the Mcu (Microcontroller Unit) module.
    container McuGeneralConfiguration  # This container contains the configuration (parameters) of the MCU driver.
      boolean McuDevErrorDetect: set at pre-compile  # Pre-processor switch for enabling the development error detection and reporting.
      boolean McuGetRamStateApi: set at pre-compile  # Pre-processor switch to enable/disable the API Mcu_GetRamState. | (e.g. If the H/W does not support the functionality, this parameter can be used to disable the Api).
      boolean McuInitClock: set at pre-compile, default-value=true  # If this parameter is set to FALSE, the clock initialization has to be disabled from the MCU driver. This concept applies when there are some write once clock registers and a bootloader is present. If this parameter is set to TRUE, the MCU driver is responsible of the clock initialization.
      boolean McuNoPll: set at pre-compile, default-value=true  # This parameter shall be set True, if the H/W does not have a PLL or the PLL circuitry is enabled after the power on without S/W intervention. In this case MCU_DistributePllClock has to be disabled and MCU_GetPllStatus has to return MCU_PLL_STATUS_UNDEFINED. Otherwise this parameters has to be set False
      boolean McuPerformResetApi: set at pre-compile  # Pre-processor switch to enable / disable the use of the function Mcu_PerformReset()
      boolean McuVersionInfoApi: set at pre-compile  # Pre-processor switch to enable / disable the API to read out the modules version information.
    container McuModuleConfiguration: multiple-configuration-container=true  # This container contains the configuration (parameters) of the MCU driver
      enumeration McuClockSrcFailureNotification: {DISABLED, ENABLED}, set at post-build in variant post-build / pre-compile in variant pre-compile  # Enables/Disables clock failure notification. In case this feature is not supported by HW the setting should be disabled.
      integer McuNumberOfMcuModes: 1..255, set at post-build in variant post-build / pre-compile in variant pre-compile  # This parameter shall represent the number of Modes available for the MCU. | calculationFormula = Number of configured McuModeSettingConf
      integer McuRamSectors: 0..4294967295, set at post-build in variant post-build / pre-compile in variant pre-compile  # This parameter shall represent the number of RAM sectors available for the MCU. | calculationFormula = Number of configured McuRamSectorSettingConf
      integer McuResetSetting [0..1]: 1..255, set at pre-compile  # This parameter relates to the MCU specific reset configuration. This applies to the function Mcu_PerformReset, which performs a microcontroller reset using the hardware feature of the microcontroller.
      container McuClockSettingConfig [1..*]  # This container contains the configuration (parameters) for the Clock settings of the MCU. Please see MCU031 for more information on the MCU clock settings.
        integer McuClockSettingId: 0..255, set at post-build in variant post-build / pre-compile in variant pre-compile, symbolic-name-value=true  # The Id of this McuClockSettingConfig to be used as argument for the API call "Mcu_InitClock".
        container McuClockReferencePoint [1..*]  # This container defines a reference point in the Mcu Clock tree. It defines the frequency which then can be used by other modules as an input value. Lower multiplicity is 1, as even in the simplest case (only one frequency is used), there is one frequency to be defined.
          float McuClockReferencePointFrequency: 0..Inf, scope=ECU, set at post-build in variant post-build / pre-compile in variant pre-compile  # This is the frequency for the specific instance of the McuClockReferencePoint container. It shall be given in Hz.
      container McuDemEventParameterRefs [0..1]  # Container for the references to DemEventParameter elements which shall be invoked using the API Dem_ReportErrorStatus API in case the corresponding error occurs. The EventId is taken from the referenced DemEventParameter's DemEventId symbolic name. The standardized errors are provided in the container and can be extended by vendor specific error references.
        symbolic name reference MCU_E_CLOCK_FAILURE [0..1]: set at pre-compile, destination=DemEventParameter  # Reference to configured DEM event to report "Clock source failure".
      container McuModeSettingConf [1..*]  # This container contains the configuration (parameters) for the Mode setting of the MCU. Please see MCU035 for more information on the MCU mode settings.
        integer McuMode: 0..255, set at post-build in variant post-build / pre-compile in variant pre-compile, symbolic-name-value=true  # The parameter represents the MCU Mode settings.
      container McuRamSectorSettingConf [0..*]  # This container contains the configuration (parameters) for the RAM Sector setting. Please see MCU030 for more information on RAM sec-tor settings.
        integer McuRamDefaultValue: 0..255, set at post-build in variant post-build / pre-compile in variant pre-compile  # This parameter shall represent the Data pre-setting to be initialized
        integer McuRamSectionBaseAddress: 0..4294967295, set at post-build in variant post-build / pre-compile in variant pre-compile  # This parameter shall represent the MCU RAM section base address
        integer McuRamSectionSize: 0..4294967295, set at post-build in variant post-build / pre-compile in variant pre-compile  # This parameter represents the MCU RAM Section size in bytes.
    container McuPublishedInformation  # Container holding all MCU specific published information parameters
      container McuResetReasonConf [1..*]  # This container contains the configuration for the different type of reset reason that can be retrieved from Mcu_GetResetReason Api.
        integer McuResetReason: 0..255, scope=ECU, set at published-information, symbolic-name-value=true  # The parameter represents the different type of reset that a Micro supports. This parameter is referenced by the parameter EcuMResetReason in the ECU State manager module.
  module definition Can [0..*]: variants post-build/pre-compile  # This container holds the configuration of a single CAN Driver.
    container CanConfigSet: multiple-configuration-container=true  # This is the multiple configuration set container for CAN Driver
      container CanController [1..*]  # This container contains the configuration parameters of the CAN controller(s).
        enumeration CanBusoffProcessing: {INTERRUPT, POLLING}, set at pre-compile  # Enables / disables API Can_MainFunction_BusOff() for handling busoff events in polling mode.
        boolean CanControllerActivation: set at pre-compile  # Defines if a CAN controller is used in the configuration.
        integer CanControllerBaseAddress: 0..4294967295, set at pre-compile  # Specifies the CAN controller base address.
        integer CanControllerId: 0..255, scope=ECU, set at pre-compile, symbolic-name-value=true  # This parameter provides the controller ID which is unique in a given CAN Driver. The value for this parameter starts with 0 and continue without any gaps.
        enumeration CanRxProcessing: {INTERRUPT, POLLING}, set at pre-compile  # Enables / disables API Can_MainFunction_Read() for handling PDU reception events in polling mode.
        enumeration CanTxProcessing: {INTERRUPT, POLLING}, set at pre-compile  # Enables / disables API Can_MainFunction_Write() for handling PDU transmission events in polling mode.
        boolean CanWakeupFunctionalityAPI: set at pre-compile, default-value=false  # Adds / removes the service Can_CheckWakeup() from the code. | True: Can_CheckWakeup can be used. False: Can_CheckWakeup cannot be used.
        enumeration CanWakeupProcessing: {INTERRUPT, POLLING}, set at pre-compile  # Enables / disables API Can_MainFunction_Wakeup() for handling wakeup events in polling mode.
        boolean CanWakeupSupport: set at pre-compile  # CAN driver support for wakeup over CAN Bus.
        reference CanControllerDefaultBaudrate: set at post-build in variant post-build / pre-compile in variant pre-compile, destination=CanControllerBaudrateConfig  # Reference to baudrate configuration container configured for the Can Controller.
        reference CanCpuClockRef: set at pre-compile, destination=McuClockReferencePoint  # Reference to the CPU clock configuration, which is set in the MCU driver configuration
        symbolic name reference CanWakeupSourceRef [0..1]: set at pre-compile, destination=EcuMWakeupSource  # This parameter contains a reference to the Wakeup Source for this controller as defined in the ECU State Manager. | Implementation Type: reference to EcuM_WakeupSourceType
        container CanControllerBaudrateConfig [1..*]  # This container contains bit timing related configuration parameters of the CAN controller(s).
          integer CanControllerBaudRate: 0..2000, set at post-build in variant post-build / pre-compile in variant pre-compile  # Specifies the baudrate of the controller in kbps.
          integer CanControllerBaudRateConfigID: 0..65535, scope=ECU, set at post-build in variant post-build / pre-compile in variant pre-compile, default-value=0  # Uniquely identifies a specific baud rate configuration. This ID is used by SetBaudrate API.
          integer CanControllerPropSeg: 0..255, set at post-build in variant post-build / pre-compile in variant pre-compile  # Specifies propagation delay in time quantas.
          integer CanControllerSeg1: 0..255, set at post-build in variant post-build / pre-compile in variant pre-compile  # Specifies phase segment 1 in time quantas.
          integer CanControllerSeg2: 0..255, set at post-build in variant post-build / pre-compile in variant pre-compile  # Specifies phase segment 2 in time quantas.
          integer CanControllerSyncJumpWidth: 0..255, set at post-build in variant post-build / pre-compile in variant pre-compile  # Specifies the synchronization jump width for the controller in time quantas.
          container CanControllerFdBaudrateConfig [0..1]  # This optional container contains bit timing related configuration parameters of the CAN controller(s) for payload and CRC of a CAN FD frame. If this container exists the controller supports CAN FD frames.
            integer CanControllerFdBaudRate: 0..16000, set at post-build in variant post-build / pre-compile in variant pre-compile  # Specifies the data segment baud rate of the controller in kbps.
            integer CanControllerPropSeg: 0..255, set at post-build in variant post-build / pre-compile in variant pre-compile  # Specifies propagation delay in time quantas.
            integer CanControllerSeg1: 0..255, set at post-build in variant post-build / pre-compile in variant pre-compile  # Specifies phase segment 1 in time quantas.
            integer CanControllerSeg2: 0..255, set at post-build in variant post-build / pre-compile in variant pre-compile  # Specifies phase segment 2 in time quantas.
            integer CanControllerSyncJumpWidth: 0..255, set at post-build in variant post-build / pre-compile in variant pre-compile  # Specifies the synchronization jump width for the controller in time quantas.
            integer CanControllerTrcvDelayCompensationOffset [0..1]: 0..400, set at post-build in variant post-build / pre-compile in variant pre-compile  # Specifies the Transceiver Delay Compensation Offset in ns. If not specified Transceiver Delay Compensation is disabled.
            boolean CanControllerTxBitRateSwitch: set at post-build in variant post-build / pre-compile in variant pre-compile, default-value=true  # Specifies if the bit rate switching shall be used for transmissions. | If FALSE: CAN FD frames shall be sent without bit rate switching.
        container CanFilterMask [0..*]  # This container contains the configuration (parameters) of the CAN Filter Mask(s). | This container is set to obsolete. It is replaced by CanHwFilterMask
          integer CanFilterMaskValue: 0..4294967295, scope=ECU, set at post-build in variant post-build / pre-compile in variant pre-compile  # Describes a mask for hardware-based filtering of CAN identifiers. The CAN identifiers of incoming messages are masked with the appropriate CanFilterMaskValue. Bits holding a 0 mean don't care, i.e. do not compare the message's identifier in the respective bit position. | The mask shall be build by filling with leading 0. In case of CanIdType EXTENDED or MIXED a 29 bit mask shall be build. In case of CanIdType STANDARD a 11 bit mask shall be build
        container CanTTController [0..1]  # This container is only included and valid if TTCAN SWS is used and TTCAN is enabled. | This container contains the configuration parameters of the TTCAN controller(s) (which are needed in addition to the configuration parameters of the CAN controller(s)). CanTTController is only included, if the controller supports TTCAN.
          integer CanTTControllerApplWatchdogLimit: 0..255, scope=ECU, set at post-build in variant post-build / pre-compile in variant pre-compile  # Defines the maximum time period (unit is 256 times NTU) after which the application has to serve the watchdog.
          integer CanTTControllerCycleCountMax: 0..63, scope=ECU, set at post-build in variant post-build / pre-compile in variant pre-compile  # Defines the value for cycle_count_max. | Allowed values: 0x00: 1 basic cycle 0x01: 2 basic cycles 0x03: 4 basic cycles 0x07: 8 basic cycles 0x0F: 16 basic cycles 0x1F: 32 basic cycles 0x3F: 64 basic cycles
          integer CanTTControllerExpectedTxTrigger: 0..255, set at post-build in variant post-build / pre-compile in variant pre-compile  # Number of expected_tx_trigger.
          boolean CanTTControllerExternalClockSynchronisation: scope=ECU, set at post-build in variant post-build / pre-compile in variant pre-compile  # Enables/disables the external clock synchronization. | TRUE: External clock synchronization enabled. FALSE: External clock synchronization disabled. This parameter shall only be configurable if parameter CanTTControllerLevel2 equals TRUE.
          boolean CanTTControllerGlobalTimeFiltering: set at post-build in variant post-build / pre-compile in variant pre-compile  # Enables/disables the global time filtering. | TRUE: Global time filtering enabled. FALSE: Global time filtering disabled. This parameter shall only be configurable if parameter CanTTControllerLevel2 equals TRUE.
          integer CanTTControllerInitialRefOffset: 0..127, scope=ECU, set at post-build in variant post-build / pre-compile in variant pre-compile  # Defines the initial value for ref trigger offset.
          integer CanTTControllerInterruptEnable: 0..1023, set at post-build in variant post-build / pre-compile in variant pre-compile  # Enables/disables the respective interrupts. | Bit Position set to 1: Enable respective interrupt. Bit Position set to 0: Disable respective interrupt. Bit Position / Interrupt Source: 10: Application Watchdog. 9: Watch Trigger reached. 8: Initialization Watch Trigger reached. 7: Change of Error Level. 6: Tx Overflow. 5: Tx Underflow. 4: Global Time Error. 3: Gap. 2: Start of Cycle. 1: Time Discontinuity. 0: Master State Change. Bit position "1: Time Discontinuity" and "4: Global Time Error" shall only be configurable if parameter CanTTControllerLevel2 equals TRUE.
          boolean CanTTControllerLevel2: set at post-build in variant post-build / pre-compile in variant pre-compile  # Defines whether Level 2 or Level 1 is used. | TRUE: Level 2. FALSE: Level 1. If this parameter is set to FALSE then all parameters with dependency to CanTTControllerLevel2 need not be configured.
          float CanTTControllerNTUConfig: 0..100, scope=ECU, set at post-build in variant post-build / pre-compile in variant pre-compile  # Defines the config value for NTU (network time unit). | Value given in microseconds. The value configured shall be greater than 0. Together with the local oscillator period, the TUR (time unit ratio) can be derived from the NTU. This parameter shall only be configurable if parameter CanTTControllerLevel2 equals TRUE.
          enumeration CanTTControllerOperationMode: {CAN_TT_EVENT_SYNC_TIME_TRIGGERED, CAN_TT_EVENT_TRIGGERED, CAN_TT_TIME_TRIGGERED}, scope=ECU, set at post-build in variant post-build / pre-compile in variant pre-compile  # Defines the operation mode.
          float CanTTControllerSyncDeviation: 0..100, set at post-build in variant post-build / pre-compile in variant pre-compile  # Defines the maximum synchronization deviation: | Given as a percentage value of the NTU (network time unit). The value configured shall be greater than 0. This parameter shall only be configurable if parameter CanTTControllerLevel2 equals TRUE.
          boolean CanTTControllerTURRestore: set at post-build in variant post-build / pre-compile in variant pre-compile  # Enables/disables the TUR restore. | Note that the value configured for TUR can be derived from the value configured for NTU and the local oscillator preriod. TRUE: TUR restore enabled. FALSE: TUR restore disabled. This parameter shall only be configurable if parameter CanTTControllerLevel2 equals TRUE.
          boolean CanTTControllerTimeMaster: scope=ECU, set at post-build in variant post-build / pre-compile in variant pre-compile  # Defines whether the controller acts as a potential time master. | TRUE: Potential time master. FALSE: Time slave.
          integer CanTTControllerTimeMasterPriority: 0..7, scope=ECU, set at post-build in variant post-build / pre-compile in variant pre-compile  # Defines the time master priority.
          integer CanTTControllerTxEnableWindowLength: 1..16, scope=ECU, set at post-build in variant post-build / pre-compile in variant pre-compile  # Length of the tx enable window given in CAN bit times. | Definition parameter "CanTTControllerTxEnableWindowlength" is used such that: Length of enable window = CanTTControllerTxEnableWindowLength + 1
          integer CanTTControllerWatchTriggerGapTimeMark: 0..65535, set at post-build in variant post-build / pre-compile in variant pre-compile  # watch trigger time mark after a gap
          integer CanTTControllerWatchTriggerTimeMark: 0..65535, set at post-build in variant post-build / pre-compile in variant pre-compile  # watch trigger time mark
          enumeration CanTTIRQProcessing: {INTERRUPT, POLLING}, scope=ECU, set at post-build in variant post-build / pre-compile in variant pre-compile  # Enables / disables API Can_MainFunction_BusOff() for handling busoff events in polling mode.
      container CanHardwareObject [1..*]  # This container contains the configuration (parameters) of CAN Hardware Objects.
        enumeration CanHandleType: {BASIC, FULL}, scope=ECU, set at post-build in variant post-build / pre-compile in variant pre-compile  # Specifies the type (Full-CAN or Basic-CAN) of a hardware object.
        integer CanHwObjectCount [0..1]: 0..65535, scope=ECU, set at post-build in variant post-build / pre-compile in variant pre-compile, default-value=1  # Number of hardware objects used to implement one HOH. In case of a HRH this parameter defines the number of elements in the hardware FIFO or the number of shadow buffers, in case of a HTH it defines the number of hardware objects used for multiplexed transmission or for a hardware FIFO used by a FullCAN HTH.
        enumeration CanIdType: {EXTENDED, MIXED, STANDARD}, scope=ECU, set at post-build in variant post-build / pre-compile in variant pre-compile  # Specifies whether the IdValue is of type | - standard identifier - extended identifier - mixed mode ImplementationType: Can_IdType
        integer CanIdValue [0..1]: 0..4294967295, scope=ECU, set at post-build in variant post-build / pre-compile in variant pre-compile  # Specifies (together with the filter mask) the identifiers range that passes the hardware filter. Tags: atp.Status=obsolete, atp.StatusComment=This parameter is replaced by CanHwFilterCode, atp.StatusRevisionBegin=4.1.1 | This parameter is set to obsolete and will be replaced by CanHwFilterCode This element is obsolete and will be removed in a future revision.
        integer CanObjectId: 0..65535, scope=ECU, set at post-build in variant post-build / pre-compile in variant pre-compile, symbolic-name-value=true  # Holds the handle ID of HRH or HTH. The value of this parameter is unique in a given CAN Driver, and it should start with 0 and continue without any gaps. | The HRH and HTH Ids share a common ID range. Example: HRH0-0, HRH1-1, HTH0-2, HTH1-3
        enumeration CanObjectType: {RECEIVE, TRANSMIT}, scope=ECU, set at post-build in variant post-build / pre-compile in variant pre-compile  # Specifies if the HardwareObject is used as Transmit or as Receive object
        reference CanControllerRef: set at post-build in variant post-build / pre-compile in variant pre-compile, destination=CanController  # Reference to CAN Controller to which the HOH is associated to.
        reference CanFilterMaskRef [0..1]: set at post-build in variant post-build / pre-compile in variant pre-compile, destination=CanFilterMask  # Reference to the filter mask that is used for hardware filtering together with the CAN_ID_VALUE. | Different CanHardwareObjects with different CanIdTypes (STANDARD, MIXED, EXTENDED) can share the same CanFilterMask (i.e., the CanFilterMaskRef parameters of these CanHardwareObjects reference the very same CanFilterMask container). This shall be allowed and must be supported by the configuration generators. The CanFilterMaskRef is omitted for 1) CanHardwareObjects with CanObjectType set to TRANSMIT 2) CanHardwareObjects with CanObjectType set to RECEIVE if only a single Can ID shall be received via this CanHardwareObjects (i.e., exact match with CanIdValue) This parameter is set to obsolete and is replaced by CanHwFilterMask This element is obsolete and will be removed in a future revision.
        reference CanMainFunctionRWPeriodRef [0..1]: set at post-build in variant post-build / pre-compile in variant pre-compile, destination=CanMainFunctionRWPeriods  # Reference to CanMainFunctionReadPeriod and CanMainFunctionWritePeriod
        container CanHwFilter [0..*]  # This container is only valid for HRHs and contains the configuration (parameters) of one hardware filter.
          integer CanHwFilterCode: 0..4294967295, set at post-build in variant post-build / pre-compile in variant pre-compile  # Specifies (together with the filter mask) the identifiers range that passes the hardware filter.
          integer CanHwFilterMask: 0..4294967295, set at post-build in variant post-build / pre-compile in variant pre-compile  # Describes a mask for hardware-based filtering of CAN identifiers. The CAN identifiers of incoming messages are masked with the appropriate CanFilterMaskValue. Bits holding a 0 mean don't care, i.e. do not compare the message's identifier in the respective bit position. | The mask shall be build by filling with leading 0. In case of CanIdType EXTENDED or MIXED a 29 bit mask shall be build. In case of CanIdType STANDARD a 11 bit mask shall be build
        container CanTTHardwareObjectTrigger [0..*]  # This container is only included and valid if TTCAN SWS is used and TTCAN is enabled. | This container contains the configuration (parameters) of TTCAN triggers for Hardware Objects, which are additional to the configuration (parameters) of CAN Hardware Objects. CanTTHardwareObjectTrigger is only included, if the controller supports TTCAN.
          integer CanTTHardwareObjectBaseCycle: 0..63, scope=ECU, set at post-build in variant post-build / pre-compile in variant pre-compile  # Defines the cycle_offset. | CanTTHardwareObjectBaseCycle must be not greater than cycle_count_max.
          integer CanTTHardwareObjectCycleRepetition: 1..64, scope=ECU, set at post-build in variant post-build / pre-compile in variant pre-compile  # Defines the repeat_factor. | CanTTHardwareObjectCycleRepetition shall be a power of two (2), greater than cycle_offset but not greater than cycle_count_max + 1.
          integer CanTTHardwareObjectTimeMark: 0..65535, set at post-build in variant post-build / pre-compile in variant pre-compile  # Defines the point in time, when the trigger will be activated. | Value is given in cycle time.
          integer CanTTHardwareObjectTriggerId: 0..63, set at post-build in variant post-build / pre-compile in variant pre-compile, symbolic-name-value=true  # Sequential number which allows separation of different TTCAN triggers configured for one and the same hardware object.
          enumeration CanTTHardwareObjectTriggerType: {CAN_TT_RX_TRIGGER, CAN_TT_TX_REF_TRIGGER, CAN_TT_TX_REF_TRIGGER_GAP, CAN_TT_TX_TRIGGER_EXCLUSIVE, CAN_TT_TX_TRIGGER_MERGED, CAN_TT_TX_TRIGGER_SINGLE}, set at post-build in variant post-build / pre-compile in variant pre-compile  # Defines the type of the trigger associated with the hardware object. This parameter depends on plain CAN parameter CAN_OBJECT_TYPE. | If CAN_OBJECT_TYPE equals RECEIVE than this parameter is fixed to CAN_TT_RX_TRIGGER. If CAN_OBJECT_TYPE equals TRANSMIT than one of the following literals is configurable: CAN_TT_TX_REF_TRIGGER, CAN_TT_TX_REF_TRIGGER_GAP, CAN_TT_TX_TRIGGER_MERGED, CAN_TT_TX_TRIGGER_SINGLE, CAN_TT_TX_TRIGGER_EXCLUSIVE.
      container CanIcom [0..1]  # This container contains the parameters for configuring pretended networking
        container CanIcomConfig [1..*]  # This container contains the configuration parameters of the ICOM Configuration.
          integer CanIcomConfigId: 1..255, scope=ECU, set at pre-compile  # This parameter identifies the ID of the ICOM configuration.
          boolean CanIcomWakeOnBusOff: scope=ECU, set at pre-compile, default-value=true  # This parameter defines that the MCU shall wake if the bus off is detected or not.
          container CanIcomWakeupCauses  # This container contains the configuration parameters of the wakeup causes to leave the power saving mode.
            container CanIcomRxMessage [1..*]  # This container contains the configuration parameters for the wakeup causes for matching received messages. It has to be configured as often as received messages are defined as wakeup cause. | constraint: For all CanIcomRxMessage instances the Message IDs which are defined in CanIcomMessageId and in CanIcomRxMessageRange shall never overlap. Also the ranges of CanIcomRxMessageRange shall not overlap each other.
              integer CanIcomCounterValue [0..1]: 1..65536, scope=ECU, set at pre-compile  # This parameter defines that the MCU shall wake if the message with the ID is received n times on the communication channel.
              integer CanIcomMessageId [0..1]: 0..536870912, scope=ECU, set at pre-compile  # This parameter defines the message ID the wakeup causes of this CanIcomRxMessage are configured for. In addition a mask can be defined,CanIcomMessageIdMask) in that case it is possible to define a range of rx messages,which can create and wakeup.
              integer CanIcomMessageIdMask [0..1]: 0..536870912, scope=ECU, set at pre-compile  # Describes a mask for filtering of CAN identifiers. The CAN identifiers of incoming messages are masked with the appropriate CanIcomMessagIdMask. Bits holding a 0 mean don't care, i.e. do not compare the message's identifier in the respective bit position. The mask shall be build by filling with leading 0.
              float CanIcomMissingMessageTimerValue [0..1]: scope=ECU, set at pre-compile  # This parameter defines that the MCU shall wake if the message with the ID is not received for a specific time in ms on the communication channel.
              boolean CanIcomPayloadLengthError: scope=ECU, set at pre-compile, default-value=false  # This parameter defines that the MCU shall wake if a payload error occurs
              container CanIcomRxMessageSignalConfig [0..*]  # This container contains the configuration parameters for the wakeup causes for matching signals. | It has to be configured as often as a signal is defined as wakeup cause. If at least one the Signal conditions evaluate to true, the whole wakeup condition is considered to be true. All instances of this container refer to the same frame/pdu
                enumeration CanIcomSignalOperation: {AND, EQUAL, GREATER, OR, SMALLER, XOR}, scope=ECU, set at pre-compile  # This parameter defines the operation, which shall be used to verify the payload data. | AND: The masked payload via CanIcomSignalMask AND CanIcomSignalValue must be TRUE (logical AND) OR: The masked payload via CanIcomSignalMask OR CanIcomSignalValue must be TRUE (logical OR) XOR: The masked payload via CanIcomSignalMask XOR CanIcomSignalValue must be TRUE (logical XOR) SMALLER: The masked payload via CanIcomSignalMask must be strictly smaller than CanIcomSignalValue EQUAL: The masked payload via CanIcomSignalMask must beequal to CanIcomSignalValue GREATER: The masked payload via CanIcomSignalMask must be strictly greater than CanIcomSignalValue GREATER and SMALLER can only be applied to unsigned integer values. It is known that AND and EQUAL can be considered the same, but for clarification reason both are kept to show that AND is taken for the arithmetical and EQUAL is taken for the logical operation.
                reference CanIcomSignalRef [0..1]: scope=ECU, set at pre-compile, destination=ComSignal  # This parameter defines a reference to the signal which shall be checked additional to the message id. | This reference is used for documentation to define which ComSignal originates this filter setting. All signals being refered by this reference shall point to the same PDU.
                container CanIcomSignalMask [1..8]  # This container defines the configuration for the signal mask to extract the signal out of the payload of the received message. | The mask shall be logical ANDed with the received payload. The result shall be used with the CanIcomSignalOperation with the specified parameters in CanIcomSignalValue
                  integer CanIcomSignalMaskIndex: 0..7, scope=ECU, set at pre-compile  # This parameter defines the byte number of the payload data to identifiy the signal. The signal can be at least one bit and in maximum 8 bits. If the signal is greater than 8 bits more than one CanIcomSignalMaskIndex must be defined. | The CanIcomSignalMaskIndex works in combination with the CanIcomSignalMaskValue.
                  integer CanIcomSignalMaskValue: 0..255, set at pre-compile  # This parameter shall be used to mask a signal in the payload of a CAN message. | The mask is logical AND with the payload. The result will be used in combination of the operations defined in CanIcomSignalOperation with the CanIcomSignalValue.
                container CanIcomSignalValue [1..8]  # This container defines the configuration for the signal value which shall be used to compare with the signal in the received message.
                  integer CanIcomSignalValueIndex: 0..7, scope=ECU, set at pre-compile  # This parameter defines the byte number of the value, which shall be used to compare with the received signal in combination with the CanIcomSignalOperation.The signal can be at least one bit and in maximum 8 bits. If the signal is greater than 8 bits more than one CanIcomSignalValueIndex must be defined. | The CanIcomSignalValueIndex works in combination with the CanIcomSignalValueValue.
                  integer CanIcomSignalValueValue: 0..255, set at pre-compile  # This parameter shall be used to define a signal which shall be used in combination with the received signal in the payload of a CAN message. | The parameter will be used in combination of the operations defined in CanIcomSignalOperation with the result of the payload and the CanIcomSignalMask.
    container CanGeneral  # This container contains the parameters related each CAN Driver Unit.
      boolean CanChangeBaudrateApi [0..1]: scope=ECU, set at pre-compile, default-value=false  # The support of the Can_ChangeBaudrate API is optional. Tags: atp.Status=obsolete, atp.StatusRevisionBegin=4.1.1 | If this parameter is set to true the Can_ChangeBaudrate API shall be supported. Otherwise the API is not supported. Please note that the Can_ChangeBaudrate API and this parameter are deprecated and will be removed in future. This element is obsolete and will be removed in a future revision.
      boolean CanDevErrorDetection: set at pre-compile  # Switches the Development Error Detection and Notification ON or OFF.
      boolean CanHardwareCancellation: scope=ECU, set at pre-compile  # Specifies if hardware cancellation shall be supported.ON or OFF
      boolean CanIdenticalIdCancellation: set at pre-compile  # Enables/disables cancellation of pending PDUs with identical ID.
      integer CanIndex: 0..255, set at pre-compile  # Specifies the InstanceId of this module instance. If only one instance is present it shall have the Id 0.
      function name CanLPduReceiveCalloutFunction [0..1]: set at pre-compile  # This parameter defines the existence and the name of a callout function that is called after a successful | reception of a received CAN Rx L-PDU. If this parameter is omitted no callout shall take place.
      float CanMainFunctionBusoffPeriod [0..1]: 0.001..65.535, set at pre-compile  # This parameter describes the period for cyclic call to Can_MainFunction_Busoff. Unit is seconds.
      float CanMainFunctionModePeriod: 0.001..65.535, set at pre-compile  # This parameter describes the period for cyclic call to Can_MainFunction_Mode. Unit is seconds.
      float CanMainFunctionWakeupPeriod [0..1]: 0.001..65.535, set at pre-compile  # This parameter describes the period for cyclic call to Can_MainFunction_Wakeup. Unit is seconds.
      boolean CanMultiplexedTransmission: scope=ECU, set at pre-compile  # Specifies if multiplexed transmission shall be supported.ON or OFF
      boolean CanSetBaudrateApi [0..1]: scope=ECU, set at pre-compile, default-value=false  # The support of the Can_SetBaudrate API is optional. | If this parameter is set to true the Can_SetBaudrate API shall be supported. Otherwise the API is not supported.
      float CanTimeoutDuration: 0.001..65.535, set at pre-compile  # Specifies the maximum time for blocking function until a timeout is detected. Unit is seconds.
      boolean CanVersionInfoApi: set at pre-compile  # Switches the Can_GetVersionInfo() API ON or OFF.
      reference CanCounterRef: set at pre-compile, destination=OsCounter  # This parameter contains a reference to the counter, which is used by the CAN driver.
      reference CanSupportTTCANRef: scope=ECU, set at pre-compile, destination=CanIfPrivateCfg  # The parameter refers to CanIfSupportTTCAN parameter in the CAN Interface Module configuration. | The CanIfSupportTTCAN parameter defines whether TTCAN is supported.
      container CanIcomGeneral [0..1]  # This container contains the general configuration parameters of the ICOM Configuration.
        enumeration CanIcomLevel: {CAN_ICOM_LEVEL_ONE, CAN_ICOM_LEVEL_TWO}, scope=ECU, set at pre-compile, default-value=CAN_ICOM_LEVEL_ONE  # Defines the level of Pretended Networking.
        enumeration CanIcomVariant: {CAN_ICOM_VARIANT_HW, CAN_ICOM_VARIANT_NONE, CAN_ICOM_VARIANT_SW}, scope=ECU, set at pre-compile, default-value=CAN_ICOM_VARIANT_NONE  # Defines the variant, which is supported by this CanController
      container CanMainFunctionRWPeriods
        float CanMainFunctionReadPeriod [0..*]: 0.001..65.535, set at pre-compile  # This parameter describes the period for cyclic call to Can_MainFunction_Read. Unit is seconds. Different poll-cycles will be configurable if more than one CanMainFunctionReadPeriod is configured. In this case multiple Can_MainFunction_Read() will be provided by the CAN Driver module.
        float CanMainFunctionWritePeriod [0..*]: 0.001..65.535, set at pre-compile  # This parameter describes the period for cyclic call to Can_MainFunction_Write. Unit is seconds. Different poll-cycles will be configurable if more than one CanMainFunctionWritePeriod is configured. In this case multiple Can_MainFunction_Write() will be provided by the CAN Driver module.
  module definition Port [0..1]: variants post-build/pre-compile  # Configuration of the Port module.
    container PortConfigSet: multiple-configuration-container=true  # This container is the base of a multiple configuration set
      container PortContainer [1..*]  # Container collecting the PortPins.
        integer PortNumberOfPortPins: 1..65535, set at pre-compile  # The number of specified PortPins in this PortContainer.
        container PortPin [1..*]  # Configuration of the individual port pins.
          enumeration PortPinDirection: {PORT_PIN_IN, PORT_PIN_OUT}, set at post-build in variant post-build / pre-compile in variant pre-compile  # The initial direction of the pin (IN or OUT). If the direction is not changeable, the value configured here is fixed. | The direction must match the pin mode. E.g. a pin used for an ADC must be configured to be an in port. Implementation Type: Port_PinDirectionType
          boolean PortPinDirectionChangeable: set at post-build in variant post-build / pre-compile in variant pre-compile  # Parameter to indicate if the direction is changeable on a port pin during runtime. | true: Port Pin direction changeable enabled. false: Port Pin direction changeable disabled.
          integer PortPinId: 1..65535, set at pre-compile, symbolic-name-value=true  # Pin Id of the port pin. This value will be assigned to the symbolic name derived from the port pin container short name.
          enumeration PortPinInitialMode: {PORT_PIN_MODE_ADC, PORT_PIN_MODE_CAN, PORT_PIN_MODE_DIO, PORT_PIN_MODE_DIO_GPT, PORT_PIN_MODE_DIO_WDG, PORT_PIN_MODE_FLEXRAY, PORT_PIN_MODE_ICU, PORT_PIN_MODE_LIN, PORT_PIN_MODE_MEM, PORT_PIN_MODE_PWM, PORT_PIN_MODE_SPI}, set at post-build in variant post-build / pre-compile in variant pre-compile  # Port pin mode from mode list for use with Port_Init() function.
          enumeration PortPinLevelValue: {PORT_PIN_LEVEL_HIGH, PORT_PIN_LEVEL_LOW}, set at post-build in variant post-build / pre-compile in variant pre-compile  # Port Pin Level value from Port pin list.
          enumeration PortPinMode [1..*]: {PORT_PIN_MODE_ADC, PORT_PIN_MODE_CAN, PORT_PIN_MODE_DIO, PORT_PIN_MODE_DIO_GPT, PORT_PIN_MODE_DIO_WDG, PORT_PIN_MODE_FLEXRAY, PORT_PIN_MODE_ICU, PORT_PIN_MODE_LIN, PORT_PIN_MODE_MEM, PORT_PIN_MODE_PWM, PORT_PIN_MODE_SPI}, set at post-build in variant post-build / pre-compile in variant pre-compile  # Port pin mode from mode list. | Note that more than one mode is allowed by default. That way it is e.g. possible to combine DIO with another mode such as ICU.
          boolean PortPinModeChangeable: set at post-build in variant post-build / pre-compile in variant pre-compile  # Parameter to indicate if the mode is changeable on a port pin during runtime. True: Port Pin mode changeable allowed. False: Port Pin mode changeable not permitted.
    container PortGeneral  # Module wide configuration parameters of the PORT driver.
      boolean PortDevErrorDetect: set at pre-compile  # Switches the Development Error Detection and Notification on or off. | true: Enabled. false: Disabled.
      boolean PortSetPinDirectionApi: set at pre-compile  # Pre-processor switch to enable / disable the use of the function Port_SetPinDirection(). | TRUE: Enabled - Function Port_SetPinDirection() is available. FALSE: Disabled - Function Port_SetPinDirection() is not available.
      boolean PortSetPinModeApi: set at pre-compile  # Pre-processor switch to enable / disable the use of the function Port_SetPinMode(). | true: Enabled - Function Port_SetPinMode() is available. false: Disabled - Function Port_SetPinMode() is not available.
      boolean PortVersionInfoApi: set at pre-compile  # Pre-processor switch to enable / disable the API to read out the modules version information. | true: Version info API enabled. false: Version info API disabled.
  module definition Lin [0..*]: variants post-build/pre-compile  # Configuration of the Lin (LIN driver) module.
    container LinDemEventParameterRefs [0..1]  # Container for the references to DemEventParameter elements which shall be invoked using the API Dem_ReportErrorStatus API in case the corresponding error occurs. The EventId is taken from the referenced DemEventParameter's DemEventId value. The standardized errors are provided in the container and can be extended by vendor specific error references.
      symbolic name reference LIN_E_TIMEOUT [0..1]: set at pre-compile, destination=DemEventParameter  # Reference to the DemEventParameter which shall be issued when the error "Timeout caused by hardware error" has occurred. If the reference is not configured the error shall be reported as DET error.
    container LinGeneral  # This container contains the parameters related to each LIN Driver Unit.
      boolean LinDevErrorDetect: set at pre-compile  # Switches the Development Error Detection and Notification ON or OFF.
      integer LinIndex: 0..255, set at pre-compile  # Specifies the InstanceId of this module instance. If only one instance is present it shall have the Id 0.
      integer LinTimeoutDuration: 0..65535, set at pre-compile  # Specifies the maximum number of loops for blocking function until a timeout is raised in short term wait loops
      boolean LinVersionInfoApi: set at pre-compile  # Switches the Lin_GetVersionInfo function ON or OFF.
    container LinGlobalConfig: multiple-configuration-container=true  # This container contains the global configuration parameter of the Lin driver. This container is a MultipleConfigurationContainer, i.e. this container and its sub-containers exit once per configuration set.
      container LinChannel [1..*]  # This container contains the configuration (parameters) of the LIN Controller(s).
        integer LinChannelBaudRate: 1000..20000, set at post-build in variant post-build / pre-compile in variant pre-compile  # Specifies the baud rate of the LIN channel
        integer LinChannelId: 0..65535, set at pre-compile, symbolic-name-value=true  # Identifies the LIN channel. Replaces LIN_CHANNEL_INDEX_NAME from the LIN SWS.
        boolean LinChannelWakeupSupport: set at pre-compile  # Specifies if the LIN hardware channel supports wake up functionality
        reference LinClockRef: set at post-build in variant post-build / pre-compile in variant pre-compile, destination=McuClockReferencePoint  # Reference to the LIN clock source configuration, which is set in the MCU driver configuration.
        symbolic name reference LinChannelEcuMWakeupSource [0..1]: set at pre-compile, destination=EcuMWakeupSource  # This parameter contains a reference to the Wakeup Source for this controller as defined in the ECU State Manager.
  module definition Adc [0..1]: variants post-build/pre-compile  # Configuration of the Adc (Analog Digital Conversion) module.
    container AdcConfigSet: multiple-configuration-container=true  # This is the base container that contains the post-build selectable configuration parameters
      container AdcHwUnit [1..*]  # This container contains the Driver configuration (parameters) depending on grouping of channels | This container could contain HW specific parameters which are not defined in the Standardized Module Definition. They must be added in the Vendor Specific Module Definition.
        enumeration AdcClockSource [0..1]: set at post-build in variant post-build / pre-compile in variant pre-compile  # The ADC module specific clock input for the conversion unit can | statically be configured to select different clock sources if provided by hardware. Enumeration literals are defined vendor specific.
        enumeration AdcHwUnitId: set at post-build in variant post-build / pre-compile in variant pre-compile  # Description: Numeric ID of the HW Unit. This symbolic name allows accessing Hw Unit data. Enumeration literals are defined vendor specific.
        integer AdcPrescale [0..1]: 0..65535, set at post-build in variant post-build / pre-compile in variant pre-compile  # Optional ADC module specific clock prescale factor, if supported by hardware. | ImplementationType: Adc_PrescaleType
        container AdcChannel [1..*]  # This container contains the channel configuration (parameters) depending on the hardware capability. | The organization of this data structure could contain dependencies to the microcontroller so this is left up to the implementer and its location is left up to the configuration. Note: Since a AdcChannel can be part of several AdcGroups, this container is not realized as a subcontainer of AdcGroup but instead as a subcontainer of AdcHwUnit.
          integer AdcChannelConvTime [0..1]: 0..18446744073709551615, set at post-build in variant post-build / pre-compile in variant pre-compile  # Configuration of conversion time, i.e. the time during which the analogue value is converted into digital representation, (in clock cycles) for each channel, if supported by hardware. | ImplementationType: Adc_ConversionTimeType
          integer AdcChannelHighLimit [0..1]: 0..18446744073709551615, set at pre-compile  # High limit - used for limit checking.
          integer AdcChannelId: 0..1024, set at post-build in variant post-build / pre-compile in variant pre-compile  # This parameter defines the assignment of the channel to the physical ADC hardware channel. | ImplementationType: Adc_ChannelType
          boolean AdcChannelLimitCheck [0..1]: set at pre-compile  # Enables or disables limit checking for an ADC channel.
          integer AdcChannelLowLimit [0..1]: 0..18446744073709551615, set at pre-compile  # Low limit - used for limit checking.
          enumeration AdcChannelRangeSelect [0..1]: {ADC_RANGE_ALWAYS, ADC_RANGE_BETWEEN, ADC_RANGE_NOT_BETWEEN, ADC_RANGE_NOT_OVER_HIGH, ADC_RANGE_NOT_UNDER_LOW, ADC_RANGE_OVER_HIGH, ADC_RANGE_UNDER_LOW}, set at pre-compile  # In case of active limit checking: defines which conversion values are taken into account related to the boarders defined with AdcChannelLowLimit and AdcChannelHighLimit. | Implementation Type: Adc_ChannelRangeSelectType
          enumeration AdcChannelRefVoltsrcHigh [0..1]: set at post-build in variant post-build / pre-compile in variant pre-compile  # Upper reference voltage source for each channel. | Enumeration literals are defined vendor specific.
          enumeration AdcChannelRefVoltsrcLow [0..1]: set at post-build in variant post-build / pre-compile in variant pre-compile  # Lower reference voltage source for each channel. | Enumeration literals are defined vendor specific.
          integer AdcChannelResolution [0..1]: 1..63, set at post-build in variant post-build / pre-compile in variant pre-compile  # Channel resolution in bits. | ImplementationType: Adc_ResolutionType
          integer AdcChannelSampTime [0..1]: 0..18446744073709551615, set at post-build in variant post-build / pre-compile in variant pre-compile  # Configuration of sampling time, i.e. the time during which the value is sampled, (in clock cycles) for each channel, if supported by hardware. | ImplementationType: Adc_SamplingTimeType
        container AdcGroup [1..*]  # This container contains the Group configuration (parameters).
          enumeration AdcGroupAccessMode: {ADC_ACCESS_MODE_SINGLE, ADC_ACCESS_MODE_STREAMING}, set at post-build in variant post-build / pre-compile in variant pre-compile  # Type of access mode to group conversion results. | ImplementationType: Adc_GroupAccessModeType
          enumeration AdcGroupConversionMode: {ADC_CONV_MODE_CONTINUOUS, ADC_CONV_MODE_ONESHOT}, set at post-build in variant post-build / pre-compile in variant pre-compile  # Type of conversion mode supported by the driver. | ImplementationType: Adc_GroupConvModeType
          integer AdcGroupId: 0..1023, set at post-build in variant post-build / pre-compile in variant pre-compile, symbolic-name-value=true  # Numeric ID of the group. This parameter is the symbolic name to be used on the API. This symbolic name allows accessing Channel Group data. This value will be assigned to the symbolic name derived of the AdcGroup container shortName. | ImplementationType: Adc_GroupType
          integer AdcGroupPriority [0..1]: 0..255, set at post-build in variant post-build / pre-compile in variant pre-compile  # Priority level of the AdcGroup. | ImplementationType: Adc_GroupPriorityType
          enumeration AdcGroupReplacement [0..1]: {ADC_GROUP_REPL_ABORT_RESTART, ADC_GROUP_REPL_SUSPEND_RESUME}, set at post-build in variant post-build / pre-compile in variant pre-compile  # Replacement mechanism, which is used on ADC group level, if a group conversion is interrupted by a group which has a higher priority. | ImplementationType: Adc_GroupReplacementType
          enumeration AdcGroupTriggSrc: {ADC_TRIGG_SRC_HW, ADC_TRIGG_SRC_SW}, set at post-build in variant post-build / pre-compile in variant pre-compile  # Type of source event that starts a group conversion. | ImplementationType: Adc_TriggerSourceType
          enumeration AdcHwTrigSignal [0..1]: {ADC_HW_TRIG_BOTH_EDGES, ADC_HW_TRIG_FALLING_EDGE, ADC_HW_TRIG_RISING_EDGE}, set at post-build in variant post-build / pre-compile in variant pre-compile  # Configures on which edge of the hardware trigger signal the driver should react, i.e. start the conversion (only if supported by the ADC hardware). | ImplementationType: Adc_HwTriggerSignalType
          integer AdcHwTrigTimer [0..1]: 0..18446744073709551615, set at post-build in variant post-build / pre-compile in variant pre-compile  # Reload value of the ADC module embedded timer (only if supported by ADC hardware). | ImplementationType: Adc_HwTriggerTimerType
          function name AdcNotification [0..1]: set at post-build in variant post-build / pre-compile in variant pre-compile  # Callback function for each group
          enumeration AdcStreamingBufferMode: {ADC_STREAM_BUFFER_CIRCULAR, ADC_STREAM_BUFFER_LINEAR}, set at post-build in variant post-build / pre-compile in variant pre-compile  # Configure streaming buffer as "linear buffer" (i.e. the ADC Driver stops the conversion as soon as the stream buffer is full) or as "ring buffer" (wraps around if the end of the stream buffer is reached). | ImplementationType: Adc_StreamBufferModeType
          integer AdcStreamingNumSamples: 1..255, set at post-build in variant post-build / pre-compile in variant pre-compile, default-value=1  # Number of ADC values to be acquired per channel in streaming access mode. | Note: in single access mode this parameter assumes value 1, since only one sample per channel is processed. ImplementationType: Adc_StreamNumSampleType
          reference AdcGroupDefinition [1..*]: set at post-build in variant post-build / pre-compile in variant pre-compile, destination=AdcHwUnit/AdcChannel  # Assignment of AdcChannels to a AdcGroups. | ImplementationType: Adc_GroupDefType
      container AdcConfigSet: multiple-configuration-container=true  # This is the base container that contains the post-build selectable configuration parameters
        container AdcHwUnit [1..*]  # This container contains the Driver configuration (parameters) depending on grouping of channels | This container could contain HW specific parameters which are not defined in the Standardized Module Definition. They must be added in the Vendor Specific Module Definition.
          enumeration AdcClockSource [0..1]: set at post-build in variant post-build / pre-compile in variant pre-compile  # The ADC module specific clock input for the conversion unit can | statically be configured to select different clock sources if provided by hardware. Enumeration literals are defined vendor specific.
          enumeration AdcHwUnitId: set at post-build in variant post-build / pre-compile in variant pre-compile  # Description: Numeric ID of the HW Unit. This symbolic name allows accessing Hw Unit data. Enumeration literals are defined vendor specific.
          integer AdcPrescale [0..1]: 0..65535, set at post-build in variant post-build / pre-compile in variant pre-compile  # Optional ADC module specific clock prescale factor, if supported by hardware. | ImplementationType: Adc_PrescaleType
          container AdcChannel [1..*]  # This container contains the channel configuration (parameters) depending on the hardware capability. | The organization of this data structure could contain dependencies to the microcontroller so this is left up to the implementer and its location is left up to the configuration. Note: Since a AdcChannel can be part of several AdcGroups, this container is not realized as a subcontainer of AdcGroup but instead as a subcontainer of AdcHwUnit.
            integer AdcChannelConvTime [0..1]: 0..18446744073709551615, set at post-build in variant post-build / pre-compile in variant pre-compile  # Configuration of conversion time, i.e. the time during which the analogue value is converted into digital representation, (in clock cycles) for each channel, if supported by hardware. | ImplementationType: Adc_ConversionTimeType
            integer AdcChannelHighLimit [0..1]: 0..18446744073709551615, set at pre-compile  # High limit - used for limit checking.
            integer AdcChannelId: 0..1024, set at post-build in variant post-build / pre-compile in variant pre-compile  # This parameter defines the assignment of the channel to the physical ADC hardware channel. | ImplementationType: Adc_ChannelType
            boolean AdcChannelLimitCheck [0..1]: set at pre-compile  # Enables or disables limit checking for an ADC channel.
            integer AdcChannelLowLimit [0..1]: 0..18446744073709551615, set at pre-compile  # Low limit - used for limit checking.
            enumeration AdcChannelRangeSelect [0..1]: {ADC_RANGE_ALWAYS, ADC_RANGE_BETWEEN, ADC_RANGE_NOT_BETWEEN, ADC_RANGE_NOT_OVER_HIGH, ADC_RANGE_NOT_UNDER_LOW, ADC_RANGE_OVER_HIGH, ADC_RANGE_UNDER_LOW}, set at pre-compile  # In case of active limit checking: defines which conversion values are taken into account related to the boarders defined with AdcChannelLowLimit and AdcChannelHighLimit. | Implementation Type: Adc_ChannelRangeSelectType
            enumeration AdcChannelRefVoltsrcHigh [0..1]: set at post-build in variant post-build / pre-compile in variant pre-compile  # Upper reference voltage source for each channel. | Enumeration literals are defined vendor specific.
            enumeration AdcChannelRefVoltsrcLow [0..1]: set at post-build in variant post-build / pre-compile in variant pre-compile  # Lower reference voltage source for each channel. | Enumeration literals are defined vendor specific.
            integer AdcChannelResolution [0..1]: 1..63, set at post-build in variant post-build / pre-compile in variant pre-compile  # Channel resolution in bits. | ImplementationType: Adc_ResolutionType
            integer AdcChannelSampTime [0..1]: 0..18446744073709551615, set at post-build in variant post-build / pre-compile in variant pre-compile  # Configuration of sampling time, i.e. the time during which the value is sampled, (in clock cycles) for each channel, if supported by hardware. | ImplementationType: Adc_SamplingTimeType
          container AdcGroup [1..*]  # This container contains the Group configuration (parameters).
            enumeration AdcGroupAccessMode: {ADC_ACCESS_MODE_SINGLE, ADC_ACCESS_MODE_STREAMING}, set at post-build in variant post-build / pre-compile in variant pre-compile  # Type of access mode to group conversion results. | ImplementationType: Adc_GroupAccessModeType
            enumeration AdcGroupConversionMode: {ADC_CONV_MODE_CONTINUOUS, ADC_CONV_MODE_ONESHOT}, set at post-build in variant post-build / pre-compile in variant pre-compile  # Type of conversion mode supported by the driver. | ImplementationType: Adc_GroupConvModeType
            integer AdcGroupId: 0..1023, set at post-build in variant post-build / pre-compile in variant pre-compile, symbolic-name-value=true  # Numeric ID of the group. This parameter is the symbolic name to be used on the API. This symbolic name allows accessing Channel Group data. This value will be assigned to the symbolic name derived of the AdcGroup container shortName. | ImplementationType: Adc_GroupType
            integer AdcGroupPriority [0..1]: 0..255, set at post-build in variant post-build / pre-compile in variant pre-compile  # Priority level of the AdcGroup. | ImplementationType: Adc_GroupPriorityType
            enumeration AdcGroupReplacement [0..1]: {ADC_GROUP_REPL_ABORT_RESTART, ADC_GROUP_REPL_SUSPEND_RESUME}, set at post-build in variant post-build / pre-compile in variant pre-compile  # Replacement mechanism, which is used on ADC group level, if a group conversion is interrupted by a group which has a higher priority. | ImplementationType: Adc_GroupReplacementType
            enumeration AdcGroupTriggSrc: {ADC_TRIGG_SRC_HW, ADC_TRIGG_SRC_SW}, set at post-build in variant post-build / pre-compile in variant pre-compile  # Type of source event that starts a group conversion. | ImplementationType: Adc_TriggerSourceType
            enumeration AdcHwTrigSignal [0..1]: {ADC_HW_TRIG_BOTH_EDGES, ADC_HW_TRIG_FALLING_EDGE, ADC_HW_TRIG_RISING_EDGE}, set at post-build in variant post-build / pre-compile in variant pre-compile  # Configures on which edge of the hardware trigger signal the driver should react, i.e. start the conversion (only if supported by the ADC hardware). | ImplementationType: Adc_HwTriggerSignalType
            integer AdcHwTrigTimer [0..1]: 0..18446744073709551615, set at post-build in variant post-build / pre-compile in variant pre-compile  # Reload value of the ADC module embedded timer (only if supported by ADC hardware). | ImplementationType: Adc_HwTriggerTimerType
            function name AdcNotification [0..1]: set at post-build in variant post-build / pre-compile in variant pre-compile  # Callback function for each group
            enumeration AdcStreamingBufferMode: {ADC_STREAM_BUFFER_CIRCULAR, ADC_STREAM_BUFFER_LINEAR}, set at post-build in variant post-build / pre-compile in variant pre-compile  # Configure streaming buffer as "linear buffer" (i.e. the ADC Driver stops the conversion as soon as the stream buffer is full) or as "ring buffer" (wraps around if the end of the stream buffer is reached). | ImplementationType: Adc_StreamBufferModeType
            integer AdcStreamingNumSamples: 1..255, set at post-build in variant post-build / pre-compile in variant pre-compile, default-value=1  # Number of ADC values to be acquired per channel in streaming access mode. | Note: in single access mode this parameter assumes value 1, since only one sample per channel is processed. ImplementationType: Adc_StreamNumSampleType
            reference AdcGroupDefinition [1..*]: set at post-build in variant post-build / pre-compile in variant pre-compile, destination=AdcHwUnit/AdcChannel  # Assignment of AdcChannels to a AdcGroups. | ImplementationType: Adc_GroupDefType
    container AdcGeneral  # General configuration (parameters) of the ADC Driver software module.
      boolean AdcDeInitApi: set at pre-compile  # Adds / removes the service Adc_DeInit() from the code. | true: Adc_DeInit() can be used. false: Adc_DeInit() can not be used.
      boolean AdcDevErrorDetect: set at pre-compile  # Switches the Development Error Detection and Notification ON or OFF. | true: Enabled. false: Disabled.
      boolean AdcEnableLimitCheck: set at pre-compile  # Enables or disables limit checking feature in the ADC driver.
      boolean AdcEnableQueuing: set at pre-compile  # Determines, if the queuing mechanism is active in case of priority mechanism disabled. | Note: If priority mechanism is enabled, queuing mechanism is always active and the parameter ADC_ENABLE_QUEUING is not evaluated. true: Enabled. false: Disabled.
      boolean AdcEnableStartStopGroupApi: set at pre-compile  # Adds / removes the services Adc_StartGroupConversion() and Adc_StopGroupConversion() from the code. | true: Adc_StartGroupConversion() and Adc_StopGroupConversion() can be used. false: Adc_StartGroupConversion() and Adc_StopGroupConversion() can not be used.
      boolean AdcGrpNotifCapability: set at pre-compile  # Determines, if the group notification mechanism (the functions to enable and disable the notifications) is available at runtime. | true: Enabled. false: Disabled.
      boolean AdcHwTriggerApi: set at pre-compile  # Adds / removes the services Adc_EnableHardwareTrigger() and Adc_DisableHardwareTrigger() from the code. | true: Adc_EnableHardwareTrigger() and Adc_DisableHardwareTrigger() can be used. false: Adc_EnableHardwareTrigger() and Adc_DisableHardwareTrigger() can not be used.
      boolean AdcLowPowerStatesSupport [0..1]: set at pre-compile, default-value=false  # Adds / removes all power state management related APIs (ADC_SetPowerState, ADC_GetCurrentPowerState, ADC_GetTargetPowerState, ADC_PreparePowerState, ADC_Main_PowerTransitionManager), indicating if the HW offers low power state management.
      boolean AdcPowerStateAsynchTransitionMode [0..1]: set at pre-compile, default-value=false  # Enables / disables support of the ADCDriver to the asynchronous power state transition.
      enumeration AdcPriorityImplementation: {ADC_PRIORITY_HW, ADC_PRIORITY_HW_SW, ADC_PRIORITY_NONE}, set at pre-compile  # Determines whether a priority mechanism is available for prioritization of the conversion requests and if available, the type of prioritization mechanism. The selection applies for groups with trigger source software and trigger source hardware. Two | types of prioritization mechanism can be selected. The hardware prioritization mechanism (AdcPriorityHw) uses the ADC hardware features for prioritization of the software conversion requests and hardware trigger signals for groups with trigger source hardware. The mixed hardware and software prioritization mechanism (AdcPriorityHwSw) uses the ADC hardware features for prioritization of ADC hardware trigger for groups with trigger source hardware and a software implemented prioritization mechanism for groups with trigger source software. The group priorities for software triggered groups are typically configured with lower priority levels than the group priorities for hardware triggered groups. ImplementationType: Adc_PriorityImplementationType
      boolean AdcReadGroupApi: set at pre-compile  # Adds / removes the service Adc_ReadGroup() and from the code. | true: Adc_ReadGroup() can be used. false: Adc_ReadGroup() can not be used.
      enumeration AdcResultAlignment: {ADC_ALIGN_LEFT, ADC_ALIGN_RIGHT}, set at pre-compile  # Alignment of ADC raw results in ADC result buffer (left/right alignment). | Implementation Type: Adc_ResultAlignmentType
      boolean AdcVersionInfoApi: set at pre-compile  # Adds / removes the service Adc_GetVersionInfo() from the code. | true: Adc_GetVersionInfo() can be used. false: Adc_GetVersionInfor() can not be used.
      container AdcPowerStateConfig [0..*]  # Each instance of this parameter defines a power state and the callback to be called when this power state is reached.
        integer AdcPowerState: 0..18446744073709551615, set at pre-compile, symbolic-name-value=true  # Each instance of this parameter describes a different power state supported by the ADC HW. It should be defined by the HW supplier and used by the ADCDriver to reference specific HW configurations which set the ADC HW module in the referenced power state. | At least the power mode corresponding to full power state shall be always configured.
        function name AdcPowerStateReadyCbkRef: set at pre-compile  # Each instance of this parameter contains a reference to a power mode callback defined in a CDD or IoHwAbs component.
    container AdcPublishedInformation  # Additional published parameters not covered by CommonPublishedInformation container. | Note that these parameters do not have any configuration class setting, since they are published information.
      boolean AdcChannelValueSigned: set at published-information  # Information whether the result value of the ADC driver has sign information (true) or not (false). If the result shall be interpreted as signed value it shall apply to C-language rules.
      boolean AdcGroupFirstChannelFixed: set at published-information  # Information whether the first channel of an ADC Channel group can be configured (false) or is fixed (true) to a value determined by the ADC HW Unit.
      integer AdcMaxChannelResolution: 1..63, set at published-information  # Maximum Channel resolution in bits (does not specify accuracy).
  module definition Pwm [0..*]: variants post-build/pre-compile  # Configuration of Pwm (Pulse Width Modulation) module.
    container PwmChannelConfigSet: multiple-configuration-container=true  # Multiple Configuration Set Container
      container PwmChannel [1..*]  # Configuration of an individual PWM channel.
        enumeration PwmChannelClass [0..1]: {PWM_FIXED_PERIOD, PWM_FIXED_PERIOD_SHIFTED, PWM_VARIABLE_PERIOD}, set at post-build in variant post-build / pre-compile in variant pre-compile  # Class of PWM Channel. | ImplementationType: Pwm_ChannelClassType
        integer PwmChannelId: 0..4294967295, set at pre-compile, symbolic-name-value=true  # Channel Id of the PWM channel. This value will be assigned to the symbolic name derived of the PwmChannel container short name.
        integer PwmDutycycleDefault: 0..32768, set at post-build in variant post-build / pre-compile in variant pre-compile  # Value of duty cycle used for Initialization | 0, represents 0% 0x8000 represents 100%
        enumeration PwmIdleState: {PWM_HIGH, PWM_LOW}, set at post-build in variant post-build / pre-compile in variant pre-compile  # The parameter PWM_IDLE_STATE represents the output state of the PWM after the signal is stopped (e.g. call of Pwm_SetOutputToIdle).
        function name PwmNotification [0..1]: set at post-build in variant post-build / pre-compile in variant pre-compile, default-value="NULL"  # Definition of the Callback function.
        float PwmPeriodDefault: 0..Inf, set at post-build in variant post-build / pre-compile in variant pre-compile  # Value of period used for Initialization.(in seconds).
        enumeration PwmPolarity: {PWM_HIGH, PWM_LOW}, set at post-build in variant post-build / pre-compile in variant pre-compile  # Defines the starting polarity of each PWM channel.
    container PwmConfigurationOfOptApiServices
      boolean PwmDeInitApi: set at pre-compile  # Adds / removes the service Pwm_DeInit() from the code.
      boolean PwmGetOutputState: set at pre-compile
      boolean PwmSetDutyCycle: set at pre-compile
      boolean PwmSetOutputToIdle: set at pre-compile
      boolean PwmSetPeriodAndDuty: set at pre-compile
      boolean PwmVersionInfoApi: set at pre-compile  # Switch to indicate that the Pwm_ GetVersionInfo is supported
    container PwmGeneral
      boolean PwmDevErrorDetect: set at pre-compile  # Switch for enabling the development error detection.
      boolean PwmDutycycleUpdatedEndperiod: set at pre-compile  # Switch for enabling the update of the duty cycle parameter at the end of the current period. | TRUE: update of duty cycle is done at the end of period of currently generated waveform (current waveform is finished). FALSE: update of duty cycle is done immediately (just after service call, current waveform is cut).
      integer PwmIndex: 0..4294967295, set at pre-compile  # Specifies the InstanceId of this module instance. If only one instance is present it shall have the Id 0.
      boolean PwmLowPowerStatesSupport [0..1]: set at pre-compile, default-value=false  # Adds / removes all power state management related APIs (PWM_SetPowerState, PWM_GetCurrentPowerState, PWM_GetTargetPowerState, PWM_PreparePowerState, PWM_Main_PowerTransitionManager), indicating if the HW offers low power state management.
      boolean PwmNotificationSupported: set at pre-compile  # Switch to indicate that the notifications are supported
      boolean PwmPeriodUpdatedEndperiod: set at pre-compile  # Switch for enabling the update of the period parameter at the end of the current period. | TRUE: update of period/duty cycle is done at the end of period of currently generated waveform (current waveform is finished). FALSE: update of period/duty cycle is done immediately (just after service call, current waveform is cut).
      boolean PwmPowerStateAsynchTransitionMode [0..1]: set at pre-compile, default-value=false  # Enables / disables support of the PWM Driver to the asynchronous power state transition.
      container PwmPowerStateConfig [0..*]  # Each instance of this parameter defines a power state and the callback to be called when this power state is reached.
        integer PwmPowerState: 0..18446744073709551615, set at pre-compile, symbolic-name-value=true  # Each instance of this parameter describes a different power state supported by the PWM HW. It should be defined by the HW supplier and used by the PWMDriver to reference specific HW configurations which set the PWM HW module in the referenced power state. | At least the power mode corresponding to full power state shall be always configured.
        function name PwmPowerStateReadyCbkRef: set at pre-compile  # Each instance of this parameter contains a reference to a power mode callback defined in a CDD or IoHwAbs component.
  module definition Spi [0..1]: variants link-time/post-build/pre-compile  # Configuration of the Spi (Serial Peripheral Interface) module.
    container SpiDemEventParameterRefs [0..1]  # Container for the references to DemEventParameter elements which shall be invoked using the API Dem_ReportErrorStatus API in case the corresponding error occurs. The EventId is taken from the referenced DemEventParameter's DemEventId value. The standardized errors are provided in the container and can be extended by vendor specific error references.
      symbolic name reference SPI_E_HARDWARE_ERROR [0..1]: set at pre-compile, destination=DemEventParameter  # Reference to configured DEM event to report "Hardware failure". If the reference is not configured the error shall not be reported.
    container SpiDriver: multiple-configuration-container=true  # Configuration of one instance (if multiplicity is 1, it is the sole configuration) of an SPI driver.
      integer SpiMaxChannel [0..1]: 0..255, set at link in variant link-time / post-build in variant post-build / pre-compile in variant pre-compile  # This parameter contains the number of Channels configured. It will be gathered by tools during the configuration stage.
      integer SpiMaxJob [0..1]: 0..65535, set at link in variant link-time / post-build in variant post-build / pre-compile in variant pre-compile  # Total number of Jobs configured.
      integer SpiMaxSequence [0..1]: 0..255, set at link in variant link-time / post-build in variant post-build / pre-compile in variant pre-compile  # Total number of Sequences configured.
      container SpiChannel [1..*]  # All data needed to configure one SPI-channel
        integer SpiChannelId: 0..255, set at pre-compile, symbolic-name-value=true  # SPI Channel ID, used as parameter in SPI API functions.
        enumeration SpiChannelType: {EB, IB}, set at link in variant link-time / post-build in variant post-build / pre-compile in variant pre-compile  # Buffer usage with EB/IB channel.
        integer SpiDataWidth: 1..32, set at link in variant link-time / post-build in variant post-build / pre-compile in variant pre-compile  # This parameter is the width of a transmitted data unit.
        integer SpiDefaultData [0..1]: 0..4294967295, set at link in variant link-time / post-build in variant post-build / pre-compile in variant pre-compile  # The default data to be transmitted when (for internal buffer or external buffer) the pointer passed to Spi_WriteIB (for internal buffer) or to Spi_SetupEB (for external buffer) is NULL.
        integer SpiEbMaxLength: 0..65535, set at link in variant link-time / post-build in variant post-build / pre-compile in variant pre-compile  # This parameter contains the maximum size (number of data elements) of data buffers in case of EB Channels and only.
        integer SpiIbNBuffers: 0..65535, set at link in variant link-time / post-build in variant post-build / pre-compile in variant pre-compile  # This parameter contains the maximum number of data buffers in case of IB Channels and only.
        enumeration SpiTransferStart: {LSB, MSB}, set at link in variant link-time / post-build in variant post-build / pre-compile in variant pre-compile  # This parameter defines the first starting bit for transmission.
      container SpiExternalDevice [1..*]  # The communication settings of an external device. Closely linked to SpiJob.
        float SpiBaudrate: 0..Inf, set at link in variant link-time / post-build in variant post-build / pre-compile in variant pre-compile  # This parameter is the communication baudrate - This parameter allows | using a range of values, from the point of view of configuration tools, from Hz up to MHz.
        string SpiCsIdentifier: set at link in variant link-time / post-build in variant post-build / pre-compile in variant pre-compile, symbolic-name-value=true  # This parameter is the symbolic name to identify the Chip Select (CS) allocated to this Job.
        enumeration SpiCsPolarity: {HIGH, LOW}, set at link in variant link-time / post-build in variant post-build / pre-compile in variant pre-compile  # This parameter defines the active polarity of Chip Select.
        enumeration SpiCsSelection [0..1]: {CS_VIA_GPIO, CS_VIA_PERIPHERAL_ENGINE}, set at link in variant link-time / post-build in variant post-build / pre-compile in variant pre-compile, default-value=CS_VIA_PERIPHERAL_ENGINE  # When the Chip select handling is enabled (see SpiEnableCs), then this parameter specifies if the chip select is handled automatically by Peripheral HW engine or via general purpose IO by Spi driver.
        enumeration SpiDataShiftEdge: {LEADING, TRAILING}, set at link in variant link-time / post-build in variant post-build / pre-compile in variant pre-compile  # This parameter defines the SPI data shift edge.
        boolean SpiEnableCs: set at link in variant link-time / post-build in variant post-build / pre-compile in variant pre-compile  # This parameter enables or not the Chip Select handling functions. If this parameter is enabled then parameter SpiCsSelection further details the type of chip selection.
        enumeration SpiHwUnit: {CSIB0, CSIB1, CSIB2, CSIB3}, set at link in variant link-time / post-build in variant post-build / pre-compile in variant pre-compile  # This parameter is the symbolic name to identify the HW SPI Hardware | microcontroller peripheral allocated to this Job.
        enumeration SpiShiftClockIdleLevel: {HIGH, LOW}, set at link in variant link-time / post-build in variant post-build / pre-compile in variant pre-compile  # This parameter defines the SPI shift clock idle level.
        float SpiTimeClk2Cs: 0..1E-4, set at link in variant link-time / post-build in variant post-build / pre-compile in variant pre-compile  # Timing between clock and chip select (in seconds) - This parameter allows to use a range of values from 0 up to 0.0001 seconds. | The real configuration-value used in software BSW-SPI is calculated out of this by the generator-tools
      container SpiJob [1..*]  # All data needed to configure one SPI-Job, amongst others the connection between the internal SPI unit and the special settings for an external device is done.
        enumeration SpiHwUnitSynchronous [0..1]: {ASYNCHRONOUS, SYNCHRONOUS}, set at link in variant link-time / post-build in variant post-build / pre-compile in variant pre-compile  # If SpiHwUnitSynchronous is set to "SYNCHRONOUS", the SpiJob uses its containing SpiDriver in a synchronous manner. If it is set to "ASYNCHRONOUS", it uses the driver in an asynchronous way. If the parameter is not set, the SpiChannel uses the driver also in an asynchronous way.
        function name SpiJobEndNotification [0..1]: set at link in variant link-time / post-build in variant post-build / pre-compile in variant pre-compile  # This parameter is a reference to a notification function.
        integer SpiJobId: 0..65535, set at pre-compile, symbolic-name-value=true  # SPI Job ID, used as parameter in SPI API functions.
        integer SpiJobPriority: 0..3, set at link in variant link-time / post-build in variant post-build / pre-compile in variant pre-compile  # Priority set accordingly to SPI093: 0, lowest, 3, highest priority
        reference SpiDeviceAssignment: set at pre-compile, destination=SpiExternalDevice  # Reference to the external device used by this job
        container SpiChannelList [1..*]  # References to SPI channels and their order within the Job.
          integer SpiChannelIndex: 0..255, set at link in variant link-time / post-build in variant post-build / pre-compile in variant pre-compile  # This parameter specifies the order of Channels within the Job.
          reference SpiChannelAssignment: set at link in variant link-time / post-build in variant post-build / pre-compile in variant pre-compile, destination=SpiChannel  # A job reference to a SPI channel.
      container SpiSequence [1..*]  # All data needed to configure one SPI-sequence
        boolean SpiInterruptibleSequence: set at link in variant link-time / post-build in variant post-build / pre-compile in variant pre-compile  # This parameter allows or not this Sequence to be suspended by another one.
        function name SpiSeqEndNotification [0..1]: set at link in variant link-time / post-build in variant post-build / pre-compile in variant pre-compile  # This parameter is a reference to a notification function.
        integer SpiSequenceId: 0..255, set at pre-compile, symbolic-name-value=true  # SPI Sequence ID, used as parameter in SPI API functions.
        reference SpiJobAssignment [1..*]: set at link in variant link-time / post-build in variant post-build / pre-compile in variant pre-compile, destination=SpiJob  # A sequence references several jobs, which are executed during a communication sequence
    container SpiGeneral  # General configuration settings for SPI-Handler
      boolean SpiCancelApi: set at pre-compile  # Switches the Spi_Cancel function ON or OFF.
      integer SpiChannelBuffersAllowed: 0..2, set at pre-compile  # Selects the SPI Handler/Driver Channel Buffers usage allowed and | delivered. IB = 0; EB = 1; IB/EB = 2;
      boolean SpiDevErrorDetect: set at pre-compile  # Switches the Development Error Detection and Notification ON or OFF.
      boolean SpiHwStatusApi: set at pre-compile  # Switches the Spi_GetHWUnitStatus function ON or OFF.
      boolean SpiInterruptibleSeqAllowed: set at pre-compile  # Switches the Interruptible Sequences handling functionality ON or OFF.
      integer SpiLevelDelivered: 0..2, set at pre-compile  # Selects the SPI Handler/Driver level of scalable functionality that is | available and delivered.
      float SpiMainFunctionPeriod [0..1]: 1E-7..1, set at pre-compile, default-value=0.01  # This parameter defines the cycle time of the function Spi_MainFunction_Handling in seconds. The parameter is not used by the driver it self, but it is used by upper layer.
      boolean SpiSupportConcurrentSyncTransmit: set at pre-compile  # Specifies whether concurrent Spi_SyncTransmit() calls for different sequences shall be configurable.
      boolean SpiVersionInfoApi: set at pre-compile  # Switches the Spi_GetVersionInfo function ON or OFF.
    container SpiPublishedInformation  # Container holding all SPI specific published information parameters
      integer SpiMaxHwUnit: 0..18446744073709551615, set at published-information  # Number of different SPI hardware microcontroller peripherals (units/busses) available and handled by this SPI Handler/Driver module.
  module definition CorTst [0..1]: variants link-time/pre-compile  # Configuration of the CorTst module.
    container CorTstBackgroundConfigSet [0..*]  # Multiple Configuration Set Container, defines background mode.
      container CorTstSelect  # This container specifies configuration parameters to select individual tests for foreground mode and background mode. The availability is hardware and implementation specific.
        boolean CorTstAddress: set at link in variant link-time / pre-compile in variant pre-compile, default-value=false  # Enable/Disables core address test.
        boolean CorTstAlu: set at link in variant link-time / pre-compile in variant pre-compile, default-value=false  # Enable/Disables core ALU test.
        boolean CorTstCache: set at link in variant link-time / pre-compile in variant pre-compile, default-value=false  # Enable/Disables core cache test.
        boolean CorTstInterrupt: set at link in variant link-time / pre-compile in variant pre-compile, default-value=false  # Enable/Disables core interrupt test
        boolean CorTstMemoryIf: set at link in variant link-time / pre-compile in variant pre-compile, default-value=false  # Enable/Disables core memory interface test
        boolean CorTstMpu: set at link in variant link-time / pre-compile in variant pre-compile, default-value=false  # Enable/Disables core MPU test
        boolean CorTstRegister: set at link in variant link-time / pre-compile in variant pre-compile, default-value=false  # Enable/Disables core register test
    container CorTstConfigApiServices
      boolean CorTstAbortApi: set at pre-compile, default-value=false  # Adds / removes the service CorTst_Abort() from the code.
      boolean CorTstGetCurrentStatus: set at pre-compile, default-value=false  # Adds / removes the service CorTst_GetCurrentStatus() from the code.
      boolean CorTstGetFgndSignature: set at pre-compile, default-value=false  # Adds / removes the service CorTst_GetFgndSignature() from the code.
      boolean CorTstGetSignature: set at pre-compile, default-value=false  # Adds / removes the service CorTst_GetSignature() from the code.
      boolean CorTstGetStateApi: set at pre-compile, default-value=false  # Adds / removes the service CorTst_GetState() from the code.
      boolean CorTstStartApi: set at pre-compile, default-value=false  # Adds / removes the service CorTst_Start() from the code.
      boolean CorTstVersionInfoApi: set at pre-compile, default-value=false  # Adds / removes the service CorTst_GetVersionInfo() from the code.
    container CorTstDemEventParameterRefs [0..1]  # Container for the references to DemEventParameter elements which shall be invoked using the API Dem_ReportErrorStatus in case the corresponding error occurs. The EventId is taken from the referenced DemEventParameter's DemEventId value. The standardized errors are provided in the container and can be extended by vendor specific error references.
      symbolic name reference CORTST_E_CORE_FAILURE [0..1]: set at pre-compile, destination=DemEventParameter  # Reference to the DemEventParameter which shall be issued when the error "CORE failure" has occured.
    container CorTstForegroundConfigSet [1..*]  # Multiple Configuration Set Container , defines foreground mode.
      integer CorTstTestIdFgnd: 0..4294967295, set at pre-compile  # This is the Id of this specific foreground test configuration. The value shall be used in the call to the API CorTst_Start(CorTst_TestIdFgndType TestId).
      container CorTstSelect  # This container specifies configuration parameters to select individual tests for foreground mode and background mode. The availability is hardware and implementation specific.
        boolean CorTstAddress: set at link in variant link-time / pre-compile in variant pre-compile, default-value=false  # Enable/Disables core address test.
        boolean CorTstAlu: set at link in variant link-time / pre-compile in variant pre-compile, default-value=false  # Enable/Disables core ALU test.
        boolean CorTstCache: set at link in variant link-time / pre-compile in variant pre-compile, default-value=false  # Enable/Disables core cache test.
        boolean CorTstInterrupt: set at link in variant link-time / pre-compile in variant pre-compile, default-value=false  # Enable/Disables core interrupt test
        boolean CorTstMemoryIf: set at link in variant link-time / pre-compile in variant pre-compile, default-value=false  # Enable/Disables core memory interface test
        boolean CorTstMpu: set at link in variant link-time / pre-compile in variant pre-compile, default-value=false  # Enable/Disables core MPU test
        boolean CorTstRegister: set at link in variant link-time / pre-compile in variant pre-compile, default-value=false  # Enable/Disables core register test
    container CorTstGeneral
      boolean CorTstDevErrorDetect: set at pre-compile, default-value=false  # Switch for enabling the development error detection.
      integer CorTstFgndTestNumber: 1..4294967295, set at pre-compile  # This parameter holds the number of test configurations available for the foreground tests as defined in this configuration.
      boolean CorTstNotificationSupported: set at pre-compile, default-value=true  # Switch to indicate that the notification is supported.
      integer CorTstTestIntervalIdEndValue [0..1]: 0..4294967295, set at pre-compile  # Defines the end value of the Test Interval Id.
      boolean CorTstTestResultMode: set at pre-compile, default-value=false  # Switch for enabling test result comparison within the Core test driver. In this mode a core test result OK or NOTOK shall not be calculated from the core test driver. Within core test driver no comparison against the reference value is processed.
  module definition Dio [0..1]: variants post-build/pre-compile  # Configuration of the Dio (Digital IO) module.
    container DioConfig: multiple-configuration-container=true  # This container contains the configuration parameters and sub containers of the AUTOSAR DIO module. This container is a MultipleConfigurationContainer, i.e. this container and its sub-containers exist once per configuration set.
      container DioPort [1..*]  # Configuration of individual DIO ports, consisting of channels and possible channel groups. | Note that this container definition does not explicitly define a symbolic name parameter. Instead, the container's short name will be used in the Ecu Configuration Description to specify the symbolic name of the port.
        integer DioPortId: 0..4294967295, set at post-build in variant post-build / pre-compile in variant pre-compile, symbolic-name-value=true  # Numeric identifier of the DIO port. Not all MCU ports may be used for DIO, thus there may be "gaps" in the list of all IDs. This value will be | assigned to the DIO port symbolic name (i.e. the SHORT-NAME of the DioPort container).
        container DioChannel [0..*]  # Configuration of an individual DIO channel.
          integer DioChannelId: 0..4294967295, set at post-build in variant post-build / pre-compile in variant pre-compile, symbolic-name-value=true  # Channel Id of the DIO channel. This value will be assigned to the symbolic names.
        container DioChannelGroup [0..*]  # Definition and configuration of DIO channel groups. A channel group represents several adjoining DIO channels represented by a logical group. | Note hat this container definition does not explicitly define a symbolic name parameter. Instead, the container's short name will be used in the Ecu Configuration Description to specify the symbolic name of the channel group.
          string DioChannelGroupIdentification: set at pre-compile, symbolic-name-value=true  # The DIO channel group is identified in DIO API by a pointer to a data structure (of type Dio_ChannelGroupType). That data structure contains the channel group information. | This parameter contains the code fragment that has to be inserted in the API call of the calling module to get the address of the variable in memory which holds the channel group information. Example values are "&MyDioGroup1" or "&MyDioGroupArray[0]"
          integer DioPortMask: 0..4294967295, set at post-build in variant post-build / pre-compile in variant pre-compile  # This shall be the mask which defines the positions of the channel | group. The channels shall consist of adjoining bits in the same port. The data type depends on the port width.
          integer DioPortOffset: 0..31, set at post-build in variant post-build / pre-compile in variant pre-compile  # The position of the Channel Group on the port, counted | from the LSB. This value can be derived from DioPortMask. calculationFormula = Position of the first bit of DioPortMask which is set to '1' counted from LSB
    container DioGeneral  # General DIO module configuration parameters.
      boolean DioDevErrorDetect: set at pre-compile  # Switches the Development Error Detection and Notification | ON or OFF
      boolean DioFlipChannelApi: set at pre-compile  # Adds / removes the service Dio_FlipChannel() from the code.
      boolean DioVersionInfoApi: set at pre-compile  # Adds / removes the service Dio_ GetVersionInfo() from the code.
  module definition Eth [0..*]: variants link-time/post-build/pre-compile  # Configuration of the Eth (Ethernet Driver) module.
    container EthConfigSet: multiple-configuration-container=true  # All included containers and parameters that may be part of a multiple configuration set.
      container EthCtrlConfig [1..*]  # Configuration of the individual controller
        boolean EthCtrlEnableMii: set at pre-compile  # Enables / Disables Media Independent Interface (MII) for transceiver access
        boolean EthCtrlEnableRxInterrupt: set at pre-compile  # Enables / Disables receive interrupt
        boolean EthCtrlEnableTxInterrupt: set at pre-compile  # Enables / Disables transmit interrupt
        integer EthCtrlIdx: 0..255, scope=ECU, set at link in variant link-time / post-build in variant post-build / pre-compile in variant pre-compile, symbolic-name-value=true  # Specifies the instance ID of the configured controller.
        string EthCtrlPhyAddress [0..1]: set at link in variant link-time / post-build in variant post-build / pre-compile in variant pre-compile, max-length=17, min-length=17  # Specifies the unique 48-bit physical address (MAC address) of the controller in network byte order. | Regular Expression: [0-9a-fA-F]{2}[[:-][0-9a-fA-F]{2}]{5}
        integer EthCtrlRxBufLenByte: 0..1522, set at link in variant link-time / post-build in variant post-build / pre-compile in variant pre-compile  # Limits the maximum receive buffer length (frame length) in bytes.
        integer EthCtrlTxBufLenByte: 0..1522, set at link in variant link-time / post-build in variant post-build / pre-compile in variant pre-compile  # Limits the maximum transmit buffer length (frame length) in bytes.
        integer EthRxBufTotal: 0..255, set at link in variant link-time / post-build in variant post-build / pre-compile in variant pre-compile  # Configures the number of receive buffers.
        integer EthTxBufTotal: 0..255, set at link in variant link-time / post-build in variant post-build / pre-compile in variant pre-compile  # Configures the number of transmit buffers.
        container EthDemEventParameterRefs [0..1]  # Container for the references to DemEventParameter elements which shall be invoked using the API Dem_ReportErrorStatus in case the corresponding error occurs. The EventId is taken from the referenced DemEventParameter's DemEventId value. The standardized errors are provided in the container and can be extended by vendor specific error references.
          symbolic name reference ETH_E_ACCESS [0..1]: set at link in variant link-time / post-build in variant post-build / pre-compile in variant pre-compile, destination=DemEventParameter  # Reference to the DemEventParameter which shall be issued when the error "Controller access failed" has occured.
    container EthGeneral  # General configuration of Ethernet Driver module
      boolean EthDevErrorDetect: set at pre-compile  # Enables / Disables development error detection.
      integer EthIndex: 0..255, set at pre-compile  # Specifies the InstanceId of this module instance. If only one instance is present it shall have the Id 0.
      integer EthMaxCtrlsSupported: 1..255, set at pre-compile  # Limits the total number of supported controllers.
      boolean EthUpdatePhysAddrFilter: set at pre-compile, default-value=false  # Enables/Disables optional API Eth_UpdatePhysAddrFilter.
      boolean EthVersionInfoApi: set at pre-compile  # Enables / Disables version info API
  module definition Fr [0..*]: variants post-build/pre-compile  # Configuration of the Fr (FlexRay driver) module.
    container FrGeneral  # General configuration (parameters) of the FlexRay Driver module.
      boolean FrBufferReconfig: set at pre-compile  # Enables or disables buffer reconfiguration at runtime.
      integer FrCtrlTestCount: 0..255, set at pre-compile, default-value=1  # Maxmimum number of iterations the FlexRay controller hardware test is performed during controller initialization.
      boolean FrDevErrorDetect: set at pre-compile  # Switches the Development Error Detection and Notification | on or off. true: Development Error Detection and Notification enabled. false: Development Error Detection and Notification disabled.
      integer FrIndex: 0..255, set at pre-compile  # Specifies the InstanceId of this module instance. If only one instance is present it shall have the Id 0.
      integer FrNumCtrlSupported: 1..256, set at pre-compile  # Determines the maximum number of communication controllers that the driver supports.
      boolean FrRxStringentCheck: set at pre-compile, default-value=false  # If stringent check is enabled (true), received frames are only | accepted if no slot status error occured.
      boolean FrRxStringentLengthCheck: set at pre-compile, default-value=false  # If stringent check is enabled (true), received frames are only | accepted the received payload length matches the configured payload length.
      boolean FrVersionInfoApi: set at pre-compile  # Enables/disables the existence of the Fr_GetVersionInfo API.
    container FrMultipleConfiguration: multiple-configuration-container=true  # Configuration of the individual controllers.
      container FrController [1..*]  # Configuration of the individual controller.
        integer FrCtrlIdx: 0..255, set at post-build in variant post-build / pre-compile in variant pre-compile, symbolic-name-value=true  # Determines index of CC within Fr.
        boolean FrPAllowHaltDueToClock: set at post-build in variant post-build / pre-compile in variant pre-compile  # Boolean flag that controls the transition to the POC:halt state due to a clock synchronization errors. If set to true, the CC is allowed to transition to POC:halt. If set to false, the CC will not transition to the POC:halt state but will enter or remain in the POC:normal passive state (self healing would still be possible)
        integer FrPAllowPassiveToActive: 0..31, set at post-build in variant post-build / pre-compile in variant pre-compile  # Number of consecutive even/odd cycle pairs that must have valid clock correction terms before the CC will be allowed to transition from the POC:normal passive state to POC:normal active state. If set to zero, the CC is not allowed to transition from POC:normal passive to POC:normal active
        enumeration FrPChannels: {FR_CHANNEL_A, FR_CHANNEL_AB, FR_CHANNEL_B}, set at post-build in variant post-build / pre-compile in variant pre-compile  # Channels to which the node is connected. | Implementation Type: Fr_ChannelType
        integer FrPClusterDriftDamping: 0..20, set at post-build in variant post-build / pre-compile in variant pre-compile  # Local cluster drift damping factor used for rate correction [Microticks]. | Remark: Upper limit 10 for FlexRay Protocol 3.0 compliance.
        integer FrPDecodingCorrection: 12..143, set at post-build in variant post-build / pre-compile in variant pre-compile  # Value used by the receiver to calculate the difference between primary time reference point and secondary time reference point [Microticks]. | Remark: Lower limit 14 for FlexRay Protocol 2.1 Rev. A compliance. Upper limit 136 for FlexRay Protocol 3.0 compliance.
        integer FrPDelayCompensationA: 0..211, set at post-build in variant post-build / pre-compile in variant pre-compile  # Value used to compensate for reception delays on the indicated channel. This covers assumed propagation delay up to cPropagationDelayMax for microticks in the range of 0.0125us to 0.05us [Microticks]. | Remark: Lower limit 4 for FlexRay Protocol 3.0 compliance. Remark: Upper limit 200 for FlexRay Protocol 2.1 Rev A compliance.
        integer FrPDelayCompensationB: 0..211, set at post-build in variant post-build / pre-compile in variant pre-compile  # Value used to compensate for reception delays on the indicated channel. This covers assumed propagation delay up to cPropagationDelayMax for microticks in the range of 0.0125us to 0.05us [Microticks]. | Remark: Lower limit 4 for FlexRay Protocol 3.0 compliance. Remark: Upper limit 200 for FlexRay Protocol 2.1 Rev A compliance.
        boolean FrPExternalSync: set at post-build in variant post-build / pre-compile in variant pre-compile  # Flag indicating whether the node is externally synchronized (operating as time gateway sink in an TT-E cluster) or locally synchronized. | If FrPExternalSync is set to 'true' then FrPTwoKeySlotMode must also be set to 'true'. Remarks: Set to 'false' for FlexRay Protocol 2.1 Rev. A compliance.
        boolean FrPFallBackInternal: set at post-build in variant post-build / pre-compile in variant pre-compile  # Flag indicating whether a time gateway sink node will switch to local clock operation when synchronization with the time gateway source node is lost (FrPFallBackInternal = true) or will instead go to POC:ready (FrPFallBackInternal =false). | Remarks: Set to 'false' for FlexRay Protocol 2.1 Rev. A compliance.
        integer FrPKeySlotId: 0..1023, set at post-build in variant post-build / pre-compile in variant pre-compile  # ID of the key slot, i.e., the slot used to transmit the startup frame, sync frame, or designated key slot frame. If this parameter is set to zero the node does not have a key slot. | For Fr3.0: if the value is not provided in System Description it shall be configured to 0. For Fr2.1: if the value is not provided in System Description it is driver implementation specific which value to configure.
        boolean FrPKeySlotOnlyEnabled: set at post-build in variant post-build / pre-compile in variant pre-compile  # Flag indicating whether or not the node shall enter key slot only mode following startup. | Remarks: This parameter maps to FlexRay Protocol 2.1 Rev. A parameter pSingleSlotEnabled.
        boolean FrPKeySlotUsedForStartup: set at post-build in variant post-build / pre-compile in variant pre-compile  # Flag indicating whether the key slot is used to transmit a startup frame. | If FrPKeySlotUsedForStartup is set to true then FrPKeySlotUsedForSync must also be set to true. If FrPTwoKeySlotMode is set to true then both FrPKeySlotUsedForSync and FrPKeySlotUsedForStartup must also be set to true.
        boolean FrPKeySlotUsedForSync: set at post-build in variant post-build / pre-compile in variant pre-compile  # Flag indicating whether the key slot is used to transmit a sync frame. | If FrPKeySlotUsedForStartup is set to true then FrPKeySlotUsedForSync must also be set to true. If FrPTwoKeySlotMode is set to true then both FrPKeySlotUsedForSync and FrPKeySlotUsedForStartup must also be set to true.
        integer FrPLatestTx: 0..7988, set at post-build in variant post-build / pre-compile in variant pre-compile  # Number of the last minislot in which a frame transmission can start in the dynamic segment. | Remark: Upper limit 7980 for FlexRay Protocol 2.1 Rev A compliance.
        integer FrPMacroInitialOffsetA: 2..68, set at post-build in variant post-build / pre-compile in variant pre-compile  # Integer number of macroticks between the static slot boundary and the following macrotick boundary of the secondary time reference point based on the nominal macrotick duration [Macroticks].
        integer FrPMacroInitialOffsetB: 2..68, set at post-build in variant post-build / pre-compile in variant pre-compile  # Integer number of macroticks between the static slot boundary and the following macrotick boundary of the secondary time reference point based on the nominal macrotick duration [Macroticks].
        integer FrPMicroInitialOffsetA: 0..239, set at post-build in variant post-build / pre-compile in variant pre-compile  # Number of microticks between the secondary time reference point | and the macrotick boundary immediately following the secondary time reference point. The parameter depends on FrPDelayCompensationA and therefore it has to be set independently for each channel [Microticks].
        integer FrPMicroInitialOffsetB: 0..239, set at post-build in variant post-build / pre-compile in variant pre-compile  # Number of microticks between the secondary time reference point | and the macrotick boundary immediately following the secondary time reference point. The parameter depends on FrPDelayCompensationB and therefore it has to be set independently for each channel [Microticks].
        integer FrPMicroPerCycle: 640..1280000, set at post-build in variant post-build / pre-compile in variant pre-compile  # Nominal number of microticks in the communication cycle of the local node. If nodes have different microtick durations this number will differ from node to node [Microticks]. | Remark: Lower limit 960 for FlexRay Protocol 3.0 compliance. Upper limit 640000 for FlexRay Protocol 2.1 Rev A compliance.
        boolean FrPNmVectorEarlyUpdate: set at post-build in variant post-build / pre-compile in variant pre-compile  # Flag indicating when the update of the Network Management Vector | in the CHI shall take place. If FrPNmVectorEarlyUpdate is set to false, the update shall take place after the NIT. If FrPNmVectorEarlyUpdate is set to true, the update shall take place after the end of the static segment. Remarks: Set to 'false' for FlexRay Protocol 2.1 Rev. A compliance.
        integer FrPOffsetCorrectionOut: 13..16082, set at post-build in variant post-build / pre-compile in variant pre-compile  # Magnitude of the maximum permissible offset correction value [Microticks]. Remark: Upper limit 15567 for FlexRay Protocol 2.1 Rev A compliance. Remark: Lower limit 15 for FlexRay Protocol 3.0 compliance.
        integer FrPOffsetCorrectionStart: 7..15999, set at post-build in variant post-build / pre-compile in variant pre-compile  # Start of the offset correction phase within the NIT, expressed as the number of macroticks from the start of cycle [Macroticks]. | Remark: This parameter maps to FlexRay Protocol 2.1 Rev. A parameter gOffsetCorrectionStart. Remark: Lower limit 9 for FlexRay Protocol 2.1 Rev A compliance.
        integer FrPPayloadLengthDynMax: 0..127, set at post-build in variant post-build / pre-compile in variant pre-compile  # Maximum payload length for dynamic frames [16 bit words].
        integer FrPRateCorrectionOut: 2..3846, set at post-build in variant post-build / pre-compile in variant pre-compile  # Magnitude of the maximum permissible rate correction value and the maximum drift offset between two nodes operating with unsynchronized clocks for one communication cycle [Microticks]. | Remarks: This parameter maps to FlexRay Protocol 2.1 Rev. A parameter pdMaxDrift. Lower limit 3 for FlexRay Protocol 3.0 compliance. Upper limit 1923 for FlexRay Protocol 2.1 Rev A compliance.
        enumeration FrPSamplesPerMicrotick: {N1SAMPLES, N2SAMPLES, N4SAMPLES}, set at post-build in variant post-build / pre-compile in variant pre-compile  # Number of samples per microtick. Remark: Allowed range N1SAMPLES, N2SAMPLES for FlexRay Protocol 3.0 compliance.
        integer FrPSecondKeySlotId: 0..1023, set at post-build in variant post-build / pre-compile in variant pre-compile  # ID of the second key slot, in which a second startup frame shall be sent when operating as a coldstart node in a TT-L or TT-D cluster. If this parameter is set to zero the node does not have a second key slot. | Remark: Set to 0 for FlexRay Protocol 2.1 Rev A compliance.
        boolean FrPTwoKeySlotMode: set at post-build in variant post-build / pre-compile in variant pre-compile  # Flag indicating whether node operates as a coldstart node in a TT-E or TT-L cluster. | If pTwoKeySlotMode is set to true then both pKeySlotUsedForSync and pKeySlotUsedForStartup must also be set to true. If pExternalSync is set to true then pTwoKeySlotMode must also be set to true. Remark: Set to false for FlexRay Protocol 2.1 Rev A compliance.
        enumeration FrPWakeupChannel: {FR_CHANNEL_A, FR_CHANNEL_B}, set at post-build in variant post-build / pre-compile in variant pre-compile  # Channel used by the node to send a wakeup pattern. | FrPWakeupChannel must be selected from among the channels configured by FrPChannels.
        integer FrPWakeupPattern: 0..63, set at post-build in variant post-build / pre-compile in variant pre-compile  # Number of repetitions of the wakeup symbol that are combined to form a wakeup pattern when the node enters the POC:wakeup send state. | Remark: Lower limit 2 for FlexRay Protocol 2.1 Rev A compliance.
        integer FrPdAcceptedStartupRange: 0..2743, set at post-build in variant post-build / pre-compile in variant pre-compile  # Expanded range of measured clock deviation allowed for startup frames during integration [Microticks]. | Remark: Upper limit 1875 for FlexRay Protocol 2.1 Rev A compliance. Remark: Lower limit 29 for FlexRay Protocol 3.0 compliance.
        integer FrPdListenTimeout: 1284..2567692, set at post-build in variant post-build / pre-compile in variant pre-compile  # Value for the startup listen timeout and wakeup listen timeout. Although this is a node local parameter, the real time equivalent of this value should be the same for all nodes in the cluster [Microticks]. | Remark: Lower limit 1926 for FlexRay Protocol 3.0 compliance. Upper limit 1283846 for FlexRay Protocol 2.1 Rev. A compliance.
        enumeration FrPdMicrotick: {T100NS, T12_5NS, T200NS, T25NS, T50NS}, set at post-build in variant post-build / pre-compile in variant pre-compile  # Duration of a microtick. | Remark: Allowed range T12_5NS, T25NS, T50NS for FlexRay Protocol 3.0 compliance.
        container FrAbsoluteTimer [1..*]  # Specifies the absolute timer configuration parameters of the Fr.
          integer FrAbsTimerIdx: 0..254, set at post-build in variant post-build / pre-compile in variant pre-compile, symbolic-name-value=true  # Contains the index of an absolute timer contained in Fr on a certain FlexRay CC.
        container FrControllerDemEventParameterRefs [0..1]  # Container for the references to DemEventParameter elements which shall be invoked using the API Dem_ReportErrorStatus API in case the corresponding error occurs. The EventId is taken from the referenced DemEventParameter's DemEventId value. The standardized errors are provided in the container and can be extended by vendor specific error references.
          symbolic name reference FrDemCtrlTestResultRef [0..1]: set at post-build in variant post-build / pre-compile in variant pre-compile, destination=DemEventParameter  # Reference to DEM event Id that is reported for FlexRay | controller hardware test failure. If this parameter is not configured, no event reporting happens.
        container FrFifo [0..*]  # One First In First Out (FIFO) queued receive structure, defining the admittance criteria to the FIFO, and mandating the ability to admit messages into the FIFO based on Message Id filtering criteria.
          boolean FrAdmitWithoutMessageId: set at post-build in variant post-build / pre-compile in variant pre-compile  # Determines whether or not frames received in the dynamic segment that don't contain a message ID will be admitted into the FIFO.
          integer FrBaseCycle: 0..63, set at post-build in variant post-build / pre-compile in variant pre-compile  # FIFO cycle counter acceptance criteria.
          enumeration FrChannels: {FR_CHANNEL_A, FR_CHANNEL_AB, FR_CHANNEL_B}, set at post-build in variant post-build / pre-compile in variant pre-compile  # FIFO channel admittance criteria.
          integer FrCycleRepetition: 1..64, set at post-build in variant post-build / pre-compile in variant pre-compile  # FIFO cycle counter acceptance criteria. Valid values are 1,2,4,5,8,10,16,20,32,40,50,64. | Remark: Values 1,2,4,8,16,32,64 are valid only for FlexRay Protocol 2.1 Rev A compliance.
          integer FrFifoDepth: 1..2048, set at post-build in variant post-build / pre-compile in variant pre-compile  # FrFifoDepth configures the maximum number of rx-frames which can be contained in the FIFO.
          integer FrMsgIdMask: 0..65535, set at post-build in variant post-build / pre-compile in variant pre-compile  # FIFO message identifier acceptance criteria (Mask filter).
          integer FrMsgIdMatch: 0..65535, set at post-build in variant post-build / pre-compile in variant pre-compile  # FIFO message identifier acceptance criteria (Match filter).
          container FrRange [1..*]  # FIFO Frame Id range acceptance criteria.
            integer FrRangeMax: 0..2047, set at post-build in variant post-build / pre-compile in variant pre-compile  # Last FrameId of this range that will be accepted by the FIFO.
            integer FrRangeMin: 0..2047, set at post-build in variant post-build / pre-compile in variant pre-compile  # First FrameId of this range that will be accepted by the FIFO.
  module definition Gpt [0..1]: variants post-build/pre-compile  # Configuration of the Gpt (General Purpose Timer) module.
    container GptChannelConfigSet: multiple-configuration-container=true  # This container is the base of a Configuration Set which contains the configured GPT channels. This way, different configuration sets can be defined for post-build process.
      container GptChannelConfiguration [1..*]  # Configuration of an individual GPT channel.
        integer GptChannelId: 0..4294967295, set at post-build in variant post-build / pre-compile in variant pre-compile, symbolic-name-value=true  # Channel Id of the GPT channel. This value will be assigned to the symbolic name derived of the GptChannelConfiguration container short name.
        enumeration GptChannelMode: {GPT_CH_MODE_CONTINUOUS, GPT_CH_MODE_ONESHOT}, set at post-build in variant post-build / pre-compile in variant pre-compile  # Specifies the behavior of the timer channel after the target time is reached.
        float GptChannelTickFrequency: 0..Inf, set at post-build in variant post-build / pre-compile in variant pre-compile  # Specifies the tick frequency of the timer channel in Hz.
        integer GptChannelTickValueMax: 0..18446744073709551615, set at post-build in variant post-build / pre-compile in variant pre-compile  # Maximum value in ticks, the timer channel is able to count. With the next tick, the timer rolls over to zero.
        boolean GptEnableWakeup: set at post-build in variant post-build / pre-compile in variant pre-compile  # Enables wakeup capability of MCU for a channel.
        function name GptNotification [0..1]: set at post-build in variant post-build / pre-compile in variant pre-compile  # Function pointer to callback function (for non-wakeup notification)
        reference GptChannelClkSrcRef: set at post-build in variant post-build / pre-compile in variant pre-compile, destination=GptClockReferencePoint  # Reference to the GptClockReferencePoint from which the channel | clock is derived.
        container GptWakeupConfiguration [0..1]  # Function pointer to callback function (for wakeup notification).
          symbolic name reference GptWakeupSourceRef: set at post-build in variant post-build / pre-compile in variant pre-compile, destination=EcuMWakeupSource  # In case the wakeup-capability is true this value is transmitted to the Ecu State Manager. | Implementation Type: reference to EcuM_WakeupSourceType
    container GptConfigurationOfOptApiServices  # This container contains all configuration switches for configuring optional API services of the GPT driver.
      boolean GptDeinitApi: set at pre-compile  # Adds / removes the service Gpt_DeInit() from the code.
      boolean GptEnableDisableNotificationApi: set at pre-compile  # Adds / removes the services Gpt_EnableNotification() and Gpt_DisableNotification from the code.
      boolean GptTimeElapsedApi: set at pre-compile  # Adds / removes the service Gpt_GetTimeElapsed() from the code
      boolean GptTimeRemainingApi: set at pre-compile  # Adds / removes the service Gpt_GetTimeRemaining() from the code.
      boolean GptVersionInfoApi: set at pre-compile  # Adds / removes the service Gpt_GetVersionInfo() from the code.
      boolean GptWakeupFunctionalityApi: set at pre-compile  # Adds / removes the services Gpt_SetMode(), Gpt_EnableWakeup() Gpt_DisableWakeup() and Gpt_CheckWakeup() from the code.
    container GptDriverConfiguration  # This container contains the module-wide configuration (parameters) of the GPT Driver
      boolean GptDevErrorDetect: set at pre-compile  # Enables/Disables development error detection.
      boolean GptReportWakeupSource: set at pre-compile  # Enables/Disables wakeup source reporting.
      boolean GptPredefTimer100us32bitEnable: scope=ECU, set at pre-compile  # Enables/disables the GPT Predef Timer 100µs32bit.
      enumeration GptPredefTimer1usEnablingGrade: {GPT_PREDEF_TIMER_1US_16BIT_ENABLED, GPT_PREDEF_TIMER_1US_16_24BIT_ENABLED, GPT_PREDEF_TIMER_1US_16_24_32BIT_ENABLED, GPT_PREDEF_TIMER_1US_DISABLED}, scope=ECU, set at pre-compile  # Specifies the grade of enabling the GPT Predef Timers with 1µs tick duration.
      container GptClockReferencePoint [1..*]  # This container contains a parameter, which represents a reference to a container of the type McuClockReferencePoint (defined in module MCU). | A container is needed to support multiple clock references (hardware dependent).
        reference GptClockReference: set at pre-compile, destination=McuClockReferencePoint  # Reference to a container of the type McuClockReferencePoint, to select an input clock. | The configuration editor for the GPT module can support the integrator by only allowing a selection of those clock reference points that can be connected physically to the GPT hardware peripheral. The desired frequency (desired by GPT) has to be the same as the selected and provided frequency of the MCU configuration. This has to be checked automatically.
  module definition Icu [0..*]: variants post-build/pre-compile  # Configuration of the Icu (Input Capture Unit) module.
    container IcuConfigSet: multiple-configuration-container=true  # This container is the base for a multiple configuration set
      integer IcuMaxChannel: 0..65535, set at post-build in variant post-build / pre-compile in variant pre-compile  # This parameter contains the number of Channels configured. It will be gathered by tools during the configuration stage. | calculationFormula = Number of configured Icu Channels Implementation Type: Icu_ChannelType
      container IcuChannel [1..*]  # Configuration of an individual ICU channel.
        integer IcuChannelId: 0..65535, scope=ECU, set at post-build in variant post-build / pre-compile in variant pre-compile, symbolic-name-value=true  # Channel Id of the ICU channel. This value will be assigned to the symbolic name derived of the IcuChannel container short name.
        enumeration IcuDefaultStartEdge: {ICU_BOTH_EDGES, ICU_FALLING_EDGE, ICU_RISING_EDGE}, set at post-build in variant post-build / pre-compile in variant pre-compile  # Configures the default-activation-edge which shall be used for this channel if there was no activation-edge configured by the call of service Icu_SetActivationCondition(). | In case the Measurement Mode is "IcuSignalMeasurement" and the properties "DutyCycle" or "Period" are set, the edge configured here is used as Default Period Start Edge. Implementation Type: Icu_ActivationType
        enumeration IcuMeasurementMode: {ICU_MODE_EDGE_COUNTER, ICU_MODE_SIGNAL_EDGE_DETECT, ICU_MODE_SIGNAL_MEASUREMENT, ICU_MODE_TIMESTAMP}, set at post-build in variant post-build / pre-compile in variant pre-compile  # Configures the measurement mode of this channel. | Implementation Type: Icu_MeasurementModeType
        boolean IcuWakeupCapability: set at post-build in variant post-build / pre-compile in variant pre-compile  # Information about the wakeup-capability of this channel. | true: Channel is wakeup capable. false: Channel is not wakeup capable.
        container IcuSignalEdgeDetection [0..1]  # This container contains the configuration (parameters) in case the measurement mode is "IcuSignalEdgeDetection"
          function name IcuSignalNotification [0..1]: set at post-build in variant post-build / pre-compile in variant pre-compile  # Notification function for signal notification.
        container IcuSignalMeasurement [0..1]  # This container contains the configuration (parameters) in case the measurement mode is "IcuSignalMeasurement"
          enumeration IcuSignalMeasurementProperty: {ICU_DUTY_CYCLE, ICU_HIGH_TIME, ICU_LOW_TIME, ICU_PERIOD_TIME}, set at post-build in variant post-build / pre-compile in variant pre-compile  # Configures the property that could be measured in case the mode is "IcuSignalMeasurement". | This property can not be changed during runtime. Implementation Type: Icu_SignalMeasurementPropertyType
        container IcuTimestampMeasurement [0..1]  # This container contains the configuration (parameters) in case the measurement mode is "IcuTimestamp"
          enumeration IcuTimestampMeasurementProperty: {ICU_CIRCULAR_BUFFER, ICU_LINEAR_BUFFER}, set at post-build in variant post-build / pre-compile in variant pre-compile  # Configures the handling of the buffer in case the mode is "Timestamp" | Implementation Type: Icu_TimestampBufferType
          function name IcuTimestampNotification [0..1]: set at post-build in variant post-build / pre-compile in variant pre-compile  # Notification function if the number of requested timestamps | (Notification interval > 0) are acquired.
        container IcuWakeup [0..1]  # This container contains the configuration (parameters) needed to configure a wakeup capable channel
          symbolic name reference IcuChannelWakeupInfo [0..1]: set at post-build in variant post-build / pre-compile in variant pre-compile, destination=EcuMWakeupSource  # If the wakeup-capability is true the wakeup source referenced is transmitted to the ECU State Manager (EcuM) . | Implementation Type: reference to EcuM_WakeupSourceType
    container IcuGeneral  # Configuration of general ICU parameters.
      boolean IcuDevErrorDetect: set at pre-compile  # Switches the Development Error Detection and Notification | on or off. true: Enabled. false: Disabled.
      integer IcuIndex: 0..255, set at pre-compile  # Specifies the InstanceId of this module instance. If only one instance is present it shall have the Id 0.
      boolean IcuReportWakeupSource: set at pre-compile  # Switch for enabling Wakeup source reporting. | true: Report Wakeup source. false: Do not report Wakeup source.
    container IcuOptionalApis  # This container contains all configuration switches for configuring optional API services of the ICU driver.
      boolean IcuDeInitApi: set at pre-compile  # Adds / removes the service Icu_DeInit() from the code. | true: Icu_DeInit() can be used. false: Icu_DeInit() can not be used.
      boolean IcuDisableWakeupApi: set at pre-compile  # Adds / removes the service Icu_DisableWakeup() from the code. | true: Icu_DisableWakeup() can be used. false: Icu_DisableWakeup() can not be used.
      boolean IcuEdgeCountApi: set at pre-compile  # Adds / removes all services related to the edge counting functionality as listed below, from the code: Icu_ResetEdgeCount(), Icu_EnableEdgeCount(), Icu_DisableEdgeCount(), Icu_GetEdgeNumbers(). | true: The services listed above can be used. false: The services listed above can not be used.
      boolean IcuEdgeDetectApi: set at pre-compile  # Adds / removes the services related to the edge detection functionality, from the code: | Icu_EnableEdgeDetection() and Icu_DisableEdgeDetection(). true: These services can be used. false: These services can not be used.
      boolean IcuEnableWakeupApi: set at pre-compile  # Adds / removes the service Icu_EnableWakeup() from the code. | true: Icu_EnableWakeup() can be used. false: Icu_EnableWakeup() can not be used.
      boolean IcuGetDutyCycleValuesApi: set at pre-compile  # Adds / removes the service Icu_GetDutyCycleValues() from the code. | true: Icu_GetDutyCycleValues() can be used. false: Icu_GetDutyCycleValues() can not be used.
      boolean IcuGetInputStateApi: set at pre-compile  # Adds / removes the service Icu_GetInputState() from the code. | true: Icu_GetInputState() can be used. false: Icu_GetInputState() can not be used.
      boolean IcuGetTimeElapsedApi: set at pre-compile  # Adds / removes the service Icu_GetTimeElapsed() from the code. | true: Icu_GetTimeElapsed() can be used. false: Icu_GetTimeElapsed() can not be used.
      boolean IcuGetVersionInfoApi: set at pre-compile  # Adds / removes the service Icu_GetVersionInfo() from the code. | true: Icu_GetVersionInfo() can be used. false: Icu_GetVersionInfo() can not be used.
      boolean IcuSetModeApi: set at pre-compile  # Adds / removes the service Icu_SetMode() from the code. | true: Icu_SetMode() can be used. false: Icu_SetMode() can not be used.
      boolean IcuSignalMeasurementApi: set at pre-compile  # Adds / removes the services Icu_StartSignalMeasurement() and Icu_StopSignalMeasurement() from the code. | true: Icu_StartSignalMeasurement() and Icu_StopSignalMeasurement() can be used. false: Icu_StartSignalMeasurement() and Icu_StopSignalMeasurement() can not be used.
      boolean IcuTimestampApi: set at pre-compile  # Adds / removes all services related to the timestamping functionality as listed below from the code: Icu_StartTimestamp(), Icu_StopTimestamp(), Icu_GetTimestampIndex(). | true: The services listed above can be used. false: The services listed above can not be used.
      boolean IcuWakeupFunctionalityApi: set at pre-compile  # Adds / removes the service Icu_CheckWakeup() from the code. | true: Icu_CheckWakeup() can be used. false: Icu_CheckWakeup() cannot be used.
  module definition Ocu [0..1]: variants post-build/pre-compile  # Configuration of Ocu (Output Compare Unit) module.
    container OcuConfigSet: multiple-configuration-container=true  # This container is the base of a Configuration Set, which contains the configured OCU channels. This way, different configuration sets can be defined for post-build process.
      enumeration OcuCountdirection [0..1]: {OCU_DOWNCOUNTING, OCU_UPCOUNTING}, set at post-build in variant post-build / pre-compile in variant pre-compile, default-value=OCU_UPCOUNTING  # This parameter indicates the count direction for the whole OCU driver.
      container OcuChannel [1..*]  # Configuration of an individual OCU channel.
        integer OcuAssignedHardwareChannel: 0..255, set at post-build in variant post-build / pre-compile in variant pre-compile  # The physical hardware channel that is assigned to this logical channel.
        integer OcuChannelId: 0..65535, set at post-build in variant post-build / pre-compile in variant pre-compile, symbolic-name-value=true  # Channel Id of the OCU channel. This value will be assigned to the symbolic name derived from the OcuChannel container short name. It defines the assignment of the channel to the physical OCU hardware channel.
        integer OcuChannelTickDuration: 1..32768, set at post-build in variant post-build / pre-compile in variant pre-compile  # Specifies the tick duration of the counter of the channel. This parameter is the number of the input clock edges (rising edges or falling edges exclusively) counted each time to increase the counter by one unit. | The value range depends from the used HW, not all allowed values may be relevant.
        integer OcuDefaultThreshold: 0..4294967295, set at post-build in variant post-build / pre-compile in variant pre-compile  # Value of comparison threshold used for Initialization.
        integer OcuHardwareTriggeredAdc [0..1]: 0..255, set at post-build in variant post-build / pre-compile in variant pre-compile, default-value=0  # This parameter is used to allow the OCU channel to trigger an ADC channel upon compare match, if this is supported by hardware. The value of the parameter represents the ADC physical channel to trigger.
        integer OcuHardwareTriggeredDMA [0..1]: 0..255, set at post-build in variant post-build / pre-compile in variant pre-compile, default-value=0  # This parameter is used to allow the OCU channel to trigger a DMA channel upon compare match, if this is supported by hardware. The value of the parameter represents the DMA physical channel to trigger.
        integer OcuMaxCounterValue: 1..4294967295, set at post-build in variant post-build / pre-compile in variant pre-compile  # Maximum value in ticks, the counter of the OCU channel is able to count.
        function name OcuNotification [0..1]: set at post-build in variant post-build / pre-compile in variant pre-compile  # Definition of a function pointer to a Callback function.
        boolean OcuOuptutPinUsed: set at pre-compile  # Information about the usage of an output pin on this channel. | True: the channel uses an output pin. False: the channel does not use an output pin.
        enumeration OcuOutputPinDefaultState [0..1]: {OCU_HIGH, OCU_LOW}, set at post-build in variant post-build / pre-compile in variant pre-compile  # The parameter OcuOutputPinDefaultState represents the state that a pin associated with a channel shall be set to after initialisation.
      container OcuGroup [0..*]  # This container contains the parameters for configuring an OCU group.
        integer OcuGroupId: 0..65535, set at post-build in variant post-build / pre-compile in variant pre-compile, symbolic-name-value=true  # Numeric ID of the group. This parameter is the symbolic name of the group.
        reference OcuGroupDefinition [1..*]: set at post-build in variant post-build / pre-compile in variant pre-compile, destination=OcuChannel  # Assignment of OcuChannels to an OcuGroup.
      container OcuHWSpecificSettings [0..1]  # This container contains Ocu-specific parameters for selecting the clock source and setting optional prescalers if supported by hardware. | Implementation is defined vendor specific.
        enumeration OcuClockSource [0..1]: set at post-build in variant post-build / pre-compile in variant pre-compile  # The OCU driver specific clock input for the unit can statically be configured to select different clock sources if provided by hardware. Enumeration literals are defined vendor specific.
        enumeration OcuPrescale [0..1]: set at post-build in variant post-build / pre-compile in variant pre-compile  # Optional OCU driver specific clock prescale factor, if supported by hardware. Implementation is defined vendor specific.
    container OcuConfigurationOfOptionalApis  # Configuration of optional APIs.
      boolean OcuDeInitApi: set at pre-compile  # Adds / removes the service Ocu_DeInit() from the code.
      boolean OcuGetCounterApi: set at pre-compile  # Adds / removes the service Ocu_GetCounter() from the code.
      boolean OcuNotificationSupported: set at pre-compile  # Adds / removes the services Ocu_EnableNotification() and Ocu_DisableNotification() from the code.
      boolean OcuSetAbsoluteThresholdApi: set at pre-compile  # Adds / removes the service Ocu_SetAbsoluteThreshold() from the code.
      boolean OcuSetPinActionApi: set at pre-compile  # Adds / removes the service Ocu_SetPinAction() from the code.
      boolean OcuSetPinStateApi: set at pre-compile  # Adds / removes the service Ocu_SetPinState() from the code.
      boolean OcuSetRelativeThresholdApi: set at pre-compile  # Adds / removes the service Ocu_SetRelativeThreshold() from the code.
      boolean OcuVersionInfoApi: set at pre-compile  # Switch to indicate that the Ocu_GetVersionInfo() is supported.
    container OcuGeneral  # This container contains the module-wide configuration parameters of the OCU Driver.
      boolean OcuDevErrorDetect: set at pre-compile, default-value=false  # Switch for enabling the development error detection.
  module definition RamTst [0..1]: variants link-time/pre-compile  # Configuration of the RamTst module.
    container RamTstCommon  # This container holds a list of all available functions in the RamTst module. Each function is turned ON or OFF before compiling so that only the desired functions and test algorithms are in the compiled code.
      boolean RamTstAllowApi: set at pre-compile  # Preprocessor switch to disable / enable the function "RamTst_Allow".
      boolean RamTstChangeNumOfTestedCellsApi: set at pre-compile  # Preprocessor switch to disable / enable the function "RamTst_ChangeNumberOfTestedCells".
      boolean RamTstDevErrorDetect: set at pre-compile  # Preprocessor switch to select the development error tracer (DET) | ON or OFF
      boolean RamTstGetAlgParamsApi: set at pre-compile  # Preprocessor switch to disable / enable the function "RamTst_GetAlgParams".
      boolean RamTstGetExecutionStatusApi: set at pre-compile  # Preprocessor switch to disable / enable the function | "RamTst_GetExecutionStatus"
      boolean RamTstGetNumberOfTestedCellsApi: set at pre-compile  # Preprocessor switch to disable / enable the function "RamTst_GetNumberOfTestedCells".
      boolean RamTstGetTestAlgorithmApi: set at pre-compile  # Preprocessor switch to disable / enable the function | "RamTst_GetTestAlgorithm"
      boolean RamTstGetTestResultApi: set at pre-compile  # Preprocessor switch to disable / enable the function | "RamTst_GetTestResult"
      boolean RamTstGetTestResultPerBlockApi: set at pre-compile  # Preprocessor switch to disable / enable the function | "RamTst_GetTestResultPerBlock"
      boolean RamTstGetVersionInfoApi: set at pre-compile  # Preprocessor switch to disable / enable the function | "RamTst_GetVersionInfo"
      boolean RamTstResumeApi: set at pre-compile  # Preprocessor switch to disable / enable the function "RamTst_Resume".
      boolean RamTstRunFullTestApi: set at pre-compile  # Preprocessor switch to disable / enable the function | "RamTst_RunFullTest"
      boolean RamTstRunPartialTestApi: set at pre-compile  # Preprocessor switch to disable / enable the function | "RamTst_RunPartialTest"
      boolean RamTstSelectAlgParamsApi: set at pre-compile  # Preprocessor switch to disable / enable the function "RamTst_SelectAlgParams".
      boolean RamTstStopApi: set at pre-compile  # Preprocessor switch to disable / enable the function | "RamTst_Stop"
      boolean RamTstSuspendApi: set at pre-compile  # Preprocessor switch to disable / enable the function "RamTst_Suspend".
      container RamTstAlgorithms  # This container holds all of the available test algorithms for the specific microcontroller. Each test algorithm is selected ON or OFF before compiling so that only the desired test algorithms are in the compiled code.
        boolean RamTstAbrahamTestSelected: set at pre-compile  # Preprocessor switch to select the Abraham Test ON or OFF
        boolean RamTstCheckerboardTestSelected: set at pre-compile  # Preprocessor switch to select the Checkerboard Test ON or OFF
        boolean RamTstGalpatTestSelected: set at pre-compile  # Preprocessor switch to select the Galpat Test ON or OFF
        boolean RamTstMarchTestSelected: set at pre-compile  # Preprocessor switch to select the March Test ON or OFF
        boolean RamTstTranspGalpatTestSelected: set at pre-compile  # Preprocessor switch to select the Transparent Galpat Test ON or OFF
        boolean RamTstWalkPathTestSelected: set at pre-compile  # Preprocessor switch to select the Walking Path Test ON or OFF
      container RamTstConfigParams  # This container specifies configuration parameters which are set at pre-compile or link time.
        integer RamTstDefaultAlgParamsId: 1..255, set at link in variant link-time / pre-compile in variant pre-compile  # This is the identifier for the default "RamTstAlgParams" valid after the "RamTst_Init(..)" function. It is the initial value for a RAM variable which could be changed by the function "RamTst_SelectAlgParams".
        integer RamTstMinNumberOfTestedCells: 1..4294967295, set at link in variant link-time / pre-compile in variant pre-compile  # Minimum number of tested cells for one cycle of a background test, as defined by implementer.
        integer RamTstNumberOfAlgParamSets: 1..255, set at link in variant link-time / pre-compile in variant pre-compile  # Number of configured parameter sets for the available test algorithms. | calculationFormula = count of the container RamTst_AlgParams
        function name RamTstTestCompletedNotification: set at link in variant link-time / pre-compile in variant pre-compile  # This function will be called from a background test after finishing the RAM test without an error.
        function name RamTstTestErrorNotification: set at link in variant link-time / pre-compile in variant pre-compile  # This function will be called from a background test if an error occurs during the RAM test.
        container RamTstAlgParams [1..255]  # This container holds parameters for configuring an algorithm. For each algorithm selected in the RamTst_Algorithms container there can be one or more RamTstAlgParams containers. The multiplicity of the included container RamTstBlockParams depends on the number of separate blocks of RAM which are defined for the particular test configuration.
          integer RamTstAlgParamsId: 1..255, set at link in variant link-time / pre-compile in variant pre-compile  # This is the identifier by which this RamTstAlgParams set can be selected.
          enumeration RamTstAlgorithm: {RAMTST_ABRAHAM_TEST, RAMTST_CHECKERBOARD_TEST, RAMTST_GALPAT_TEST, RAMTST_MARCH_TEST, RAMTST_TRANSP_GALPAT_TEST, RAMTST_WALK_PATH_TEST}, set at link in variant link-time / pre-compile in variant pre-compile  # This is the algorithm for which this RamTstAlgParams set is defined. Note that the same algorithm can be used in more than one RamTstAlgParams. | Constraint: Only the algorithms selected by RamTstCommon/ RamTstAlgorithms can be used.
          integer RamTstExtNumberOfTestedCells: 1..4294967295, set at link in variant link-time / pre-compile in variant pre-compile  # This is the absolute maximum value for the number of cells that NUMBER_OF_TESTED_CELLS and MAX_NUMBER_OF_TESTED_CELLS can be.
          integer RamTstMaxNumberOfTestedCells: 1..4294967295, set at link in variant link-time / pre-compile in variant pre-compile  # This is the maximum value for the number of cells that can be tested in one cycle of a background test.
          integer RamTstNumberOfBlocks: 1..65535, set at link in variant link-time / pre-compile in variant pre-compile  # Number of RAM blocks configured using the container | "RamTst_BlockParams" calculationFormula = Count of RamTstBlockParams contained in this RamTstAlgParams.
          integer RamTstNumberOfTestedCells: 1..4294967295, set at link in variant link-time / pre-compile in variant pre-compile  # This is the initial value for a RAM variable, which can be changed by the function "RamTst_ChangeNumberOfTestedCells"
          container RamTstBlockParams [1..65535]  # This container holds the description for one block of RAM. For each RAM block to be tested by a given algorithm, there is one container which describes the block. Multiple instances of this container are included in each container RamTst_AlgParams.
            integer RamTstBlockId: 1..65535, set at link in variant link-time / pre-compile in variant pre-compile  # ID of the RAM block
            integer RamTstEndAddress: 1..4294967295, set at link in variant link-time / pre-compile in variant pre-compile  # End Address of the RAM block. | Constraint: It must be larger than the RamTstStartAddress.
            integer RamTstFillPattern: 0..4294967295, set at link in variant link-time / pre-compile in variant pre-compile  # Pattern to be filled into each memory cell after destructive test of this block.
            integer RamTstStartAddress: 0..4294967295, set at link in variant link-time / pre-compile in variant pre-compile  # Start Address of the RAM block. | Constraint: It must be smaller than the RamTstEndAddress.
            enumeration RamTstTestPolicy: {RAMTEST_DESTRUCTIVE, RAMTEST_NON_DESTRUCTIVE}, set at link in variant link-time / pre-compile in variant pre-compile  # Policy regarding destruction or non-destruction of memory content.
    container RamTstDemEventParameterRefs [0..1]  # Container for the references to DemEventParameter elements which shall be invoked using the API Dem_ReportErrorStatus in case the corresponding error occurs. The EventId is taken from the referenced DemEventParameter's DemEventId value. | The standardized errors are provided in the container and can be extended by vendor-specific error references.
      symbolic name reference RAMTST_E_RAM_FAILURE [0..1]: set at pre-compile, destination=DemEventParameter  # Reference to the DemEventParameter which shall be issued when the error "RAM failure" has occurred.
    container RamTstPublishedInformation  # Container holding all RamTst specific published information parameter.
      integer RamTstCellSize: 1..64, set at published-information  # Size of RAM cells (in bits) which can be tested individually by the given implementation.
  module definition Wdg [0..*]: variants link-time/post-build/pre-compile  # Configuration of the Wdg (Watchdog driver) module.
    container WdgDemEventParameterRefs [0..1]  # Container for the references to DemEventParameter elements which shall be invoked using the API Dem_ReportErrorStatus in case the corresponding error occurs. The EventId is taken from the referenced DemEventParameter's DemEventId value. | The standardized errors are provided in the container and can be extended by vendor-specific error references.
      symbolic name reference WDG_E_DISABLE_REJECTED [0..1]: set at pre-compile, destination=DemEventParameter  # Reference to the DemEventParameter which shall be issued when the error "Initialization or mode switch failed because it would disable the watchdog" has occurred.
      symbolic name reference WDG_E_MODE_FAILED [0..1]: set at pre-compile, destination=DemEventParameter  # Reference to the DemEventParameter which shall be issued when the error "Setting a watchdog mode failed (during initialization or mode switch)" has occurred.
    container WdgGeneral  # All general parameters of the watchdog driver are collected here.
      boolean WdgDevErrorDetect: set at pre-compile  # Compile switch to enable / disable development error detection for this module. | True: Development error detection enabled False: Development error detection disabled
      boolean WdgDisableAllowed: set at pre-compile  # Compile switch to allow / forbid disabling the watchdog driver during runtime. | True: Disabling the watchdog driver at runtime is allowed. False: Disabling the watchdog driver at runtime is not allowed.
      integer WdgIndex: 0..255, set at pre-compile, symbolic-name-value=true  # Represents the watchdog driver's ID so that it can be referenced by the watchdog interface.
      float WdgInitialTimeout: 0..65.535, set at pre-compile  # The initial timeout (sec) for the trigger condition to be initialized during Init function. It shall be not larger than WdgMaxTimeout.
      float WdgMaxTimeout: 0..65.535, set at pre-compile  # The maximum timeout (sec) to which the watchdog trigger condition can be initialized.
      enumeration WdgRunArea: {RAM, ROM}, set at pre-compile  # Represents the watchdog driver execution area is either from ROM(Flash) or RAM as required with the particular microcontroller.
      function name WdgTriggerLocation: set at pre-compile  # Location (memory address) of the watchdog trigger routine.
      boolean WdgVersionInfoApi: set at pre-compile  # Compile switch to enable / disable the version information API | * True: API enabled * False: API disabled
    container WdgPublishedInformation  # Container holding all Wdg specific published information parameters
      enumeration WdgTriggerMode: {WDG_BOTH, WDG_TOGGLE, WDG_WINDOW}, set at published-information  # Watchdog trigger mode (toggle/window/both)
    container WdgSettingsConfig: multiple-configuration-container=true  # Configuration items for the different watchdog settings, including those for external watchdog hardware. | Note: All postbuild parameters are handled via this container.
      enumeration WdgDefaultMode: {WDGIF_FAST_MODE, WDGIF_OFF_MODE, WDGIF_SLOW_MODE}, set at link in variant link-time / post-build in variant post-build / pre-compile in variant pre-compile  # Default mode for watchdog driver initialization. | ImplementationType: WdgIf_ModeType
      container WdgExternalConfiguration [0..1]  # Configuration items for an external watchdog hardware
        choice reference WdgExternalContainerRef [0..1]: set at link in variant link-time / post-build in variant post-build / pre-compile in variant pre-compile, destination=[DioChannelGroup, SpiSequence]  # Reference to either | - a DioChannelGroup container in case the hardware watchdog is connected via DIO pins - an SpiSequenceConfiguration container in case the watchdog hardware is accessed via SPI
      container WdgSettingsFast  # Hardware dependent settings for the watchdog driver's "fast" mode.
      container WdgSettingsOff  # Hardware dependent settings for the watchdog driver's "off" mode.
      container WdgSettingsSlow  # Hardware dependent settings for the watchdog driver's "slow" mode.
  module definition Eep [0..*]: variants post-build/pre-compile  # Configuration of the Eep (internal or external EEPROM driver) module. | Its multiplicity describes the number of EEPROM drivers present, so there will be one container for each EEPROM driver in the ECUC template. When no EEPROM driver is present then the multiplicity is 0.
    container EepGeneral  # Container for general configuration parameters of the EEPROM driver. These parameters are always pre-compile.
      boolean EepDevErrorDetect: set at pre-compile, default-value=true  # Pre-processor switch to enable and disable development error detection. | true: Development error detection enabled. false: Development error detection disabled.
      integer EepDriverIndex: 0..254, scope=ECU, set at pre-compile, symbolic-name-value=true  # Index of the driver, used by EA.
      boolean EepUseInterrupts: set at pre-compile, default-value=false  # Switches to activate or deactivate interrupt controlled job processing. | true: Interrupt controlled job processing enabled. false: Interrupt controlled job processing disabled.
      boolean EepVersionInfoApi: set at pre-compile, default-value=false  # Pre-processor switch to enable / disable the API to read out the modules version information. | true: Version info API enabled. false: Version info API disabled.
      boolean EepWriteCycleReduction: set at pre-compile, default-value=false  # Switches to activate or deactivate write cycle reduction (EEPROM value is read and compared before being overwritten). | true: Write cycle reduction enabled. false: Write cycle reduction disabled.
    container EepInitConfiguration: multiple-configuration-container=true  # Container for runtime configuration parameters of the EEPROM driver. | Implementation Type: Eep_ConfigType.
      integer EepBaseAddress: 0..4294967295, set at post-build in variant post-build / pre-compile in variant pre-compile  # This parameter is the EEPROM device base address. | Implementation Type: Eep_AddressType.
      enumeration EepDefaultMode: {MEMIF_MODE_FAST, MEMIF_MODE_SLOW}, set at post-build in variant post-build / pre-compile in variant pre-compile, default-value=MEMIF_MODE_SLOW  # This parameter is the default EEPROM device mode after initialization. | Implementation Type: MemIf_ModeType.
      integer EepFastReadBlockSize: 0..4294967295, set at post-build in variant post-build / pre-compile in variant pre-compile  # Number of bytes read within one job processing cycle in fast mode. If the hardware does not support burst mode this parameter shall be set to the same value as EepNormalReadBlockSize. | Implementation Type: Eep_LengthType.
      integer EepFastWriteBlockSize: 0..4294967295, set at post-build in variant post-build / pre-compile in variant pre-compile  # Number of bytes written within one job processing cycle in fast mode. If the hardware does not support burst mode this parameter shall be set to the same value as EepNormalWriteBlockSize. | Implementation Type: Eep_LengthType.
      float EepJobCallCycle [0..1]: 0..Inf, set at post-build in variant post-build / pre-compile in variant pre-compile  # Call cycle time of the EEPROM driver's main function. Unit: [s]
      function name EepJobEndNotification [0..1]: set at post-build in variant post-build / pre-compile in variant pre-compile  # This parameter is a reference to a callback function for positive job result (see EEP045).
      function name EepJobErrorNotification [0..1]: set at post-build in variant post-build / pre-compile in variant pre-compile  # This parameter is a reference to a callback function for negative job result (see EEP046).
      integer EepNormalReadBlockSize: 0..4294967295, set at post-build in variant post-build / pre-compile in variant pre-compile  # Number of bytes read within one job processing cycle in normal mode. | Implementation Type: Eep_LengthType.
      integer EepNormalWriteBlockSize: 0..4294967295, set at post-build in variant post-build / pre-compile in variant pre-compile  # Number of bytes written within one job processing cycle in normal mode. | Implementation Type: Eep_LengthType.
      integer EepSize: 0..4294967295, set at post-build in variant post-build / pre-compile in variant pre-compile  # This parameter is the used size of EEPROM device in bytes. | Implementation Type: Eep_LengthType.
      container EepDemEventParameterRefs [0..1]  # Container for the references to DemEventParameter elements which shall be invoked using the API Dem_ReportErrorStatus API in case the corresponding error occurs. The EventId is taken from the referenced DemEventParameter's DemEventId value. The standardized errors are provided in the container and can be extended by vendor specific error references.
        symbolic name reference EEP_E_COMPARE_FAILED [0..1]: set at post-build in variant post-build / pre-compile in variant pre-compile, destination=DemEventParameter  # Reference to the DemEventParameter which shall be issued when the error "EEPROM compare failed (HW)" has occurred.
        symbolic name reference EEP_E_ERASE_FAILED [0..1]: set at post-build in variant post-build / pre-compile in variant pre-compile, destination=DemEventParameter  # Reference to the DemEventParameter which shall be issued when the error "EEPROM erase failed (HW)" has occurred.
        symbolic name reference EEP_E_READ_FAILED [0..1]: set at post-build in variant post-build / pre-compile in variant pre-compile, destination=DemEventParameter  # Reference to the DemEventParameter which shall be issued when the error "EEPROM read failed (HW)" has occurred.
        symbolic name reference EEP_E_WRITE_FAILED [0..1]: set at post-build in variant post-build / pre-compile in variant pre-compile, destination=DemEventParameter  # Reference to the DemEventParameter which shall be issued when the error "EEPROM write failed (HW)" has occurred.
      container EepExternalDriver [0..1]  # This container is present for external EEPROM drivers only. Internal EEPROM drivers do not use the parameter listed in this container, hence its multiplicity is 0 for internal drivers.
        symbolic name reference EepSpiReference [1..*]: set at post-build in variant post-build / pre-compile in variant pre-compile, destination=SpiSequence  # Reference to SPI sequence (required for external EEPROM drivers).
    container EepPublishedInformation  # Additional published parameters not covered by CommonPublishedInformation container. | Note that these parameters do not have any configuration class setting, since they are published information.
      integer EepAllowedWriteCycles: 0..4294967295, set at published-information  # Specified maximum number of write cycles under worst case conditions of specific EEPROM hardware (e.g. +90°C)
      float EepEraseTime: 0..Inf, set at published-information  # Maximum time for erasing one EEPROM data unit.
      integer EepEraseUnitSize: 0..4294967295, set at published-information  # Size of smallest erasable EEPROM data unit in bytes.
      integer EepEraseValue: 0..255, set at published-information  # Value of an erased EEPROM cell.
      integer EepMinimumAddressType: 0..4294967295, set at published-information  # Minimum expected size of Eep_AddressType.
      integer EepMinimumLengthType: 0..4294967295, set at published-information  # Minimum expected size of Eep_LengthType.
      integer EepReadUnitSize: 0..4294967295, set at published-information  # Size of smallest readable EEPROM data unit in bytes.
      integer EepSpecifiedEraseCycles: 0..4294967295, set at published-information  # Number of erase cycles specified for the EEP device (usually given in the device data sheet).
      integer EepTotalSize: 0..4294967295, set at published-information  # Total size of EEPROM in bytes. | Implementation Type: Eep_LengthType.
      float EepWriteTime: 0..Inf, set at published-information  # Maximum time for writing one EEPROM data unit.
      integer EepWriteUnitSize: 0..4294967295, set at published-information  # Size of smallest writeable EEPROM data unit in bytes.
  module definition Fls [0..*]: variants post-build/pre-compile  # Configuration of the Fls (internal or external flash driver) module. | Its multiplicity describes the number of flash drivers present, so there will be one container for each flash driver in the ECUC template. When no flash driver is present then the multiplicity is 0.
    container FlsConfigSet: multiple-configuration-container=true  # Container for runtime configuration parameters of the flash driver. | Implementation Type: Fls_ConfigType.
      integer FlsAcErase: 0..4294967295, set at post-build in variant post-build / pre-compile in variant pre-compile  # Address offset in RAM to which the erase flash access code shall be loaded. | Used as function pointer to access the erase flash access code.
      integer FlsAcWrite: 0..4294967295, set at post-build in variant post-build / pre-compile in variant pre-compile  # Address offset in RAM to which the write flash access code shall be loaded. | Used as function pointer to access the write flash access code.
      float FlsCallCycle: 0..1, set at post-build in variant post-build / pre-compile in variant pre-compile  # Cycle time of calls of the flash driver's main function (in seconds).
      enumeration FlsDefaultMode: {MEMIF_MODE_FAST, MEMIF_MODE_SLOW}, set at post-build in variant post-build / pre-compile in variant pre-compile, default-value=MEMIF_MODE_SLOW  # This parameter is the default FLS device mode after initialization. | Implementation Type: MemIf_ModeType.
      function name FlsJobEndNotification [0..1]: set at post-build in variant post-build / pre-compile in variant pre-compile  # Mapped to the job end notification routine provided by some upper layer module, typically the Fee module.
      function name FlsJobErrorNotification [0..1]: set at post-build in variant post-build / pre-compile in variant pre-compile  # Mapped to the job error notification routine provided by some upper layer module, typically the Fee module.
      integer FlsMaxReadFastMode: 0..4294967295, set at post-build in variant post-build / pre-compile in variant pre-compile  # The maximum number of bytes to read or compare in one cycle of the flash driver's job processing function in fast mode.
      integer FlsMaxReadNormalMode: 0..4294967295, set at post-build in variant post-build / pre-compile in variant pre-compile  # The maximum number of bytes to read or compare in one cycle of the flash driver's job processing function in normal mode.
      integer FlsMaxWriteFastMode: 0..4294967295, set at post-build in variant post-build / pre-compile in variant pre-compile  # The maximum number of bytes to write in one cycle of the flash driver's job processing function in fast mode.
      integer FlsMaxWriteNormalMode: 0..4294967295, set at post-build in variant post-build / pre-compile in variant pre-compile  # The maximum number of bytes to write in one cycle of the flash driver's job processing function in normal mode.
      integer FlsProtection: 0..4294967295, set at post-build in variant post-build / pre-compile in variant pre-compile  # Erase/write protection settings. Only relevant if supported by hardware.
      container FlsDemEventParameterRefs [0..1]  # Container for the references to DemEventParameter elements which shall be invoked using the Dem_ReportErrorStatus API in case the corresponding error occurs. The EventId is taken from the referenced DemEventParameter's DemEventId value. The standardized errors are provided in the container and can be extended by vendor specific error references.
        symbolic name reference FLS_E_COMPARE_FAILED [0..1]: set at post-build in variant post-build / pre-compile in variant pre-compile, destination=DemEventParameter  # Reference to the DemEventParameter which shall be issued when the error "Flash compare failed (HW)" has occurred.
        symbolic name reference FLS_E_ERASE_FAILED [0..1]: set at post-build in variant post-build / pre-compile in variant pre-compile, destination=DemEventParameter  # Reference to the DemEventParameter which shall be issued when the error "Flash erase failed (HW)" has occurred.
        symbolic name reference FLS_E_READ_FAILED [0..1]: set at post-build in variant post-build / pre-compile in variant pre-compile, destination=DemEventParameter  # Reference to the DemEventParameter which shall be issued when the error "Flash read failed (HW)" has occurred.
        symbolic name reference FLS_E_UNEXPECTED_FLASH_ID [0..1]: set at post-build in variant post-build / pre-compile in variant pre-compile, destination=DemEventParameter  # Reference to the DemEventParameter which shall be issued when the error "Expected hardware ID not matched" has occurred.
        symbolic name reference FLS_E_WRITE_FAILED [0..1]: set at post-build in variant post-build / pre-compile in variant pre-compile, destination=DemEventParameter  # Reference to the DemEventParameter which shall be issued when the error "Flash write failed (HW)" has occurred.
      container FlsExternalDriver [0..1]  # This container is present for external Flash drivers only. Internal Flash drivers do not use the parameter listed in this container, hence its multiplicity is 0 for internal drivers.
        symbolic name reference FlsSpiReference [1..*]: set at pre-compile, destination=SpiSequence  # Reference to SPI sequence (required for external Flash drivers).
      container FlsSectorList  # List of flashable sectors and pages.
        container FlsSector [1..*]  # Configuration description of a flashable sector
          integer FlsNumberOfSectors: 0..65535, set at pre-compile  # Number of continuous sectors with identical values for FlsSectorSize and | FlsPageSize. The parameter FlsSectorStartAddress denotes the start address of the first sector.
          integer FlsPageSize: 0..4294967295, set at pre-compile  # Size of one page of this sector. | Implementation Type: Fls_LengthType.
          integer FlsSectorSize: 0..4294967295, set at pre-compile  # Size of this sector. | Implementation Type: Fls_LengthType.
          integer FlsSectorStartaddress: 0..4294967295, set at pre-compile  # Start address of this sector. | Implementation Type: Fls_AddressType.
    container FlsGeneral  # Container for general parameters of the flash driver. These parameters are always pre-compile.
      boolean FlsAcLoadOnJobStart: set at pre-compile, default-value=false  # The flash driver shall load the flash access code to RAM whenever an erase or write job is started and unload (overwrite) it after that job has been finished or canceled. | true: Flash access code loaded on job start / unloaded on job end or error. false: Flash access code not loaded to / unloaded from RAM at all.
      integer FlsBaseAddress: 0..4294967295, set at pre-compile  # The flash memory start address (see also SWS_Fls_00208 and SWS_Fls_00209). | This parameter defines the lower boundary for read / write / erase and compare jobs.
      boolean FlsCancelApi: set at pre-compile  # Compile switch to enable and disable the Fls_Cancel function. | true: API supported / function provided. false: API not supported / function not provided
      boolean FlsCompareApi: set at pre-compile  # Compile switch to enable and disable the Fls_Compare function. | true: API supported / function provided. false: API not supported / function not provided
      boolean FlsDevErrorDetect: set at pre-compile, default-value=true  # Pre-processor switch to enable and disable development error detection. | true: Development error detection enabled. false: Development error detection disabled.
      integer FlsDriverIndex: 0..254, scope=ECU, set at pre-compile, symbolic-name-value=true  # Index of the driver, used by FEE.
      boolean FlsGetJobResultApi: set at pre-compile  # Compile switch to enable and disable the Fls_GetJobResult function. | true: API supported / function provided. false: API not supported / function not provided
      boolean FlsGetStatusApi: set at pre-compile  # Compile switch to enable and disable the Fls_GetStatus function. | true: API supported / function provided. false: API not supported / function not provided
      boolean FlsSetModeApi: set at pre-compile  # Compile switch to enable and disable the Fls_SetMode function. | true: API supported / function provided. false: API not supported / function not provided
      integer FlsTotalSize: 0..4294967295, set at pre-compile  # The total amount of flash memory in bytes (see also SWS_Fls_00208 and SWS_Fls_00209). | This parameter in conjunction with FLS_BASE_ADDRESS defines the upper boundary for read / write / erase and compare jobs.
      boolean FlsUseInterrupts: set at pre-compile, default-value=false  # Job processing triggered by hardware interrupt. | true: Job processing triggered by interrupt (hardware controlled). false: Job processing not triggered by interrupt (software controlled)
      boolean FlsVersionInfoApi: set at pre-compile  # Pre-processor switch to enable / disable the API to read out the modules version information. | true: Version info API enabled. false: Version info API disabled.
    container FlsPublishedInformation  # Additional published parameters not covered by CommonPublishedInformation container. | Note that these parameters do not have any configuration class setting, since they are published information.
      integer FlsAcLocationErase: 0..4294967295, set at published-information  # Position in RAM, to which the erase flash access code has to be loaded. | Only relevant if the erase flash access code is not position independent. If this information is not provided it is assumed that the erase flash access code is position independent and that therefore the RAM position can be freely configured.
      integer FlsAcLocationWrite: 0..4294967295, set at published-information  # Position in RAM, to which the write flash access code has to be loaded. | Only relevant if the write flash access code is not position independent. If this information is not provided it is assumed that the write flash access code is position independent and that therefore the RAM position can be freely configured.
      integer FlsAcSizeErase: 0..4294967295, set at published-information  # Number of bytes in RAM needed for the erase flash access code.
      integer FlsAcSizeWrite: 0..4294967295, set at published-information  # Number of bytes in RAM needed for the write flash access code.
      float FlsEraseTime: 0..Inf, set at published-information  # Maximum time to erase one complete flash sector.
      integer FlsErasedValue: 0..4294967295, set at published-information  # The contents of an erased flash memory cell.
      string FlsExpectedHwId: set at published-information  # Unique identifier of the hardware device that is expected by this driver (the device for which this driver has been implemented). | Only relevant for external flash drivers.
      integer FlsSpecifiedEraseCycles: 0..4294967295, set at published-information  # Number of erase cycles specified for the flash device (usually given in the device data sheet). | If the number of specified erase cycles depends on the operating environment (temperature, voltage, ...) during reprogramming of the flash device, the minimum number for which a data retention of at least 15 years over the temperature range from -40°C .. +125°C can be guaranteed shall be given. Note: If there are different numbers of specified erase cycles for different flash sectors of the device this parameter has to be extended to a parameter list (similar to the sector list above).
      float FlsWriteTime: 0..Inf, set at published-information  # Maximum time to program one complete flash page.
  module definition FlsTst [0..1]: variants post-build/pre-compile
    container FlsTstConfigSet: multiple-configuration-container=true  # Multiple Configuration Set Container
      integer FlsTstBlockNumberBgnd: 0..4294967295, set at post-build in variant post-build / pre-compile in variant pre-compile  # This parameter shall represent the number of test blocks available for the background test. | calculationFormula = Number of configured FlsTstBlocks in the FlsTstBlockBgndConfigSet (or 0 if no FlsTstBlocks are configured).
      integer FlsTstBlockNumberFgnd: 0..4294967295, set at post-build in variant post-build / pre-compile in variant pre-compile  # This parameter shall represent the number of test blocks available for the foreground test. | calculationFormula = Number of configured FlsTstBlocks in the FlsTstBlockFgndConfigSet (or 0 if no FlsTstBlocks are configured).
      function name FlsTstTestCompletedNotification: set at post-build in variant post-build / pre-compile in variant pre-compile  # Pointer to function, which shall be called after finishing the background Flash test interval.
      container FlsTstBlockBgndConfigSet [0..1]  # This container defines the blocks in background mode.
        container FlsTstBlock [1..*]  # This container specifies configuration parameters for an individual test block.
          integer FlsTstBlockBaseAddress: 0..18446744073709551615, set at post-build in variant post-build / pre-compile in variant pre-compile  # Start Address of the Flash block.
          integer FlsTstBlockIndex: 0..4294967295, set at post-build in variant post-build / pre-compile in variant pre-compile, symbolic-name-value=true  # Foreground Test: Index identifies block to be tested by FlsTst_StartFgnd(); | Background Test: The scheduling for background test shall follow an order defined by this index. '0' means highest priority.
          integer FlsTstBlockSize: 0..4294967295, set at post-build in variant post-build / pre-compile in variant pre-compile  # This parameter shall represent the Flash Test block size.
          integer FlsTstNumberOfTestedCells: 0..4294967295, set at pre-compile  # Configures the Number of cells to be tested in background mode during one scheduled task (FlsTst_MainFunction() call).
          integer FlsTstSignatureAddress: 0..18446744073709551615, set at post-build in variant post-build / pre-compile in variant pre-compile  # Address of the signature reference value of the Flash test block.
          enumeration FlsTstTestAlgorithm: {FLSTST_16BIT_CRC, FLSTST_32BIT_CRC, FLSTST_8BIT_CRC, FLSTST_CHECKSUM, FLSTST_DUPLICATED_MEMORY, FLSTST_ECC}, set at post-build in variant post-build / pre-compile in variant pre-compile  # This is the configuration of the test algorithm for foreground mode and background mode. The availability of algorithm is implementation specific.
      container FlsTstBlockFgndConfigSet [0..1]  # This container defines the blocks in foreground mode.
        container FlsTstBlock [1..*]  # This container specifies configuration parameters for an individual test block.
          integer FlsTstBlockBaseAddress: 0..18446744073709551615, set at post-build in variant post-build / pre-compile in variant pre-compile  # Start Address of the Flash block.
          integer FlsTstBlockIndex: 0..4294967295, set at post-build in variant post-build / pre-compile in variant pre-compile, symbolic-name-value=true  # Foreground Test: Index identifies block to be tested by FlsTst_StartFgnd(); | Background Test: The scheduling for background test shall follow an order defined by this index. '0' means highest priority.
          integer FlsTstBlockSize: 0..4294967295, set at post-build in variant post-build / pre-compile in variant pre-compile  # This parameter shall represent the Flash Test block size.
          integer FlsTstNumberOfTestedCells: 0..4294967295, set at pre-compile  # Configures the Number of cells to be tested in background mode during one scheduled task (FlsTst_MainFunction() call).
          integer FlsTstSignatureAddress: 0..18446744073709551615, set at post-build in variant post-build / pre-compile in variant pre-compile  # Address of the signature reference value of the Flash test block.
          enumeration FlsTstTestAlgorithm: {FLSTST_16BIT_CRC, FLSTST_32BIT_CRC, FLSTST_8BIT_CRC, FLSTST_CHECKSUM, FLSTST_DUPLICATED_MEMORY, FLSTST_ECC}, set at post-build in variant post-build / pre-compile in variant pre-compile  # This is the configuration of the test algorithm for foreground mode and background mode. The availability of algorithm is implementation specific.
    container FlsTstConfigurationOfOptApiServices
      boolean FlsTstGetCurrentStateApi: set at pre-compile, default-value=false  # Adds / removes the service FlsTst_GetCurrentState() from the code.
      boolean FlsTstGetErrorDetailsApi: set at pre-compile, default-value=false  # Adds / removes the service FlsTst_GetErrorDetails() from the code.
      boolean FlsTstGetTestResultBgndApi: set at pre-compile, default-value=false  # Adds / removes the service FlsTst_GetTestResultBgnd() from the code.
      boolean FlsTstGetTestResultFgndApi: set at pre-compile, default-value=false  # Adds / removes the service FlsTst_GetTestResultFgnd() from the code.
      boolean FlsTstGetTestSignatureBgndApi: set at pre-compile, default-value=false  # Adds / removes the service FlsTst_GetTestSignatureBgnd() from the code.
      boolean FlsTstGetTestSignatureFgndApi: set at pre-compile, default-value=false  # Adds / removes the service FlsTst_GetTestSignatureFgnd() from the code.
      boolean FlsTstStartFgndApi: set at pre-compile, default-value=false  # Adds / removes the service FlsTst_StartFgnd() from the code.
      boolean FlsTstSuspendResumeApi: set at pre-compile, default-value=false  # Adds / removes the services FlsTst_Suspend() and FlsTst_Resume() from the code.
      boolean FlsTstTestEccApi: set at pre-compile, default-value=false  # Adds / removes the service FlsTst_TestEcc() from the code.
      boolean FlsTstVersionInfoApi: set at pre-compile, default-value=false  # Adds / removes the service FlsTst_GetVersionInfo() from the code.
    container FlsTstDemEventParameterRefs [0..1]  # Container for the references to DemEventParameter elements which shall be invoked using the API Dem_ReportErrorStatus API in case the corresponding error occurs. The EventId is taken from the referenced DemEventParameter's DemEventId value. The standardized errors are provided in the container and can be extended by vendor specific error references.
      symbolic name reference FLSTST_E_FLSTST_FAILURE [0..1]: set at pre-compile, destination=DemEventParameter  # Reference to the DemEventParameter which shall be issued when the error "Flash Failure" has occurred.
    container FlsTstGeneral
      boolean FlsTstDevErrorDetect: set at pre-compile, default-value=false  # Switch for enabling the development error detection.
      integer FlsTstNumberOfTestedCellsAtomic: 0..4294967295, set at pre-compile  # Configures the Number of cells to be tested in background mode without checking user requests (Abort, Suspend).
      boolean FlsTstTestCompletedNotificationSupported: set at pre-compile, default-value=true  # Switch to indicate that the notification is supported.
      integer FlsTstTestIntervalIdEndValue: 0..4294967295, set at pre-compile  # Defines the end value of the Test Interval Id.
      boolean FlsTstTestResultSignature: set at pre-compile, default-value=false  # Configures the result of the test in background mode: | True: Test Result is a signature (see FlsTst155, FlsTst054) False: Test Result is ok/not ok (see FlsTst153, FlsTst042)
  module definition CanTrcv [0..*]: variants post-build/pre-compile  # Configuration of the CanTrcv (CAN Transceiver driver) module.
    container CanTrcvConfigSet: multiple-configuration-container=true  # This is the multiple configuration set container for CAN Transceiver.
      integer CanTrcvSPICommRetries: 0..255, set at post-build in variant post-build / pre-compile in variant pre-compile, default-value=0  # Indicates the maximum number of communication retries in case of a failed SPI communication (applies both to timed out communication and to errors/NACK in the response data). | If configured value is '0', no retry is allowed (communication is expected to succeed at first try).
      integer CanTrcvSPICommTimeout: 0..100, set at post-build in variant post-build / pre-compile in variant pre-compile, default-value=0  # Indicates the maximum time allowed to the CanTrcv for replying (either positively or negatively) to a SPI command. | Timeout is configured in milliseconds. Timeout value of '0' means that no specific timeout is to be used by CanTrcv and the communication is executed at the best of the SPI HW capacity.
      container CanTrcvChannel [1..*]  # Container gives CAN transceiver driver information about a single CAN | transceiver (channel).
        integer CanTrcvChannelId: 0..255, scope=ECU, set at pre-compile, symbolic-name-value=true  # Unique identifier of the CAN Transceiver Channel.
        boolean CanTrcvChannelUsed: set at pre-compile, default-value=true  # Shall the related CAN transceiver channel be used?
        boolean CanTrcvControlsPowerSupply: set at pre-compile, default-value=false  # Is ECU power supply controlled by this transceiver? | TRUE = Controlled by transceiver. FALSE = Not controlled by transceiver.
        boolean CanTrcvHwPnSupport: set at pre-compile, default-value=false  # Indicates whether the HW supports the selective wake-up function | TRUE = Selective wakeup feature is supported by the transceiver FALSE = Selective wakeup functionality is not available in transceiver
        enumeration CanTrcvInitState: {CANTRCV_OP_MODE_NORMAL, CANTRCV_OP_MODE_SLEEP, CANTRCV_OP_MODE_STANDBY}, set at pre-compile, default-value=CANTRCV_OP_MODE_NORMAL  # State of CAN transceiver after call to CanTrcv_Init.
        integer CanTrcvMaxBaudrate: 0..1000, set at pre-compile  # Max baudrate for transceiver hardware type. Only used for validation purposes. Value shall be configured by configuration tool based on | transceiver hardware type.
        boolean CanTrcvWakeupByBusUsed [0..1]: set at pre-compile, default-value=false  # Is wake up by bus supported? If CAN transceiver hardware does not support wake up by bus value is always FALSE. If CAN transceiver hardware supports wake up by bus value is TRUE or FALSE depending whether it is used or not. | TRUE = Is used. FALSE = Is not used.
        reference CanTrcvWakeupSourceRef [0..1]: scope=ECU, set at pre-compile, destination=EcuMWakeupSource  # Reference to a wakeup source in the EcuM configuration. | This reference is only needed if CanTrcvWakeupByBusUsed is true.
        symbolic name reference CanTrcvPorWakeupSourceRef [0..1]: scope=ECU, set at pre-compile, destination=EcuMWakeupSource  # Symbolic name reference to specify the wakeup sources that should be used in the calls to EcuM_SetWakeupEvent as specified in [SWS_CanTrcv_00183] and [SWS_CanTrcv_00184]. | This reference is mandatory if the HW supports POR or SYSERR flags
        symbolic name reference CanTrcvSyserrWakeupSourceRef [0..1]: scope=ECU, set at pre-compile, destination=EcuMWakeupSource  # Symbolic name reference to specify the wakeup sources that should be used in the calls to EcuM_SetWakeupEvent as specified in [SWS_CanTrcv_00183] and [SWS_CanTrcv_00184] | This reference is mandatory if the HW supports POR or SYSERR flags
        choice container CanTrcvAccess  # Container gives CanTrcv Driver information about access to a single CAN transceiver.
          container CanTrcvDioAccess [0..1]  # Container gives CAN transceiver driver information about accessing ports and port pins. In addition relation between CAN transceiver hardware pin names and Dio port access information is given. | If a CAN transceiver hardware has no Dio interface, there is no instance of this container.
            container CanTrcvDioChannelAccess [1..*]  # Container gives DIO channel access by single Can transceiver channel.
              string CanTrcvHardwareInterfaceName: set at pre-compile  # CAN transceiver hardware interface name. It is typically the name of a pin. From a Dio point of view it is either a port, a single channel or a channel group. Depending on this fact either | CANTRCV_DIO_PORT_SYMBOLIC_NAME or CANTRCV_DIO_CHANNEL_SYMBOLIC_NAME or CANTRCV_DIO_CHANNEL_GROUP_SYMBOLIC_NAME shall reference a Dio configuration. The CAN transceiver driver implementation description shall list up this name for the appropriate CAN transceiver hardware.
              choice reference CanTrcvDioSymNameRef: set at pre-compile, destination=[DioChannel, DioChannelGroup, DioPort]  # Choice Reference to a DIO Port, DIO Channel or DIO Channel Group. This reference replaces the CANTRCV_DIO_PORT_SYM_NAME, CANTRCV_DIO_CHANNEL_SYM_NAME and CANTRCV_DIO_GROUP_SYM_NAME references in the Can Trcv SWS.
          container CanTrcvSpiSequence [0..*]  # Container gives CAN transceiver driver information about one SPI sequence. | One SPI sequence used by CAN transceiver driver is in exclusive use for it. No other driver is allowed to access this sequence. CAN transceiver driver may use one sequence to access n CAN transceiver hardwares chips of the same type or n sequences are used to access one single CAN transceiver hardware chip. If a CAN transceiver hardware has no SPI interface, there is no instance of this container.
            boolean CanTrcvSpiAccessSynchronous [0..1]: set at pre-compile, default-value=false  # This parameter is used to define whether the access to the Spi sequence is synchronous or asynchronous. | true: SPI access is synchronous. false: SPI access is asynchronous.
            symbolic name reference CanTrcvSpiSequenceName [0..*]: set at pre-compile, destination=SpiSequence  # Reference to a Spi sequence configuration container.
        container CanTrcvPartialNetwork [0..1]  # Container gives CAN transceiver driver information about the configuration of Partial Networking functionality.
          integer CanTrcvBaudRate: 0..1000, set at post-build in variant post-build / pre-compile in variant pre-compile  # Indicates the CAN Bus communication baud rate in kbps.
          boolean CanTrcvBusErrFlag: set at post-build in variant post-build / pre-compile in variant pre-compile, default-value=false  # Indicates if the Bus Error (BUSERR) flag is managed by the BSW. This flag is set if a bus failure is detected by the transceiver. | TRUE = Supported by transceiver and managed by BSW. FALSE = Not managed by BSW.
          boolean CanTrcvPnCanIdIsExtended: set at post-build in variant post-build / pre-compile in variant pre-compile, default-value=false  # Indicates whether extended or standard ID is used. | TRUE = Extended Can identifier is used. FALSE = Standard Can identifier is used
          boolean CanTrcvPnEnabled: set at post-build in variant post-build / pre-compile in variant pre-compile, default-value=false  # Indicates whether the selective wake-up function is enabled or disabled in HW. | TRUE = Selective wakeup feature is enabled in the transceiver hardware FALSE = Selective wakeup feature is disabled in the transceiver hardware
          integer CanTrcvPnFrameCanId: 0..4294967295, set at post-build in variant post-build / pre-compile in variant pre-compile  # CAN ID of the Wake-up Frame (WUF).
          integer CanTrcvPnFrameCanIdMask: 0..4294967295, set at post-build in variant post-build / pre-compile in variant pre-compile  # ID Mask for the selective activation of the transceiver. It is used to enableFrame Wake-up (WUF) on a group of IDs.
          integer CanTrcvPnFrameDlc: 0..8, set at post-build in variant post-build / pre-compile in variant pre-compile  # Data Length of the Wake-up Frame (WUF).
          boolean CanTrcvPowerOnFlag: set at post-build in variant post-build / pre-compile in variant pre-compile, default-value=false  # Description: Indicates if the Power On Reset (POR) flag is available and is managed by the transceiver. | TRUE = Supported by Hardware. FALSE = Not supported by Hardware
          container CanTrcvPnFrameDataMaskSpec [0..8]  # Defines data payload mask to be used on the received payload in order to determine if the transceiver must be woken up by the received Wake-up Frame (WUF).
            integer CanTrcvPnFrameDataMask: 0..255, set at post-build in variant post-build / pre-compile in variant pre-compile  # Defines the n byte (Byte0 = LSB) of the data payload mask to be used on the received payload in order to determine if the transceiver must be woken up by the received Wake-up Frame (WUF).
            integer CanTrcvPnFrameDataMaskIndex: 0..7, set at post-build in variant post-build / pre-compile in variant pre-compile  # holds the position n in frame of the mask-part
    container CanTrcvGeneral  # Container gives CAN transceiver driver basic information.
      boolean CanTrcvDevErrorDetect: set at pre-compile  # Switches development error detection and notification on and off. | If switched on, #define CANTRCV_DEV _ERROR_DETECT ON shall be generated. If switched off, #define CANTRCV_DEV_ERROR _DETECT OFF shall be generated. Define shall be part of file CanTrcv_Cfg.h.
      boolean CanTrcvGetVersionInfo: set at pre-compile, default-value=false  # Switches version information API on and off. If switched off, function need not be present in compiled code.
      integer CanTrcvSPICommRetries: 0..255, set at pre-compile, default-value=0  # Indicates the maximal number of communication retries in case of failed SPI communication (applies both to timed out communication and to errors/NACK in the response data). | (0 ... 255 times, 0 means no retry allowed, communication must succeed at first try)
      integer CanTrcvSPICommTimeout: 0..100, set at pre-compile, default-value=0  # Indicates the maximal time allowed to the Transceiver in order to reply | (either positively or negatively) to a SPI command. (value in ms, 0ms means no specific timeout is to be used, communication is executed at the best of the SPI HW capacity)
      integer CanTrcvWaitCount: 0..4294967295, set at pre-compile, default-value=0  # Indicates the number of wait states to change the transceiver operation mode. Transceiver hardware may need wait states for some transitions.
      enumeration CanTrcvWakeUpSupport: {CANTRCV_WAKEUP_BY_POLLING, CANTRCV_WAKEUP_NOT_SUPPORTED}, set at pre-compile  # Informs whether wake up is supported by polling or not supported. In case no | wake up is supported by the hardware, setting has to be NOT_SUPPORTED. Only in the case of wake up supported by polling, function CanTrcv_MainFunction has to be present and to be invoked by the scheduler.
