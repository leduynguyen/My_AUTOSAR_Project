AUTOSAR XML (schema 4-2-2)
package /AUTOSAR/AISpecification/LifeCycleInfoSets
  life cycle info set PortIfObslt: default-lc-state=obsolete, used-life-cycle-state-definition-group=AutosarLifeCycleStates
    life-cycle-infos:
      lc-object=TrsmTqDftlAxleFrntAct1, lc-state=obsolete, period-begin=ar-release-version=4.2.1, remark=p=l-1=Interface short name changed, keyword Act replaced by Consold, use-instead=TrsmTqDftlAxleFrntConsold1
      lc-object=TrsmTqDftlAxleReAct1, lc-state=obsolete, period-begin=ar-release-version=4.2.1, remark=p=l-1=Interface short name changed, keyword Act replaced by Consold, use-instead=TrsmTqDftlAxleReConsold1
      lc-object=TrsmTqDftlTrfAct1, lc-state=obsolete, period-begin=ar-release-version=4.2.1, remark=p=l-1=Interface short name changed, keyword Act replaced by Consold, use-instead=TrsmTqDftlTrfConsold1
      lc-object=TrsmRatGearAct1, lc-state=obsolete, period-begin=ar-release-version=4.2.1, remark=p=l-1=Interface short name changed, keyword Act replaced by Consold, use-instead=TrsmRatGearConsold1
      lc-object=TrsmCluStAct1, period-begin=ar-release-version=4.2.1, remark=p=l-1=Interface short name changed, keyword Act replaced by Consold, use-instead=TrsmCluStConsold1
      lc-object=TrsmNrGearAct1, lc-state=obsolete, period-begin=ar-release-version=4.2.1, remark=p=l-1=Interface short name changed, keyword Act replaced by Consold, use-instead=TrsmNrGearConsold1
      lc-object=TrsmRatTqPtAct1, lc-state=obsolete, period-begin=ar-release-version=4.2.1, remark=p=l-1=Interface short name changed, keyword Act replaced by Consold, use-instead=TrsmRatTqPtConsold1
      lc-object=ActrBodyLvlSts1, period-begin=ar-release-version=4.2.1, remark=p=l-1=Change of shortname, use-instead=ActrBodyLvlSt1
      lc-object=ActvSuspSts1, period-begin=ar-release-version=4.2.1, remark=p=l-1=Change of shortname, use-instead=ActvSuspSt1
      lc-object=AlrmSts1, period-begin=ar-release-version=4.2.1, remark=p=l-1=Change of shortname, use-instead=AlrmSt1
      lc-object=AntithftPasSts1, period-begin=ar-release-version=4.2.1, remark=p=l-1=Change of shortname, use-instead=AntithftPasSt1
      lc-object=CarHeiSts1, period-begin=ar-release-version=4.2.1, remark=p=l-1=Change of shortname, use-instead=CarHeiSt1
      lc-object=ChdProtnSts1, period-begin=ar-release-version=4.2.1, remark=p=l-1=Change of shortname, use-instead=ChdProtnSt1
      lc-object=CrashSts1, period-begin=ar-release-version=4.2.1, remark=p=l-1=Change of shortname, use-instead=CrashSt1
      lc-object=CrsCtrlAndAccSwtStsEngd1, period-begin=ar-release-version=4.2.1, remark=p=l-1=Change of shortname, use-instead=CrsCtrlAndAccSwtStEngd1
      lc-object=DamprSts1, period-begin=ar-release-version=4.2.1, remark=p=l-1=Change of shortname, use-instead=DamprSt1
      lc-object=DefrstSts1, period-begin=ar-release-version=4.2.1, remark=p=l-1=Change of shortname, use-instead=DefrstSt1
      lc-object=DftlCoorrSts1, period-begin=ar-release-version=4.2.1, remark=p=l-1=Change of shortname, use-instead=DftlCoorrSt1
      lc-object=DoorHndlSenSts1, period-begin=ar-release-version=4.2.1, remark=p=l-1=Change of shortname, use-instead=DoorHndlSenSt1
      lc-object=DoorHndlSts1, period-begin=ar-release-version=4.2.1, remark=p=l-1=Change of shortname, use-instead=DoorHndlSt1
      lc-object=DoorSts1, period-begin=ar-release-version=4.2.1, remark=p=l-1=Change of shortname, use-instead=DoorSt1
      lc-object=DtTqDistbnStsIndcn1, period-begin=ar-release-version=4.2.1, remark=p=l-1=Change of shortname, use-instead=DtTqDistbnStIndcn1
      lc-object=EgyMngtSts1, period-begin=ar-release-version=4.2.1, remark=p=l-1=Change of shortname, use-instead=EgyMngtSt1
      lc-object=EngHoodSts1, period-begin=ar-release-version=4.2.1, remark=p=l-1=Change of shortname, use-instead=EngHoodSt1
      lc-object=EpbActrFltSts1, period-begin=ar-release-version=4.2.1, remark=p=l-1=Change of shortname, use-instead=EpbActrFltSt1
      lc-object=EpbBtnCtrlSts1, period-begin=ar-release-version=4.2.1, remark=p=l-1=Change of shortname, use-instead=EpbBtnCtrlSt1
      lc-object=EscSts1, period-begin=ar-release-version=4.2.1, remark=p=l-1=Change of shortname, use-instead=EscSt1
      lc-object=EscStsIndcn1, period-begin=ar-release-version=4.2.1, remark=p=l-1=Change of shortname, use-instead=EscStIndcn1
      lc-object=FltStsOfSeatClima1, period-begin=ar-release-version=4.2.1, remark=p=l-1=Change of shortname, use-instead=FltStOfSeatClima1
      lc-object=HldOnDmdSts1, period-begin=ar-release-version=4.2.1, remark=p=l-1=Change of shortname, use-instead=HldOnDmdSt1
      lc-object=HoopRollSts1, period-begin=ar-release-version=4.2.1, remark=p=l-1=Change of shortname, use-instead=HoopRollSt1
      lc-object=HornSts1, period-begin=ar-release-version=4.2.1, remark=p=l-1=Change of shortname, use-instead=HornSt1
      lc-object=HtlModSts1, period-begin=ar-release-version=4.2.1, remark=p=l-1=Change of shortname, use-instead=HtlModSt1
      lc-object=IdCfmdSts1, period-begin=ar-release-version=4.2.1, remark=p=l-1=Change of shortname, use-instead=IdCfmdSt1
      lc-object=ImobSts1, period-begin=ar-release-version=4.2.1, remark=p=l-1=Change of shortname, use-instead=ImobSt1
      lc-object=InclnSts1, period-begin=ar-release-version=4.2.1, remark=p=l-1=Change of shortname, use-instead=InclnSt1
      lc-object=KeyInsertSts1, period-begin=ar-release-version=4.2.1, remark=p=l-1=Change of shortname, use-instead=KeyInsertSt1
      lc-object=LiFltSts1, period-begin=ar-release-version=4.2.1, remark=p=l-1=Change of shortname, use-instead=LiFltSt1
      lc-object=LockSts1, period-begin=ar-release-version=4.2.1, remark=p=l-1=Change of shortname, use-instead=LockSt1
      lc-object=LockStsOfSteerCol1, period-begin=ar-release-version=4.2.1, remark=p=l-1=Change of shortname, use-instead=LockStOfSteerCol1
      lc-object=LockgCenSts1, period-begin=ar-release-version=4.2.1, remark=p=l-1=Change of shortname, use-instead=LockgCenSt1
      lc-object=LvlDefrstSts1, period-begin=ar-release-version=4.2.1, remark=p=l-1=Change of shortname, use-instead=LvlDefrstSt1
      lc-object=MassgAdjSts1, period-begin=ar-release-version=4.2.1, remark=p=l-1=Change of shortname, use-instead=MassgAdjSt1
      lc-object=MirrActnSts1, period-begin=ar-release-version=4.2.1, remark=p=l-1=Change of shortname, use-instead=MirrActnSt1
      lc-object=MirrFltSts1, period-begin=ar-release-version=4.2.1, remark=p=l-1=Change of shortname, use-instead=MirrFltSt1
      lc-object=MirrMoveSts1, period-begin=ar-release-version=4.2.1, remark=p=l-1=Change of shortname, use-instead=MirrMoveSt1
      lc-object=MirrPosnSts1, period-begin=ar-release-version=4.2.1, remark=p=l-1=Change of shortname, use-instead=MirrPosnSt1
      lc-object=MirrTintgSts1, period-begin=ar-release-version=4.2.1, remark=p=l-1=Change of shortname, use-instead=MirrTintgSt1
      lc-object=NozHeatrSts1, period-begin=ar-release-version=4.2.1, remark=p=l-1=Change of shortname, use-instead=NozHeatrSt1
      lc-object=OpendClsdSts1, period-begin=ar-release-version=4.2.1, remark=p=l-1=Change of shortname, use-instead=OpendClsdSt1
      lc-object=OperModSts1, period-begin=ar-release-version=4.2.1, remark=p=l-1=Change of shortname, use-instead=OperModSt1
      lc-object=OutdBriSts1, period-begin=ar-release-version=4.2.1, remark=p=l-1=Change of shortname, use-instead=OutdBriSt1
      lc-object=PanicAlrmSts1, period-begin=ar-release-version=4.2.1, remark=p=l-1=Change of shortname, use-instead=PanicAlrmSt1
      lc-object=PaseActvnSts1, period-begin=ar-release-version=4.2.1, remark=p=l-1=Change of shortname, use-instead=PaseActvnSt1
      lc-object=PaseKeylsInvldSts1, period-begin=ar-release-version=4.2.1, remark=p=l-1=Change of shortname, use-instead=PaseKeylsInvldSt1
      lc-object=PosnSts1, period-begin=ar-release-version=4.2.1, remark=p=l-1=Change of shortname, use-instead=PosnSt1
      lc-object=ProfPenSts1, period-begin=ar-release-version=4.2.1, remark=p=l-1=Change of shortname, use-instead=ProfPenSt1
      lc-object=PwrSplySts1, period-begin=ar-release-version=4.2.1, remark=p=l-1=Change of shortname, use-instead=PwrSplySt1
      lc-object=RadioSts1, period-begin=ar-release-version=4.2.1, remark=p=l-1=Change of shortname, use-instead=RadioSt1
      lc-object=RainAmntSts1, period-begin=ar-release-version=4.2.1, remark=p=l-1=Change of shortname, use-instead=RainAmntSt1
      lc-object=RoadCdnSts1, period-begin=ar-release-version=4.2.1, remark=p=l-1=Change of shortname, use-instead=RoadCdnSt1
      lc-object=RoofCnvtbSts1, period-begin=ar-release-version=4.2.1, remark=p=l-1=Change of shortname, use-instead=RoofCnvtbSt1
      lc-object=SeatAxisPosnSts1, period-begin=ar-release-version=4.2.1, remark=p=l-1=Change of shortname, use-instead=SeatAxisPosnSt1
      lc-object=SeatFixaSts1, period-begin=ar-release-version=4.2.1, remark=p=l-1=Change of shortname, use-instead=SeatFixaSt1
      lc-object=SeatMoveSts1, period-begin=ar-release-version=4.2.1, remark=p=l-1=Change of shortname, use-instead=SeatMoveSt1
      lc-object=SeatStorePosnSts1, period-begin=ar-release-version=4.2.1, remark=p=l-1=Change of shortname, use-instead=SeatStorePosnSt1
      lc-object=SnsrAlrmSimpleSts1, period-begin=ar-release-version=4.2.1, remark=p=l-1=Change of shortname, use-instead=SnsrAlrmSimpleSt1
      lc-object=SnsrAlrmSts1, period-begin=ar-release-version=4.2.1, remark=p=l-1=Change of shortname, use-instead=SnsrAlrmSt1
      lc-object=SnsrGlassBreakSts1, period-begin=ar-release-version=4.2.1, remark=p=l-1=Change of shortname, use-instead=SnsrGlassBreakSt1
      lc-object=SnsrInclnSts1, period-begin=ar-release-version=4.2.1, remark=p=l-1=Change of shortname, use-instead=SnsrInclnSt1
      lc-object=SnsrIntrScanrSts1, period-begin=ar-release-version=4.2.1, remark=p=l-1=Change of shortname, use-instead=SnsrIntrScanrSt1
      lc-object=SnsrRoofCnvtbSts1, period-begin=ar-release-version=4.2.1, remark=p=l-1=Change of shortname, use-instead=SnsrRoofCnvtbSt1
      lc-object=SnsrSoundrBattBackedSts1, period-begin=ar-release-version=4.2.1, remark=p=l-1=Change of shortname, use-instead=SnsrSoundrBattBackedSt1
      lc-object=SsmSts1, period-begin=ar-release-version=4.2.1, remark=p=l-1=Change of shortname, use-instead=SsmSt1
      lc-object=StabrSts1, period-begin=ar-release-version=4.2.1, remark=p=l-1=Change of shortname, use-instead=StabrSt1
      lc-object=SteerDrvrAsscSysStsIndcn1, period-begin=ar-release-version=4.2.1, remark=p=l-1=Change of shortname, use-instead=SteerDrvrAsscSysStIndcn1
      lc-object=SteerSts1, period-begin=ar-release-version=4.2.1, remark=p=l-1=Change of shortname, use-instead=SteerSt1
      lc-object=SteerTqSuppsnFrntSts1, period-begin=ar-release-version=4.2.1, remark=p=l-1=Change of shortname, use-instead=SteerTqSuppsnFrntSt1
      lc-object=SwilSprgSts1, period-begin=ar-release-version=4.2.1, remark=p=l-1=Change of shortname, use-instead=SwilSprgSt1
      lc-object=SwtStrtSts1, period-begin=ar-release-version=4.2.1, remark=p=l-1=Change of shortname, use-instead=SwtStrtSt1
      lc-object=TerminalPosnSts1, period-begin=ar-release-version=4.2.1, remark=p=l-1=Change of shortname, use-instead=TerminalPosnSt1
      lc-object=TintgAutSts1, period-begin=ar-release-version=4.2.1, remark=p=l-1=Change of shortname, use-instead=TintgAutSt1
      lc-object=TirePMonCalStsIndcnPerWhl1, period-begin=ar-release-version=4.2.1, remark=p=l-1=Change of shortname, use-instead=TirePMonCalStIndcnPerWhl1
      lc-object=TirePMonSts1, period-begin=ar-release-version=4.2.1, remark=p=l-1=Change of shortname, use-instead=TirePMonSt1
      lc-object=TrlrHitchSts1, period-begin=ar-release-version=4.2.1, remark=p=l-1=Change of shortname, use-instead=TrlrHitchSt1
      lc-object=TrlrSts1, period-begin=ar-release-version=4.2.1, remark=p=l-1=Change of shortname, use-instead=TrlrSt1
      lc-object=VehHldSts1, period-begin=ar-release-version=4.2.1, remark=p=l-1=Change of shortname, use-instead=VehHldSt1
      lc-object=WinHeatrSts1, period-begin=ar-release-version=4.2.1, remark=p=l-1=Change of shortname, use-instead=WinHeatrSt1
      lc-object=WiprSts1, period-begin=ar-release-version=4.2.1, remark=p=l-1=Change of shortname, use-instead=WiprSt1
      lc-object=WshrFldSts1, period-begin=ar-release-version=4.2.1, remark=p=l-1=Change of shortname, use-instead=WshrFldSt1
      lc-object=WshrSts1, period-begin=ar-release-version=4.2.1, remark=p=l-1=Change of shortname, use-instead=WshrSt1
      lc-object=ACenForOccptPedSfty1, period-begin=ar-release-version=4.1.1, remark=p=l-1=changed data type specification, use-instead=ACenForOccptPedSfty2
      lc-object=AExtForOccptPedSfty1, period-begin=ar-release-version=4.1.1, remark=p=l-1=changed data type specification, use-instead=AExtForOccptPedSfty2
      lc-object=CogPosnEstimd1, period-begin=ar-release-version=4.1.1, remark=p=l-1=Interface Name Harmonization (removal of "Estimd"), use-instead=CogPosn1
      lc-object=DamprCoeffEstimd1, period-begin=ar-release-version=4.1.1, remark=p=l-1=Interface Name Harmonization (removal of "Estimd"), use-instead=DamprCoeff1
      lc-object=DamprFEstimd1, period-begin=ar-release-version=4.1.1, remark=p=l-1=Interface Name Harmonization (removal of "Estimd"), use-instead=DamprF1
      lc-object=FricCoeffEstimd1, period-begin=ar-release-version=4.1.1, remark=p=l-1=Interface Name Harmonization (removal of "Estimd"), use-instead=FricCoeff1
      lc-object=SnsrInclInhbReq1, period-begin=ar-release-version=4.1.1, remark=p=l-1=Correction of used keyword abbreviation, use-instead=SnsrInclnInhbReq1
      lc-object=SprgCoeffEstimd1, period-begin=ar-release-version=4.1.1, remark=p=l-1=Interface Name Harmonization (removal of "Estimd"), use-instead=SprgCoeff1
      lc-object=SprgFEstimd1, period-begin=ar-release-version=4.1.1, remark=p=l-1=Interface Name Harmonization (removal of "Estimd"), use-instead=SprgF1
      lc-object=TirePEstimdPerWhl1, period-begin=ar-release-version=4.1.1, remark=p=l-1=Interface Name Harmonization (removal of "Estimd"), use-instead=TirePPerWhl1
      lc-object=TireTEstimdPerWhl1, period-begin=ar-release-version=4.1.1, remark=p=l-1=Interface Name Harmonization (removal of "Estimd"), use-instead=TireTPerWhl1
      lc-object=VehMEstimd1, period-begin=ar-release-version=4.1.1, remark=p=l-1=Interface Name Harmonization (removal of "Estimd"), use-instead=VehM1
      lc-object=HvacTqReq1, lc-state=obsolete, period-begin=ar-release-version=4.2.1, use-instead=AcTqReq1
      lc-object=PtFlgHvacDeactvt1, lc-state=obsolete, period-begin=ar-release-version=4.2.1, use-instead=PtFlgAcDeactvt1
      lc-object=PtTqMaxHvac1, lc-state=obsolete, period-begin=ar-release-version=4.2.1, use-instead=PtTqMaxAc1
      lc-object=HvacTq1, lc-state=obsolete, period-begin=ar-release-version=4.2.1, use-instead=AcTq1
