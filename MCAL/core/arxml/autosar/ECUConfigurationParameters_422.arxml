AUTOSAR XML (schema 4-0-1)
# The material contained in this specification is protected by copyright and
# other types of Intellectual Property Rights. The commercial exploitation of the
# material contained in this specification requires a license to such
# Intellectual Property Rights.
# This specification may be utilized or reproduced without any modification, in
# any form or by any means, for informational purposes only. For any other
# purpose, no part of the specification may be utilized or reproduced, in any
# form or by any means, without permission in writing from the publisher.
# licensed under the same rules as applicable to the AUTOSAR Standard.
package /AUTOSAR/EcucDefs
  ecuc definition collection AUTOSARParameterDefinition: module=[Adc, BswM, Cal, Can, CanIf, CanNm, CanSM, CanTSyn, CanTp, CanTrcv, Cdd, Com, ComM, CorTst, Crc, Csm, Dbg, Dcm, Dem, Det, Dio, Dlt, DoIP, Ea, EcuC, EcuM, Eep, Eth, EthIf, EthSM, EthSwt, EthTSyn, EthTrcv, Fee, FiM, Fls, FlsTst, Fr, FrArTp, FrIf, FrNm, FrSM, FrTSyn, FrTp, FrTrcv, Gpt, Icu, IpduM, J1939Dcm, J1939Nm, J1939Rm, J1939Tp, LdCom, Lin, LinIf, LinNm, LinSM, LinTp, LinTrcv, Mcu, MemIf, MemMap, Nm, NvM, Ocu, Os, PduR, Port, Pwm, RamTst, Rte, Sd, SecOC, SoAd, Spi, StbM, TcpIp, Tm, UdpNm, Wdg, WdgIf, WdgM, Xcp, Xfrm]
  module definition CanTSyn [0..1]: variants post-build/pre-compile  # Configuration of the Synchronized Time-base Manager (StbM) module with respect to global time handling on CAN.
    container CanTSynGeneral  # This container holds the general parameters of the CAN-specific Synchronized Time-base Manager
      boolean CanTSynDevErrorDetect  # Switches the Default Error Tracer (Det) detection and notification ON or OFF. | * true: enabled (ON). * false: disabled (OFF).
      float CanTSynMainFunctionPeriod: 0..Inf  # Schedule period of the main function CanTSyn_MainFunction. Unit: [s].
      boolean CanTSynVersionInfo  # Activate/Deactivate the version information API (CanTSyn_GetVersionInfo). True: version information API activated False: version information API deactivated.
      container CanTSynGlobalTimeFupDataIDList  # The DataIDList for FUP messages ensures the identification of data elements due to CRC calculation process.
        container CanTSynGlobalTimeFupDataIDListElement [16..16]  # Element of the DataIDList for FUP messages ensures the identification of data elements due to CRC calculation process.
          integer CanTSynGlobalTimeFupDataIDListIndex: 0..15  # Index of the DataIDList for FUP messages ensures the identification of data elements due to CRC calculation process.
          integer CanTSynGlobalTimeFupDataIDListValue: 0..255  # Value of the DataIDList for FUP messages ensures the identification of data elements due to CRC calculation process.
      container CanTSynGlobalTimeOfnsDataIDList  # The DataIDList for OFNS messages ensures the identification of data elements due to CRC calculation process.
        container CanTSynGlobalTimeOfnsDataIDListElement [16..16]  # Element of the DataIDList for OFNS messages ensures the identification of data elements due to CRC calculation process.
          integer CanTSynGlobalTimeOfnsDataIDListIndex: 0..15  # Index of the DataIDList for OFNS messages ensures the identification of data elements due to CRC calculation process.
          integer CanTSynGlobalTimeOfnsDataIDListValue: 0..255  # Value of the DataIDList for OFNS messages ensures the identification of data elements due to CRC calculation process.
      container CanTSynGlobalTimeOfsDataIDList  # The DataIDList for OFS messages ensures the identification of data elements due to CRC calculation process.
        container CanTSynGlobalTimeOfsDataIDListElement [16..16]  # Element of the DataIDList for OFS messages ensures the identification of data elements due to CRC calculation process.
          integer CanTSynGlobalTimeOfsDataIDListIndex: 0..15  # Index of the DataIDList for OFS messages ensures the identification of data elements due to CRC calculation process.
          integer CanTSynGlobalTimeOfsDataIDListValue: 0..255  # Value of the DataIDList for OFS messages ensures the identification of data elements due to CRC calculation process.
      container CanTSynGlobalTimeSyncDataIDList  # The DataIDList for SYNC messages ensures the identification of data elements due to CRC calculation process.
        container CanTSynGlobalTimeSyncDataIDListElement [16..16]  # Element of the DataIDList for SYNC messages ensures the identification of data elements due to CRC calculation process.
          integer CanTSynGlobalTimeSyncDataIDListIndex: 0..15  # Index for the DataIDList for SYNC messages ensures the identification of data elements due to CRC calculation process.
          integer CanTSynGlobalTimeSyncDataIDListValue: 0..255  # Value of the DataIDList for SYNC messages ensures the identification of data elements due to CRC calculation process.
    container CanTSynGlobalTimeDomain [1..*]  # This represents the existence of a global time domain on CAN. The CanTSyn module can administrate several global time domains at the same time that in itself form a hierarchy of domains and sub-domains. | If the CanTSyn exists it is assumed that at least one global time domain exists.
      integer CanTSynGlobalTimeDomainId: 0..31  # The global time domain ID.
      float CanTSynGlobalTimeFollowUpTimeout: 0..Inf  # Rx timeout for the follow-up message. This is only relevant for selected bus systems Unit:seconds
      integer CanTSynGlobalTimeSequenceCounterJumpWidth: 1..15  # The SequenceCounterJumpWidth specifies the maximum allowed gap of the Sequence Counter between two SYNC resp. two OFS messages.
      symbolic name reference CanTSynSynchronizedTimeBaseRef: destination=StbMSynchronizedTimeBase  # Mandatory reference to the required synchronized time-base.
      container CanTSynGlobalTimeMaster [0..1]  # Configuration of the global time master. Each global time domain is required to have exactly one global time master. This master may or may not exist on the configured ECU.
        enumeration CanTSynGlobalTimeTxCrcSecured: {CRC_NOT_SUPPORTED, CRC_SUPPORTED}  # This represents the configuration of whether or not CRC is supported.
        float CanTSynGlobalTimeTxFollowUpOffset: 0..Inf  # This represents the transmission time offset between a SYNC message and the related FUP message resp. OFS message and related OFNS message. Unit: seconds.
        float CanTSynGlobalTimeTxPeriod: 0..Inf  # This represents configuration of the TX period. Unit: seconds
        float CanTSynMasterConfirmationTimeout: 0..Inf  # This represents the confirmation timeout after transmission of a SYNC message resp. OFS message. Unit: seconds.
        container CanTSynGlobalTimeMasterPdu  # This container encloses the configuration of the PDU that is supposed to contain the global time information.
          integer CanTSynGlobalTimeMasterConfirmationHandleId: 0..65535, symbolic-name-value=true  # This represents the handle ID of the PDU that contains the global time information.
          reference CanTSynGlobalTimePduRef: destination=Pdu  # This represents the reference to the Pdu taken to transmit the global time information. The global time master of a global time domain acts as the sender of the Pdu while all the time slaves are supposed to receive the Pdu.
      container CanTSynGlobalTimeSlave [0..1]  # Configuration of a global time slave. Each global time domain is required to have at least one time slave. The configured ECU may or may not represent a time slave.
        enumeration CanTSynRxCrcValidated: {CRC_IGNORED, CRC_NOT_VALIDATED, CRC_VALIDATED}  # Definition of whether or not validation of the CRC is supported.
        container CanTSynGlobalTimeSlavePdu  # This container encloses the configuration of the PDU that is supposed to contain the global time information.
          integer CanTSynGlobalTimeSlaveHandleId: 0..65535, symbolic-name-value=true  # This represents the handle ID of the PDU that contains the global time information.
          reference CanTSynGlobalTimePduRef: destination=Pdu  # This represents the reference to the Pdu taken to transmit the global time information. The global time master of a global time domain acts as the sender of the Pdu while all the time slaves are supposed to receive the Pdu.
  module definition Crc [0..1]: variants pre-compile  # Configuration of the Crc (Crc routines) module.
    container CrcGeneral  # General configuration of CRC module
      enumeration Crc16Mode [0..1]: {CRC_16_HARDWARE, CRC_16_RUNTIME, CRC_16_TABLE}, multiplicity set at pre-compile, set at pre-compile  # Switch to select one of the available CRC 16-bit (CCITT) calculation methods
      enumeration Crc32Mode [0..1]: {CRC_32_HARDWARE, CRC_32_RUNTIME, CRC_32_TABLE}, multiplicity set at pre-compile, set at pre-compile  # Switch to select one of the available CRC 32-bit (IEEE-802.3 CRC32 Ethernet Standard) calculation methods
      enumeration Crc32P4Mode [0..1]: {CRC_32P4_HARDWARE, CRC_32P4_RUNTIME, CRC_32P4_TABLE}, multiplicity set at pre-compile, set at pre-compile  # Switch to select one of the available CRC 32-bit E2E Profile 4 calculation methods.
      enumeration Crc8H2FMode [0..1]: {CRC_8H2F_HARDWARE, CRC_8H2F_RUNTIME, CRC_8H2F_TABLE}, multiplicity set at pre-compile, set at pre-compile  # Switch to select one of the available CRC 8-bit (2Fh polynomial) calculation methods
      enumeration Crc8Mode [0..1]: {CRC_8_HARDWARE, CRC_8_RUNTIME, CRC_8_TABLE}, multiplicity set at pre-compile, set at pre-compile  # Switch to select one of the available CRC 8-bit (SAE J1850) calculation methods
  module definition DoIP [0..1]: variants link-time/post-build/pre-compile  # Configuration of the DoIP (Diagnostic over IP) module.
    container DoIPConfigSet  # This container contains the configuration parameters and sub containers of the AUTOSAR DoIP module.
      integer DoIPEid [0..1]: 0..281474976710655  # Configured EID (Entity ID of) for vehicle identification/vehicle announcement. Only necessary if DoIPUseMacAddressForIdentification is set to FALSE.
      integer DoIPGid [0..1]: 0..281474976710655  # Configured GID (Group ID of) for vehicle identification/vehicle announcement.
      integer DoIPLogicalAddress: 0..65535  # Describes the logical address of the DoIP entity, i.e. the LA that will route diagnostic requests to the Dcm of the DoIP entity.
      container DoIPChannel [1..65536]  # Configuration of one DoIPChannel.
        reference DoIPChannelSARef: destination=DoIPTester  # Reference to the DoIPTester.
        reference DoIPChannelTARef: destination=DoIPTargetAddress  # Reference to the target address.
        container DoIPPduRRxPdu [0..1]  # This container contains the Rx Pdus to connect with the Rx Pdus of the PduR.
          integer DoIPPduRRxPduId: 0..65535, symbolic-name-value=true  # The DoIPPduRRxPduId is required by the API call DoIP_TpCancelReceive.
          reference DoIPPduRRxPduRef: destination=Pdu  # Reference to the "global" Pdu structure to allow harmonization of handle IDs in the COM-Stack.
        container DoIPPduRTxPdu [0..1]  # This container contains the Tx Pdus to connect with the Tx Pdus of the PduR. If the parameter is not configured the channel is for functional addressing.
          integer DoIPPduRTxPduId: 0..65535, symbolic-name-value=true  # The DoIPPduRTxPduId is required by DoIP_TpTransmit or DoIP_IfTransmit and DoIP_TpCancelTransmit.
          enumeration DoIPPduType [0..1]: {DOIP_IFPDU, DOIP_TPPDU}, default-value=DOIP_TPPDU  # API Type to use for communication with PduR. DOIP_IFPDU for UUDT messages, DOIP_TPPDU for all other diagnostic messages.
          reference DoIPPduRTxPduRef: destination=Pdu  # Reference to the "global" Pdu structure to allow harmonization of handle IDs in the COM-Stack.
      container DoIPConnections  # Container contains all lower layer connection specific information, i.e. the single Pdu References and Handle IDs to the SoAd.
        container DoIPTargetAddress [1..255]  # This container describes a possible TargetAddress that is supported by DoIP.
          integer DoIPTargetAddressValue: 0..65535  # Valid Target Address of a DoIP target address.
        container DoIPTcpConnection [2..255]  # This container describes a tcp connection to the lower layer SoAd module.
          container DoIPSoAdRxPdu  # This container contains the Rx Pdus received by DoIP
            integer DoIPSoAdRxPduId: 0..65535, symbolic-name-value=true  # The DoIPSoAdRxPduId is required by the API call DoIP_SoAdTpRxIndication to receive I-PDUs from the SoAd.
            reference DoIPSoAdRxPduRef: destination=Pdu  # Reference to the "global" Pdu structure to allow harmonization of handle IDs in the COM-Stack.
          container DoIPSoAdTxPdu  # This container describes the TxPdu sent via the SoAd
            integer DoIPSoAdTxPduId: 0..65535, symbolic-name-value=true  # The DoIPSoAdTxPduId is required by the API call DoIP_SoAdTpTxConfirmation that is called by the SoAd to confirm that the IPdu has been transmitted successfully.
            reference DoIPSoAdTxPduRef: destination=Pdu  # Reference to the "global" Pdu structure to allow harmonization of handle IDs in the COM-Stack.
        container DoIPUdpConnection [1..255]  # This Container describes a udp connection to the lower layer SoAd module.
          container DoIPSoAdRxPdu  # This container contains the Rx Pdus received by DoIP
            integer DoIPSoAdRxPduId: 0..65535, symbolic-name-value=true  # The DoIPSoAdRxPduId is required by the API call DoIP_SoAdTpRxIndication to receive I-PDUs from the SoAd.
            reference DoIPSoAdRxPduRef: destination=Pdu  # Reference to the "global" Pdu structure to allow harmonization of handle IDs in the COM-Stack.
          container DoIPSoAdTxPdu  # This container describes the TxPdu sent via the SoAd
            integer DoIPSoAdTxPduId: 0..65535, symbolic-name-value=true  # The DoIPSoAdTxPduId is required by the API call DoIP_SoAdTpTxConfirmation that is called by the SoAd to confirm that the IPdu has been transmitted successfully.
            reference DoIPSoAdTxPduRef: destination=Pdu  # Reference to the "global" Pdu structure to allow harmonization of handle IDs in the COM-Stack.
      container DoIPRoutingActivation [0..255]  # This container describes the routing activation possibilities by representing for each container a possible routing activation request message to the DoIP entity and the according references to the activated diagnostic messages.
        integer DoIPRoutingActivationNumber: 0..255  # Identifies the Routing activation Number which is received for a DoIP routing activation request message.
        reference DoIPTargetAddressRef [1..255]: destination=DoIPTargetAddress  # Reference to all DoIPTargetAddress which are activated on this Routing activation.
        container DoIPRoutingActivationAuthenticationCallback [0..1]  # Container describes the Callbackfunction to call on a Routing Activation Request for Authentication. If this container is configured but the DoIPRoutingActivationAuthenticationFunc parameter is not present, the DoIP module will use an RPort of ServiceInterface <RoutingActivation>_RoutingActivation with the name "CB<RoutingActivation>RoutingActivation". <RoutingActivation> is the ShortName of the DoIPRoutingActiviation container.
          function name DoIPRoutingActivationAuthenticationFunc [0..1]  # Direct C Callback function to trigger the authentication function for routing activation. If the DoIPRoutingActivationAuthenticationFunc parameter is present, the DoIP module will not use an RPort of ServiceInterface <RoutingActivation>_RoutingActivation but call the configured function.
          integer DoIPRoutingActivationAuthenticationReqLength: 0..4  # Describes the amount of bytes used to handle to the authentication function on routing activation. If 0 is configured as length the parameter AuthenticationReqData will not be handled to the API.
          integer DoIPRoutingActivationAuthenticationResLength: 0..4  # Describes the amount of bytes used to read by the authentication function on routing activation. If 0 is configured as length the parameter AuthenticationResData will not be fetched via the API.
        container DoIPRoutingActivationConfirmationCallback [0..1]  # Container describes the Callbackfunction to call on a Routing Activation Request for Confirmation. If this container is configured but the DoIPRoutingActivationConfirmationFunc parameter is not present the DoIP module will use an RPort of ServiceInterface <RoutingActivation>_RoutingActivation with the name "CB<RoutingActivation>RoutingActivation". <RoutingActivation> is the ShortName of the DoIPRoutingActiviation container.
          function name DoIPRoutingActivationConfirmationFunc [0..1]  # Direct C Callback function to trigger the confirmation function for routing activation. If the DoIPRoutingActivationConfirmationFunc parameter is present the DoIP module will not use an RPort of ServiceInterface <RoutingActivation>_RoutingActivation but call the configured function.
          integer DoIPRoutingActivationConfirmationReqLength: 0..4  # Describes the amount of bytes used to handle to the confirmation function on routing activation. If 0 is configured as length the parameter ConfirmedReqData will not be handled to the API.
          integer DoIPRoutingActivationConfirmationResLength: 0..4  # Describes the amount of bytes used to read by the confirmation function on routing activation. If 0 is configured as length the parameter ConfirmedResData will not be fetched via the API.
      container DoIPTester [1..255]  # This container describes the properties of the possible connectable Tester for the DoIP entity.
        integer DoIPNumByteDiagAckNack: 0..4294967295  # Specifies the number of original Diagnostic request bytes the DoIP entity responses on a NACK of a diagnostic response message to the Tester.
        integer DoIPTesterSA: 0..65535  # Source Address of the Tester sent via routing activation or diagnostic message.
        reference DoIPRoutingActivationRef [1..255]: destination=DoIPRoutingActivation  # Reference to a DoIPRoutingActivation describing the possible routing activations of the DoIPTester
    container DoIPGeneral  # This container specifies the general configuration parameters of the DoIP module.
      float DoIPAliveCheckResponseTimeout: 0..Inf  # Timeout in [s] for waiting for a response to an Alive Check request before the connection is considered to be disconnected. Represents parameter T_TCP_AliveCheck of ISO 13400-2:2012.
      boolean DoIPDevelopmentErrorDetect  # Switches the Default Error Tracer (Det) detection and notification ON or OFF. | * true: enabled (ON). * false: disabled (OFF).
      boolean DoIPDhcpOptionVinUse  # If DoIPDhcpOptionVinUse is set to true the DoIP module will add the VIN to the Dhcp host name if no valid Dhcp host name is already set.
      boolean DoIPEntityStatusMaxByteFieldUse  # This parameter is used to distinguish the optional support of the Max data size element of a diagnostic entity status response.
      integer DoIPGIDInvalidityPattern: 0..255  # Specifies the Byte pattern that is used for response messages if no valid GID could be retrieved.
      float DoIPGeneralInactivityTime: 0..Inf  # Timeout in [s] for maximum inactivity of a TCP socket connection before the DoIP module will close the according socket connection. Represents parameter T_TCP_General_Inactivity of ISO 13400-2:2012
      string DoIPHeaderFileInclusion [0..*]  # Name of the header file(s) to be included by the DoIP module containing the used C-callback declarations.
      string DoIPHostNameSizeMax: max-length=255, min-length=5  # Maximum Size of the DHCP HostName in ASCII. This parameter is necessary to reserve the correct amount of bytes for working with the DHCP HostName option. Minimum range is 5 because Dhcp Host Name should be at least "DoIP-" on any configuration.
      float DoIPInitialInactivityTime: 0..Inf  # Timeout in [s] used for initial inactivity of a connected TCP socket connection directly after socket connection. Represents parameter T_TCP_Initial_Inactivity of ISO 13400-2:2012
      float DoIPInitialVehicleAnnouncementTime: 0..Inf  # Time to wait in [s] for sending first vehicle anouncement message after IP address assignment. Represents parameter A_DoIP_Announce_Wait of ISO 13400-2:2012
      float DoIPMainFunctionPeriod: 0..Inf  # Determines the frequency at which the DoIP_MainFunction() is called in [s].
      integer DoIPMaxRequestBytes: 1..18446744073709551615  # Specifies the maximum allowed bytes of a DoIP message request without the DoIP header.
      integer DoIPMaxTesterConnections: 1..255  # Maximum ammount of tester connections that shall be maintained at one time before alive check is performed.
      integer DoIPMaxUDPRequestPerMessage: 1..255  # This parameter captures the maximum amont of UDP Requests necessary to handle paralel within a single UDP connection.
      enumeration DoIPNodeType: {DOIP_GATEWAY, DOIP_NODE}  # Describes the Type of the DoIP node.
      boolean DoIPUseEIDasGID  # Specifies if the DoIP entity shall use its EID if it is the Master for vehicle identification gid on the vehicle identification/vehicle announcement.
      boolean DoIPUseMacAddressForIdentification  # Provided the information if a configured EID at vehicle identification response/vehicle announment is used or the MAC address. | TRUE: Use MAC Address instead of EID for Vehicle identification/announcement. FALSE: Use configured EID for vehicle identification/announcement. Dependencies: DoIPEID
      boolean DoIPUseVehicleIdentificationSyncStatus  # Defines if the optional VIN/GID synchronization status is used additionally in the vehicle identification/announcement.
      float DoIPVehicleAnnouncementInterval: 0..Inf  # Time to wait in [s] for sending subsequent vehicle anouncement messages. Represents parameter A_DoIP_Announce_Interval of ISO 13400-2:2012
      integer DoIPVehicleAnnouncementRepetition: 1..255  # Amount of repetitions of the vehicle announcement message on IP address assignment. Represents parameter A_DoIP_Annunce_Num of ISO 13400-2:2012
      boolean DoIPVersionInfoApi  # Activates the DoIP_GetVersionInfo() API. | TRUE: Enables the DoIP_GetVersionInfo() API. FALSE: DoIP_GetVersionInfo() API is not included.
      boolean DoIPVinGidMaster  # Specifies if the DoIP entity is the Vehicle identification Master for the GID (Group ID).
      integer DoIPVinInvalidityPattern: 0..255  # Specifies the Byte pattern that is used for response messages if no valid VIN could be retrieved.
      container DoIPGetGidCallback [0..1]  # This container describes the usage of a callback function to get the GID. (If this container is not present no callback function shall be used by DoIP module to retrive the GID.)
        function name DoIPGetGidDirect [0..1]  # If the DoIPGetGidDirect parameter exist the DoIP module shall call the configured callback function (<User>_DoIPGetGID) direct. (It is not needed to specify a service port to the DoIP service component.) | If the DoIPGetGidDirect parameter does NOT exist the DoIP module shall use a RPort with a CallbackGetGID type of client-server port interface to retrive the GID.
      container DoIPPowerModeCallback  # This container describes the usage of a callback function to retrieve the current power mode. This container shall always be present.
        function name DoIPPowerModeDirect [0..1]  # If the DoIPPowerModeDirect parameter exist the DoIP module shall call the configured callback function (<User>_DoIPGetPowerModeCallback) direct. (It is not needed to specify a service port to the DoIP service component.) | If the DoIPPowerModeDirect parameter does NOT present the DoIP module shall use a RPort with a CallbackGetPowerMode type of client-server port interface to retrive the current power mode.
      container DoIPTriggerGidSyncCallback [0..1]  # This container describes the usage of a callback function to trigger the GID synchronization. (If this container does not exist no callback function shall be used by DoIP module to trigger the GID synchronization.)
        function name DoIPTriggerGidSyncDirect [0..1]  # If the DoIPTriggerGidSyncDirect parameter exist the DoIP module shall call the configured callback function (<User>_DoIPTriggerGidSyncCallback) direct. (It is not needed to specify a service port to the DoIP service component.) | If the DoIPTriggerGidSyncDirect parameter does NOT present the DoIP module shall use a RPort with a CallbackTriggerGIDSynchnonization type of client-server port interface to trigger the GID synchronization.
  module definition EthSwt [0..*]: variants link-time/post-build/pre-compile  # Configuration of the EthSwt (Ethernet Switch Driver) module.
    container EthSwtConfig [1..*]  # Configuration of one Ethernet Switch.
      integer EthSwtIdx: 0..255, symbolic-name-value=true  # Specifies the instance ID of the configured Ethernet Switch.
      container EthSwtDemEventParameterRefs [0..1]  # Container for the references to DemEventParameter elements which shall be invoked using the API Dem_ReportErrorStatus in case the corresponding error occurs. The EventId is taken from the referenced DemEventParameter's DemEventId value. The standardized errors are provided in the container and can be extended by vendor specific error references.
        symbolic name reference ETHSWT_E_ACCESS [0..1]: destination=DemEventParameter  # Reference to the DemEventParameter which shall be issued when the error "Ethernet Switch Access Failure" has occurred.
      container EthSwtNvm [0..1]  # Configuration of one Ethernet Switch Nvm usage in case the module requires non volatile memory in the Ecu to store switch configuration.
        symbolic name reference EthSwtNvmBlockDescriptorRef: destination=NvMBlockDescriptor  # Reference to the Nvm block description in the Nvm module configuration.
      container EthSwtPort [1..*]  # Configuration of one Ethernet Switch Port.
        boolean EthSwtPortEnableLinkDownCallback  # Enables the callback <User>_LinkDown for this EthSwtPort if an IEEE802.1X link loss is detected. | <User> is defined by EthSwtLinkDownUser.
        integer EthSwtPortIdx: 0..255, symbolic-name-value=true  # Specifies the instance ID of the configured Ethernet Switch Port.
        enumeration EthSwtPortPhysicalLayerType: {ETHSWT_PORT_BASE_T, ETHSWT_PORT_BROAD_R_REACH, ETHSWT_PORT_RTPGE, ETHSWT_PORT_X_MII}  # Defines the physical layer type on this EthSwtPort.
        string EthSwtPortPredefinedMacAddresses [0..*]: regular-expression=[0-9a-fA-F]{2}[[:-][0-9a-fA-F]{2}]{5}  # Specifies a list of 48-bit physical addresses (MAC addresses) which can be reached via this port in network byte order. | Note that further addresses can be learned during runtime.
        enumeration EthSwtPortSpeed [0..1]: {ETHSWT_PORT_SPEED_10, ETHSWT_PORT_SPEED_100, ETHSWT_PORT_SPEED_1000}  # Defines the communication speed in Mbit per second on this EthSwtPort in case no EthSwtPortTrcvRef is defined. | Is optional if EthSwtPortTrcvRef is defined.
        symbolic name reference EthSwtPortTrcvRef [0..1]: destination=EthTrcvConfig  # Reference to the ethernet transceiver driver this EthSwtPort is connected with.
        container EthSwtPortEgress  # Configuration of one Ethernet Switch Port Egress behavior.
          reference EthSwtPortEgressLastSchedulerRef: destination=EthSwtPortScheduler  # Reference to the port scheduler which is the last in the egress port structure.
          container EthSwtPortFifo [1..*]  # Represents a Fifo in the egress port.
            integer EthSwtPortFifoTrafficClassAssignment [0..8]: 0..7  # Defines which traffic classes are assigned to this Fifo.
          container EthSwtPortScheduler [1..*]  # Represents a Scheduler in the egress port.
            enumeration EthSwtPortSchedulerAlgorithm: {ETHSWT_SCHEDULER_DEFICIT_ROUND_ROBIN, ETHSWT_SCHEDULER_STRICT_PRIORITY, ETHSWT_SCHEDULER_WEIGHTED_ROUND_ROBIN}  # Defines the scheduler algorithm.
            container EthSwtPortSchedulerPredecessor [1..*]  # Defines an ordered list of predecessors for this scheduler.
              integer EthSwtPortSchedulerPredecessorOrder: 0..18446744073709551615  # Defines the order of the scheduler predecessors.
              choice reference EthSwtPortEgressPredecessorRef: destination=[EthSwtPortFifo, EthSwtPortScheduler, EthSwtPortShaper]  # Choice reference to the scheduler predecessor.
          container EthSwtPortShaper [0..*]  # Represents a Shaper in the egress port.
            integer EthSwtPortShaperIdleSlope [0..1]: 0..18446744073709551615  # Defines the increase of credit in bits per second for the AVB shaper.
            reference EthSwtPortEgressPredecessorFifoRef: destination=EthSwtPortFifo  # Reference to the fifo which is the predecessor for this shaper.
          container EthSwtPortVlanForwarding [0..*]  # Defines how messages with a specific VLAN Id shall be handled at this egress port wrt. their VLAN Id.
            integer EthSwtPortVlanDefaultPriority: 0..7  # Determines the standard output-priority outgoing messages will be tagged with.
            integer EthSwtPortVlanForwardingId: 1..4094  # Determines the VLAN Id the VlanForwarding shall apply to.
            enumeration EthSwtPortVlanForwardingType: {ETHSWT_NOT_SENT, ETHSWT_SENT_TAGGED, ETHSWT_SENT_UNTAGGED}  # Defines how the message with a specific VLAN Id shall be handled.
        container EthSwtPortIngress  # Configuration of one Ethernet Switch Port ingress behavior.
          integer EthSwtPortIngressVlanModification [0..1]: 1..4094  # If this parameter is defined all messages which arrive at this ingress port will be tagged with this VLAN Id. This tagging happen also if the arriving message already has a VLAN Id, it will be overwritten by the defined one. | If this parameter is not defined no changes to the VLAN Id shall happen at this ingress port.
          integer EthSwtPortTrafficClassAssignment [0..1]: 0..7  # If this parameter is defined all arriving messages at this ingress port shall be assigned this traffic class. | If this parameter is not defined no general port based traffic class assignment is done.
          container EthSwtPriorityRegeneration [0..8]  # Defines a priority regeneration where the EthSwtPriorityRegenerationIngressPriority is replaced by EthSwtPriorityRegenerationRegeneratedPriority. | The EthSwtPriorityRegeneration is optional in case no priority regeneration shall be performed. In case a EthSwtPriorityRegeneration is defined it shall have 8 mappings, one for each priority.
            integer EthSwtPriorityRegenerationIngressPriority: 0..7  # Message priority of the incoming message.
            integer EthSwtPriorityRegenerationRegeneratedPriority: 0..7  # Message priority the incoming message will be tagged with.
          container EthSwtPriorityTrafficClassAssignment [0..8]  # Defines a priority based traffic class assignment. All messages with a specific priority (EthSwtPriorityTrafficClassAssignmentPriority) arriving at this ingress port or, if enabled regenerated priorities (EthSwtPriorityRegeneration), shall be assigned to a traffic class (EthSwtPriorityTrafficClassAssignmentTrafficClass).
            integer EthSwtPriorityTrafficClassAssignmentPriority: 0..7  # Message priority.
            integer EthSwtPriorityTrafficClassAssignmentTrafficClass: 0..7  # Traffic Class value.
      container EthSwtSpi [0..1]  # Configuration of one Ethernet Switch SPI access (if SPI is used).
        container EthSwtSpiSequence [1..*]  # Container gives EthSwt driver information about one SPI sequence. | One SPI sequence used by EthSwt driver is in exclusive use for it. No other driver is allowed to access this sequence. EthSwt driver may use one sequence to access n EthSwt hardware chips of the same type or n sequences are used to access one single EthSwt hardware chip. If a EthSwt hardware has no SPI interface, there is no instance of this container.
          boolean EthSwtSpiAccessSynchronous [0..1]  # This parameter is used to define whether the access to the Spi sequence is synchronous or asynchronous. | true: SPI access is synchronous. false: SPI access is asynchronous.
          symbolic name reference EthSwtSpiSequenceName [0..*]: destination=SpiSequence  # Reference to a Spi sequence configuration container.
    container EthSwtGeneral  # General configuration of Ethernet Switch Driver module.
      boolean EthSwtDevErrorDetect  # Switches the Default Error Tracer (Det) detection and notification ON or OFF. | * true: enabled (ON). * false: disabled (OFF).
      boolean EthSwtEnableVlanApi  # Enables / Disables EthSwt_EnableVLAN API.
      boolean EthSwtGetArlTableApi  # Enables / Disables EthSwt_GetArlTable API.
      boolean EthSwtGetBufferLevelApi  # Enables / Disables API to fetch the switch buffer utilization.
      boolean EthSwtGetDropCountApi  # Enables / Disables EthSwt_GetDropCount API.
      boolean EthSwtGetEtherStatsApi  # Enables / Disables EthSwt_GetEtherStats API.
      boolean EthSwtGetMacLearningModeApi  # Enables / Disables EthSwt_GetMacLearningMode API.
      boolean EthSwtGetPortMacAddrApi  # Enables / Disables EthSwt_GetPortMacAddr API.
      boolean EthSwtGetSwitchRegApi  # Enables / Disables EthSwt_GetSwitchReg API.
      integer EthSwtIndex: 0..255  # Specifies the InstanceId of this module instance. If only one instance is present it shall have the Id 0.
      function name EthSwtLinkDownUser [0..1]  # Defines the <User> function name for the <User>_LinkDown callback.
      function name EthSwtLinkUpUser [0..1]  # Defines the <User> function name for the <User>_LinkUp callback.
      boolean EthSwtPersistentConfigurationResult  # Enables / Disables the callback API <User>_PersistentConfigurationResult.
      function name EthSwtPersistentConfigurationResultUser [0..1]  # Defines the <User> function name for the <User>_PersistentConfigurationResult callback.
      string EthSwtPublicCddHeaderFile [0..*]: max-length=32, min-length=1  # Defines header files for callback functions which shall be included in case of CDDs.
      boolean EthSwtReadTrcvRegisterApi  # Enables / Disables EthSwt_ReadTrcvRegister API.
      boolean EthSwtResetConfigurationApi  # Enables / Disables EthSwt_ResetConfiguration API.
      boolean EthSwtSetMacLearningModeApi  # Enables / Disables EthSwt_SetMacLearningMode API.
      boolean EthSwtSetSwitchRegApi  # Enables / Disables EthSwt_SetSwitchReg API.
      boolean EthSwtStoreConfigurationApi  # Enables / Disables EthSwt_StoreConfiguration API.
      boolean EthSwtVersionInfoApi  # Enables / Disables version info API.
      boolean EthSwtWriteTrcvRegisterApi  # Enables / Disables EthSwt_WriteTrcvRegister API.
  module definition EthTSyn [0..1]: variants pre-compile  # Configuration of the Synchronized Time-base Manager (StbM) module with respect to global time handling on Ethernet.
    container EthTSynGeneral  # This container holds the general parameters of the Ethernet-specific Synchronized Time-base Manager
      boolean EthTSynDevErrorDetect  # Switches the Default Error Tracer (Det) detection and notification ON or OFF. | * true: enabled (ON). * false: disabled (OFF).
      boolean EthTSynHardwareTimestampSupport  # Activate/Deactivate the hardware time stamping functionality of the Ethernet hardware. | True: Timestamp is retrieved from the Ethernet hardware False: Timestamp is retrieved from the StbM
      float EthTSynMainFunctionPeriod: 0..Inf  # Schedule period of the main function EthTSyn_MainFunction. Unit: [s].
      boolean EthTSynVersionInfo  # Activate/Deactivate the version information API (EthTSyn_GetVersionInfo). True: version information API activated False: version information API deactivated.
    container EthTSynGlobalTimeDomain [1..*]  # This represents the existence of a global time domain on Ethernet. The EthTSyn module can administrate several global time domains at the same time that in itself form a hierarchy of domains and sub-domains. | If the EthTSyn exists it is assumed that at least one global time domain exists.
      integer EthTSynGlobalTimeDomainId [0..1]: 0..31  # This Parameter is deprecated and will be removed in future. Tags: atp.Status=obsolete, atp.StatusRevisionBegin=4.2.2 | Old description: The global time domain ID. This element is obsolete and will be removed in a future revision.
      float EthTSynGlobalTimeFollowUpTimeout: 0..Inf
      symbolic name reference EthTSynSynchronizedTimeBaseRef: destination=StbMSynchronizedTimeBase  # Mandatory reference to the required synchronized time-base.
      container EthTSynGlobalTimeMaster [0..1]  # Configuration of the global time master. Each global time domain is required to have exactly one global time master. This master may or may not exist on the configured ECU.
        float EthTSynGlobalTimeTxFollowUpOffset: 0..Inf  # This represents configuration of the TX offset for Follow_Up / Pdelay_Resp_Follow_Up messages. Unit: seconds
        float EthTSynGlobalTimeTxPdelayReqPeriod: 0..Inf  # This represents configuration of the TX period for Pdelay_Req messages. Unit: seconds
        float EthTSynGlobalTimeTxPeriod: 0..Inf  # This represents configuration of the TX period. Unit: seconds
        reference EthTSynGlobalTimeEthIfRef: destination=EthIfController  # This represents the reference to the Ethernet interface taken to fetch the global time information.
      container EthTSynGlobalTimeSlave [0..1]  # Configuration of a time slave. Each global time domain is required to have at least one time slave. The configured ECU may or may not represent a time slave.
        float EthTSynGlobalTimeTxFollowUpOffset: 0..Inf  # This represents configuration of the TX offset for Follow_Up / Pdelay_Resp_Follow_Up messages. Unit: seconds
        float EthTSynGlobalTimeTxPdelayReqPeriod: 0..Inf  # This represents configuration of the TX period for Pdelay_Req messages. Unit: seconds
        float EthTSynTimeHardwareCorrectionThreshold [0..1]  # This parameter can be taken to define the maximum deviation between the local time and the time obtained from SYNC message that triggers a correction of the time drift caused by the hardware on the local node.
        reference EthTSynGlobalTimeEthIfRef: destination=EthIfController  # This represents the reference to the Ethernet interface taken to fetch the global time information.
  module definition FrTSyn [0..1]: variants post-build/pre-compile  # This represents the specific configuration variant for the TSyn on Flexray.
    container FrTSynGeneral  # This container holds the general parameters of the Flexray-specific Synchronized Time-base Manager
      boolean FrTSynDevErrorDetect  # Switches the Default Error Tracer (Det) detection and notification ON or OFF. | * true: enabled (ON). * false: disabled (OFF).
      float FrTSynMainFunctionPeriod: 0..Inf  # Schedule period of the main function FrTSyn_MainFunction. Unit: [s].
      boolean FrTSynVersionInfo  # Activate/Deactivate the version information API (FrTSyn_GetVersionInfo). True: version information API activated False: version information API deactivated.
      container FrTSynGlobalTimeOfsDataIDList  # The DataIDList for OFS messages ensures the identification of data elements due to CRC calculation process.
        container FrTSynGlobalTimeOfsDataIDListElement [16..16]  # Element of the DataIDList for OFS messages ensures the identification of data elements due to CRC calculation process.
          integer FrTSynGlobalTimeOfsDataIDListIndex: 0..15  # Index of the DataIDList for OFS messages ensures the identification of data elements due to CRC calculation process.
          integer FrTSynGlobalTimeOfsDataIDListValue: 0..255  # Value of the DataIDList for OFS messages ensures the identification of data elements due to CRC calculation process.
      container FrTSynGlobalTimeSyncDataIDList  # The DataIDList for SYNC messages ensures the identification of data elements due to CRC calculation process.
        container FrTSynGlobalTimeSyncDataIDListElement [16..16]  # Element of the DataIDList for SYNC messages ensures the identification of data elements due to CRC calculation process.
          integer FrTSynGlobalTimeSyncDataIDListIndex: 0..15  # Index of the DataIDList for SYNC messages ensures the identification of data elements due to CRC calculation process.
          integer FrTSynGlobalTimeSyncDataIDListValue: 0..255  # Value of the DataIDList for SYNC messages ensures the identification of data elements due to CRC calculation process.
    container FrTSynGlobalTimeDomain [1..*]  # This represents the existence of a global time domain on Flexray. The FrTSyn module can administrate several global time domains at the same time that in itself form a hierarchy of domains and sub-domains. | If the FrTSyn exists it is assumed that at least one global time domain exists.
      integer FrTSynGlobalTimeDomainId: 0..31  # The global time domain ID.
      integer FrTSynGlobalTimeSequenceCounterJumpWidth: 1..15  # The SequenceCounterJumpWidth specifies the maximum allowed gap of the Sequence Counter between two SYNC resp. two OFS messages.
      symbolic name reference FrTSynSynchronizedTimeBaseRef: destination=StbMSynchronizedTimeBase  # Mandatory reference to the required synchronized time-base.
      container FrTSynGlobalTimeMaster [0..1]  # Configuration of the global time master. Each global time domain is required to have exactly one global time master. This master may or may not exist on the configured ECU.
        enumeration FrTSynGlobalTimeTxCrcSecured: {CRC_NOT_SUPPORTED, CRC_SUPPORTED}  # This represents the configuration of whether or not CRC is supported.
        float FrTSynGlobalTimeTxPeriod: 0..Inf  # This represents the TX period. Unit: seconds
        container FrTSynGlobalTimeMasterPdu  # This container carries all properties required to configure the PDU sent by the global time master for the given global time domain.
          integer FrTSynGlobalTimeMasterConfirmationHandleId: 0..65535, symbolic-name-value=true  # This represents the handle ID of the PDU that contains the global time information.
          reference FrTSynGlobalTimePduRef: destination=Pdu  # This represents the reference to the Pdu taken to transmit the global time information. The global time master of a global time domain acts as the sender of the Pdu while all the time slaves are supposed to receive the Pdu.
      container FrTSynGlobalTimeSlave [0..1]  # This represents the time slave for the enclosing global time domain.
        enumeration FrTSynRxCrcValidated: {CRC_IGNORED, CRC_NOT_VALIDATED, CRC_VALIDATED}  # This parameter controls whether or not CRC validation shall be supported.
        container FrTSynGlobalTimeSlavePdu  # This container carries all properties required to configure the PDU received by the time slave for the given global time domain.
          integer FrTSynGlobalTimeSlaveHandleId: 0..65535, symbolic-name-value=true  # This represents the handle ID of the PDU that contains the global time information.
          reference FrTSynGlobalTimePduRef: destination=Pdu  # This represents the reference to the Pdu taken to transmit the global time information. The global time master of a global time domain acts as the sender of the Pdu while all the time slaves are supposed to receive the Pdu.
  module definition J1939Dcm [0..1]: variants link-time/post-build/pre-compile  # The SAE J1939 Dcm module
    container J1939DcmConfigSet  # This container contains the configuration parameters and sub containers of the AUTOSAR J1939Dcm module.
      container J1939DcmChannel [1..*]  # Contains the J1939DcmChannel parameters.
        enumeration J1939DcmBusType: {J1939DCM_ISO9141, J1939DCM_J1587, J1939DCM_J1850, J1939DCM_J1922, J1939DCM_J1939_NETWORK_1, J1939DCM_J1939_NETWORK_2, J1939DCM_J1939_NETWORK_3, J1939DCM_OTHER}  # Identifies the communication port
        symbolic name reference J1939DcmComMChannelRef: destination=ComMChannel  # Reference to the ComMChannel.
      container J1939DcmNode [1..*]  # Contains the parameters for the support of a logical J1939 node.
        integer J1939DcmSPNsInDataStream [0..*]: 0..524287  # Defines the SPNs available in data stream for use in DM24.
        symbolic name reference J1939DcmNmNodeRef: destination=J1939NmNode  # Reference to the corresponding J1939Nm node.
        symbolic name reference J1939DcmNodeRmUserRef: destination=J1939RmUser  # Reference to the J1939RmUser used by J1939Dcm.
        container J1939DcmDiagnosticMessageSupport [1..*]  # Contains parameters to configure the diagnostic message support
          enumeration J1939DcmDmxSupport: {J1939DCM_DM01_SUPPORT, J1939DCM_DM02_SUPPORT, J1939DCM_DM03_SUPPORT, J1939DCM_DM04_SUPPORT, J1939DCM_DM05_SUPPORT, J1939DCM_DM06_SUPPORT, J1939DCM_DM07_SUPPORT, J1939DCM_DM08_SUPPORT, J1939DCM_DM09_SUPPORT, J1939DCM_DM10_SUPPORT, J1939DCM_DM11_SUPPORT, J1939DCM_DM12_SUPPORT, J1939DCM_DM13_SUPPORT, J1939DCM_DM14_SUPPORT, J1939DCM_DM15_SUPPORT, J1939DCM_DM16_SUPPORT, J1939DCM_DM17_SUPPORT, J1939DCM_DM18_SUPPORT, J1939DCM_DM19_SUPPORT, J1939DCM_DM20_SUPPORT, J1939DCM_DM21_SUPPORT, J1939DCM_DM22_SUPPORT, J1939DCM_DM23_SUPPORT, J1939DCM_DM24_SUPPORT, J1939DCM_DM25_SUPPORT, J1939DCM_DM26_SUPPORT, J1939DCM_DM27_SUPPORT, J1939DCM_DM28_SUPPORT, J1939DCM_DM29_SUPPORT, J1939DCM_DM30_SUPPORT, J1939DCM_DM31_SUPPORT, J1939DCM_DM32_SUPPORT, J1939DCM_DM33_SUPPORT, J1939DCM_DM34_SUPPORT, J1939DCM_DM35_SUPPORT, J1939DCM_DM36_SUPPORT, J1939DCM_DM37_SUPPORT, J1939DCM_DM38_SUPPORT, J1939DCM_DM39_SUPPORT, J1939DCM_DM40_SUPPORT, J1939DCM_DM41_SUPPORT, J1939DCM_DM42_SUPPORT, J1939DCM_DM43_SUPPORT, J1939DCM_DM44_SUPPORT, J1939DCM_DM45_SUPPORT, J1939DCM_DM46_SUPPORT, J1939DCM_DM47_SUPPORT, J1939DCM_DM48_SUPPORT, J1939DCM_DM49_SUPPORT, J1939DCM_DM50_SUPPORT, J1939DCM_DM51_SUPPORT, J1939DCM_DM52_SUPPORT, J1939DCM_DM53_SUPPORT, J1939DCM_DM54_SUPPORT, J1939DCM_DM55_SUPPORT, J1939DCM_DM56_SUPPORT, J1939DCM_DM57_SUPPORT}  # This parameter is used to identify the actual DMx message.
          reference J1939DcmDiagnosticMessageSupportChannelRef: destination=J1939DcmChannel  # Reference to J1939DcmChannel for which this diagnostic message is supported.
          container J1939DcmRxPdu [0..1]  # Contains parameters to configure the J1939DcmRxPdu.
            integer J1939DcmRxPduId: 0..65535, symbolic-name-value=true  # The I-PDU identifier used for communication with PduR.
            reference J1939DcmRxPduRef: destination=Pdu  # Reference to the global Pdu element in the Ecuc module.
          container J1939DcmTxPdu [0..1]  # Contains parameters to configure the J1939DcmTxPdu.
            integer J1939DcmTxPduId: 0..65535, symbolic-name-value=true  # The I-PDU identifier used to identify the Tx message.
            reference J1939DcmTxPduRef: destination=Pdu  # Reference to the global Pdu element in the Ecuc module.
    container J1939DcmGeneral  # Contains the general configuration parameters of the module.
      integer J1939DcmCommonBufferSize: 1..65535  # Size of common buffer (in Bytes). The buffer size should be as large as the longest command or response message.
      integer J1939DcmDM01BufferSize [0..1]: 1..65535  # Size of DM01 buffer (in Bytes). The buffer size should be as large as the longest DM01 response message.
      boolean J1939DcmDevErrorDetect  # Switches the Default Error Tracer (Det) detection and notification ON or OFF. | * true: enabled (ON). * false: disabled (OFF).
      float J1939DcmMainFunctionPeriod: 0.001..0.255  # Call cycle in seconds of J1939Dcm_MainFunction.
      integer J1939DcmMaxDTCsPerMainFunction [0..1]: 1..255  # Maximum threshold of DTCs filtered in a single MainFunction cycle.
      integer J1939DcmMaxFreezeFramesPerMainFunction [0..1]: 1..255  # Maximum threshold of FreezeFrames filtered in a single MainFunction cycle.
      integer J1939DcmMaxRatiosPerMainFunction [0..1]: 1..255  # Maximum threshold of Ratios filtered in a single MainFunction cycle.
      boolean J1939DcmVersionInfoApi  # Pre-processor switch for enabling version info API support.
  module definition J1939Nm [0..1]: variants link-time/post-build/pre-compile  # Configuration of the J1939 Network Management module.
    container J1939NmConfigSet  # This container is a MultipleConfigurationContainer, i.e. this container and its sub-containers exist once per configuration set.
      container J1939NmChannel [1..*]  # Physical CAN channel handled by J1939Nm.
        boolean J1939NmChannelUsesAddressArbitration: default-value=true  # Defines whether the nodes attached to this channel use an initial address claim, and whether they react to contending address claims of other nodes. | True: The initial address claim is sent, and the node reacts to address claims of other nodes. False: The node only sends an address claim upon request, and does not react to other address claims.
        symbolic name reference J1939NmComMNetworkHandleRef: destination=ComMChannel  # Reference to the channel defined by the ComMChannel providing access to the unique channel index ComMChannelId.
        container J1939NmRxPdu  # Contains the configuration of the I-PDU used to receive the AddressClaimed PG.
          integer J1939NmRxPduId: 0..65535, symbolic-name-value=true  # The I-PDU identifier used for RxIndication from CanIf.
          reference J1939NmRxPduRef: destination=Pdu  # Reference to the Pdu object representing the I-PDU.
        container J1939NmTxPdu  # Contains the configuration of the I-PDU used to transmit the AddressClaimed PG.
          integer J1939NmTxPduId: 0..65535, symbolic-name-value=true  # The I-PDU identifier used for TxConfirmation from CanIf.
          reference J1939NmTxPduRef: destination=Pdu  # Reference to the Pdu object representing the I-PDU.
      container J1939NmNode [1..*]  # Logical node representing one function handled by J1939Nm.
        integer J1939NmNodeId: 0..255, symbolic-name-value=true  # Unique identifier of this node.
        boolean J1939NmNodeNameArbitraryAddressCapable  # Arbitrary Address Capable field of the NAME of this node.
        integer J1939NmNodeNameECUInstance: 0..7  # ECU Instance field of the NAME of this node.
        integer J1939NmNodeNameFunction: 0..255  # Function field of the NAME of this node.
        integer J1939NmNodeNameFunctionInstance: 0..31  # Function Instance field of the NAME of this node.
        integer J1939NmNodeNameIdentityNumber: 0..2097151  # Identity Number field of the NAME of this node.
        integer J1939NmNodeNameIndustryGroup: 0..7  # Industry Group field of the NAME of this node.
        integer J1939NmNodeNameManufacturerCode: 0..2047  # Manufacturer Code field of the NAME of this node.
        integer J1939NmNodeNameVehicleSystem: 0..127  # Vehicle System field of the NAME of this node.
        integer J1939NmNodeNameVehicleSystemInstance: 0..15  # Vehicle System Instance field of the NAME of this node.
        integer J1939NmNodePreferredAddress: 0..253  # Source address of this node used for address claiming.
        boolean J1939NmNodeStartUpDelay: default-value=true  # If enabled, the node will start communication after a delay of 250ms after transmission of the initial AddressClaimed, depending on the configured J1939NmNodePreferredAddress. If disabled, the node will start communication immediately at network start-up. | Please note: According to J1939/81, the 250ms delay is not required for single address CAs with desired source addresses in the ranges 0..127 or 248..253.
        reference J1939NmNodeChannelRef [1..*]: destination=J1939NmChannel  # Reference to the channels this node has access to.
    container J1939NmDemEventParameterRefs [0..1]  # Container for the references to DemEventParameter elements which shall be invoked using the API Dem_ReportErrorStatus in case the corresponding error occurs. The EventId is taken from the referenced DemEventParameter's DemEventId value. The standardized errors are provided in the container and can be extended by vendor specific error references.
      symbolic name reference J1939NM_E_ADDRESS_LOST: destination=DemEventParameter  # Reference to the DemEventParameter which shall be issued when the ECU failed to claim one of its addresses.
    container J1939NmGeneral  # Contains the general configuration parameters of the module.
      float J1939NmBusOffDelayTickPeriod [0..1]: 0.001..0.255, default-value=0.02  # Duration of ticks that are used to time BusOff delays after conflicting address claims. This parameter must be synchronized with the main function period of the CAN State Manager.
      boolean J1939NmDevErrorDetect  # Switches the Default Error Tracer (Det) detection and notification ON or OFF. | * true: enabled (ON). * false: disabled (OFF).
      float J1939NmMainFunctionPeriod: 0.001..0.255, default-value=0.01  # Call cycle in seconds of J1939Nm_MainFunction.
      float J1939NmTxConfirmationTimeout: 0..65.535, default-value=1.5  # Time in seconds to wait for a confirmation after transmission of a message. The behaviour when the time elapses depends on the transmitted message.
      function name J1939NmUserCallout [0..1]  # Pre-processor switch for enabling the <User_AddressClaimedIndication> and defining the name of the callout function.
      string J1939NmUserCalloutHeaderFile [0..1]  # Header file which is included by J1939Nm when J1939NmUserCallout is enabled. This header file must provide the prototype of the <User_AddressClaimedIndication> defined in J1939NmUserCallout.
      boolean J1939NmVersionInfoApi  # Pre-processor switch for enabling version info API support.
  module definition J1939Rm [0..1]: variants link-time/post-build/pre-compile  # Configuration of the J1939 Request Manager.
    container J1939RmConfigSet  # This container contains the configuration parameters and sub containers of the AUTOSAR J1939Rm module.
      container J1939RmChannel [1..*]  # Contains the parameters for a CAN channel supported by the J1939 Request Manager.
        integer J1939RmAckQueueSize: 0..255  # Number of transmitted acknowledgements that can be stored.
        integer J1939RmRequestQueueSize: 0..255  # Number of transmitted requests that can be stored.
        integer J1939RmRequestTimeoutMonitors: 0..255  # Number of transmitted requests that can be monitored for timeout.
        symbolic name reference J1939RmComMNetworkHandleRef: destination=ComMChannel  # Reference to the channel defined by the ComMChannel providing access to the unique channel index ComMChannelId.
        container J1939RmAckmRxPdu [0..1]  # Contains the configuration of the I-PDU used to receive the Acknowledgement PG.
          integer J1939RmAckmRxPduId: 0..65535, symbolic-name-value=true  # The I-PDU identifier used for RxIndication from PduR.
          reference J1939RmAckmRxPduRef: destination=Pdu  # Reference to the Pdu object representing the I-PDU.
        container J1939RmAckmTxPdu [0..1]  # Contains the configuration of the I-PDU used to transmit the Acknowledgement PG.
          integer J1939RmAckmTxPduId: 0..65535, symbolic-name-value=true  # The I-PDU identifier used for TxConfirmation from PduR.
          reference J1939RmAckmTxPduRef: destination=Pdu  # Reference to the Pdu object representing the I-PDU.
        container J1939RmRqstRxPdu [0..1]  # Contains the configuration of the I-PDU used to receive the Request PG.
          integer J1939RmRqstRxPduId: 0..65535, symbolic-name-value=true  # The I-PDU identifier used for RxIndication from PduR.
          reference J1939RmRqstRxPduRef: destination=Pdu  # Reference to the Pdu object representing the I-PDU.
        container J1939RmRqstTxPdu [0..1]  # Contains the configuration of the I-PDU used to transmit the Request PG.
          integer J1939RmRqstTxPduId: 0..65535, symbolic-name-value=true  # The I-PDU identifier used for TxConfirmation from PduR.
          reference J1939RmRqstTxPduRef: destination=Pdu  # Reference to the Pdu object representing the I-PDU.
      container J1939RmNode [1..*]  # Contains the parameters for the support of a logical J1939 node (identified by an ECU address).
        reference J1939RmNodeChannelRef [1..*]: destination=J1939RmChannel  # Reference to the channels this node has access to.
        symbolic name reference J1939RmNmNodeRef: destination=J1939NmNode  # Reference to the corresponding J1939Nm node.
        container J1939RmUser [1..*]  # Contains the configuration of a module that uses the request and acknowledgement interfaces of J1939Rm.
          boolean J1939RmUserAckIndication  # Enable AckIndication for this module. In case of CDD, the name is <apiServicePrefix>_AckIndication. In case of RTE, the operation AckIndication of the required port J1939Rm_AckIndication_{user} is called. | This parameter shall not be set for J1939RmUserType J1939RM_USER_J1939NM, J1939RM_USER_J1939DCM, or J1939RM_USER_COM.
          integer J1939RmUserAckPGN [0..*]: 0..262143  # PGN supported to be acknowledged to this module. The PGNs supported by different modules should usually be disjunctive. | This parameter shall not be set for J1939RmUserType J1939RM_USER_J1939NM, J1939RM_USER_J1939DCM, and J1939RM_USER_COM.
          integer J1939RmUserId [0..1]: 0..65535, symbolic-name-value=true  # Identifier used by a module using J1939Rm. This parameter is only required when the module uses transmission of requests.
          integer J1939RmUserPGN [0..*]: 0..262143  # PGN supported to be requested from this module. The PGNs supported by different modules should usually be disjunctive. | This parameter is predefined to AC (0x0EE00) for J1939RmUserType J1939RM_USER_J1939NM and is derived from the J1939Dcm PDUs in the system description for J1939RmUserType J1939RM_USER_J1939DCM. It shall not be set for J1939RmUserType J1939RM_USER_COM.
          boolean J1939RmUserRequestIndication  # Enable RequestIndication for this module. In case of J1939Nm or J1939Dcm, the name is fixed. In case of CDD, the name is <apiServicePrefix>_RequestIndication. In case of RTE, J1939Rm will call the operation RequestIndication of the required port J1939Rm_RequestIndication_{user}. | This parameter shall not be set for J1939RmUserType J1939RM_USER_COM.
          boolean J1939RmUserSendAck  # Enable the SendAck API for this module. In case of RTE, the operation SendAck of the provided port J1939Rm_SendAck_{user} is called. | This parameter shall not be set for J1939RmUserType J1939RM_USER_J1939NM or J1939RM_USER_COM.
          boolean J1939RmUserSendRequest  # Enable the SendRequest API for this module. In case of RTE, the operation SendRequest of the provided port J1939Rm_SendRequest_{user} is called. | This parameter shall not be set for J1939RmUserType J1939RM_USER_J1939NM, J1939RM_USER_J1939DCM, or J1939RM_USER_COM.
          boolean J1939RmUserTimeoutSupervision  # Enable RequestTimeoutIndication and CancelRequestTimeout for this module. | RequestTimeoutIndication: In case of CDD, the name is <apiServicePrefix>_RequestTimeoutIndication. In case of RTE, the operation RequestTimeoutIndication of the required port J1939Rm_RequestTimeoutIndication_{user} is called. CancelRequestTimeout: In case of RTE, the operation CancelRequestTimeout of the provided port J1939Rm_CancelRequestTimeout_{user} is called. This parameter shall not be set for J1939RmUserType J1939RM_USER_J1939NM, J1939RM_USER_J1939DCM, or J1939RM_USER_COM.
          enumeration J1939RmUserType: {J1939RM_USER_CDD, J1939RM_USER_COM, J1939RM_USER_J1939DCM, J1939RM_USER_J1939NM, J1939RM_USER_RTE}  # Type of module using J1939Rm.
          foreign reference J1939RmUserCddRef [0..1]: destination-type=ECUC-MODULE-CONFIGURATION-VALUES  # Reference to the CDD module description. | This parameter is only required for J1939RmUserType J1939RM_USER_CDD.
          container J1939RmComIPdu [0..*]  # Contains the configuration of an I-PDU that is to be transmitted on request by COM. This configuration container is only relevant for J1939RmUserType J1939RM_USER_COM.
            integer J1939RmComIPduPGN: 0..262143  # PGN of the COM I-PDU.
            reference J1939RmComIPduRef: destination=Pdu  # Reference to the Pdu object representing the I-PDU.
    container J1939RmGeneral  # Contains the general configuration parameters of the module.
      boolean J1939RmDevErrorDetect  # Switches the Default Error Tracer (Det) detection and notification ON or OFF. | * true: enabled (ON). * false: disabled (OFF).
      float J1939RmMainFunctionPeriod: 0.001..0.255  # Execution cycle of J1939Rm_MainFunction in seconds.
      boolean J1939RmSupportAckIndication  # Pre-processor switch for enabling support of acknowledgement indications.
      boolean J1939RmSupportAckTransmission  # Pre-processor switch for enabling support of acknowledgement transmission.
      boolean J1939RmSupportRequestIndication  # Pre-processor switch for enabling support of request indications.
      boolean J1939RmSupportRequestTransmission  # Pre-processor switch for enabling support of request transmission.
      boolean J1939RmSupportTimeoutSupervision  # Pre-processor switch for enabling support of request timeout supervision.
      float J1939RmTxConfirmationTimeout: 0..65.535  # Time in seconds to wait for a confirmation after transmission of a message. The behaviour when the time elapses depends on the transmitted message.
      boolean J1939RmVersionInfoApi  # Pre-processor switch for enabling version info API support.
  module definition LdCom [0..1]: variants link-time/post-build/pre-compile  # Configuration of the AUTOSAR LdCom module.
    container LdComConfig  # This container contains the configuration parameters and sub containers of the AUTOSAR LdCom module.
      container LdComIPdu [0..*]  # Contains the configuration parameters of the IPdu inside LdCom.
        enumeration LdComApiType: {LDCOM_IF, LDCOM_TP}  # Defines if this I-PDU is a normal I-PDU that shall be sent unfragmented or if this is a large I-PDU that shall be sent via the Transport Protocol of the underlying bus. | This setting is used by RTE to invoke the proper API.
        integer LdComHandleId: 0..65535, symbolic-name-value=true  # This is the ID used by RTE to invoke LdCom. | A corresponding shortName is created, which is used for the invocations of the RTE. The same ID is used for invocations by PduR.
        enumeration LdComIPduDirection: {LDCOM_RECEIVE, LDCOM_SEND}  # The direction defines if this IPdu, and therefore the contributing signal, shall be sent or received.
        function name LdComRxCopyRxData [0..1]  # Only on receiver side: Name of Rte_LdComCbkCopyRxData callback function to be called.
        function name LdComRxIndication [0..1]  # Only on receiver side: Name of Rte_LdComCbkRxIndication callback function to be called.
        function name LdComRxStartOfReception [0..1]  # Only on receiver side: Name of Rte_LdComCbkStartOfReception callback function to be called.
        function name LdComTpRxIndication [0..1]  # Only on receiver side: Name of Rte_LdComCbkTpRxIndication callback function to be called.
        function name LdComTpTxConfirmation [0..1]  # Only on sender side: Name of Rte_LdComCbkTpTxConfirmation callback function to be called.
        function name LdComTxConfirmation [0..1]  # Only on sender side: Name of Rte_LdComCbkTxConfirmation callback function to be called.
        function name LdComTxCopyTxData [0..1]  # Only on sender side: Name of Rte_LdComCbkCopyTxData callback function to be called.
        function name LdComTxTriggerTransmit [0..1]  # Only on sender side: Name of Rte_LdComCbkTriggerTransmit callback function to be called. If defined TriggerTransmit has to be supported for this signal.
        foreign reference LdComSystemTemplateSignalRef [0..1]: destination-type=I-SIGNAL-TO-I-PDU-MAPPING  # Reference to the ISignalToIPduMapping that contains a reference to the ISignal (System Template) which this LdCom signal represents.
        reference LdComPduRef: destination=Pdu  # Reference to the global Pdu.
    container LdComGeneral  # Contains the general configuration parameters of the LdCom module.
      boolean LdComDevErrorDetect  # Switches the Default Error Tracer (Det) detection and notification ON or OFF. | * true: enabled (ON). * false: disabled (OFF).
      boolean LdComVersionInfoApi  # Activate/Deactivate the version information API (LdCom_GetVersionInfo). | * True: version information API activated * False: version information API deactivated
  module definition Sd [0..1]: variants link-time/post-build/pre-compile  # Configuration of the Service Discovery module.
    container SdConfig  # This container contains the configuration parameters and sub containers of the AUTOSAR Service Discovery module.
      container SdInstance [0..*]  # This container represents an instance of the SD; i.e. the SD configuration for a certain link.
        string SdInstanceHostname [0..1]  # Configuration parameter to specify the Hostname.
        container SdClientService [0..*]  # This container specifies all parameters used by Client services.
          boolean SdClientServiceAutoRequire: default-value=false  # If existing and set to true, this Service will be set to "required" on start.
          integer SdClientServiceHandleId: 0..65535, symbolic-name-value=true  # The HandleId by which the BswM can identify this Client Service Instance.
          integer SdClientServiceId: 0..65534  # Id to identify the service. This is unique for the service interface.
          integer SdClientServiceInstanceId: 0..65534  # Configuration parameter to specify Instance Id of the service as used in SD entries.
          integer SdClientServiceMajorVersion: 0..254  # Major version number of the Service as used in the SD entries.
          integer SdClientServiceMinorVersion: 0..4294967295  # Minor version number of the Service as used in the SD Service Entries.
          reference SdClientServiceTcpRef [0..1]: destination=SoAdSocketConnectionGroup  # Reference to the SoAdSocketConnection representing the data path (TCP) for communication with methods. | This element is also used to set the remote address of the server and to open the TCP connection.
          reference SdClientServiceTimerRef: destination=SdClientTimer  # The reference of the SdClientTimer container for this service.
          reference SdClientServiceUdpRef [0..1]: destination=SoAdSocketConnectionGroup  # Reference to the SoAdSocketConnection representing the data path (UDP) for communication with methods. | This element is also used to set the remote address of the server.
          container SdClientCapabilityRecord [0..*]  # Sd uses capability records to store arbitrary name/value pairs conveying additional information about the named service. | The following use cases are supported: 1) Key present, with no value (e.g. "passreq" -- password required for this service) 2) Key present, with empty value (e.g. "PlugIns=" server supports plugins, but none are presently installed) 3) Key present, with non-empty value (e.g. "PlugIns=JPEG,MPEG2,MPEG4")
            string SdClientServiceCapabilityRecordKey  # Defines a CapabilityRecord key.
            string SdClientServiceCapabilityRecordValue [0..1]  # Defines the corresponding CapabilityRecord value.
          container SdConsumedEventGroup [0..*]  # A Service may have event groups which can be consumed. A service consumer has to subscribe to the corresponding event-group. After the subscription the event consumer takes the role of a server and the event provider that of a client.
            boolean SdConsumedEventGroupAutoRequire: default-value=false  # If existing and set to true, this EventGroup will be set to "required" on start.
            integer SdConsumedEventGroupHandleId: 0..65535, symbolic-name-value=true  # The HandleId by which the BswM can identify this EventGroup.
            integer SdConsumedEventGroupId: 0..65534  # The Eventgroup Id of this eventGroup as a unique identifier of the eventgroup in this service. This identifier is used for EventGroup entries as well.
            reference SdConsumedEventGroupMulticastGroupRef [0..*]: destination=SoAdSocketConnectionGroup  # Reference to the SoAdSocketConnectionGroup representing the multicast data path (UDP).
            reference SdConsumedEventGroupTimerRef: destination=SdClientTimer  # The reference of the SdClientTimer container for this eventGroup.
            symbolic name reference SdConsumedEventGroupMulticastActivationRef [0..1]: destination=SoAdRoutingGroup  # The reference of a Routing Group in order to activate and setup the Socket Connection for Multicast Events of this EventGroup. The multicast address from the received Multicast option is setup by SoAd_RequestIpAddrAssignment. | The local address is the same as for the unicast events; thus, it was sent in the UDP Endpoint option of the Subscribe EventGroup entry.
            symbolic name reference SdConsumedEventGroupTcpActivationRef [0..1]: destination=SoAdRoutingGroup  # The reference of the Routing Group for activation of the data path for receiving TCP events. | This element is also being used for getting the IP address and port number for building the TCP endpoint option for the Subscribe EventGroup entry. If no TCP methods are used in the service, this element is also being used for setting the remote address (TCP Endpoint option referenced by the Offer Service entry) and opening the TCP connection to the server before sending the Subscribe EventGroup entry. If multiple EventGroups of the same Service Instance are subscribed the TCP connection will be shared and must be opened only once.
            symbolic name reference SdConsumedEventGroupUdpActivationRef [0..1]: destination=SoAdRoutingGroup  # The reference of the Routing Group for activation of the data path for receiving UDP events. | This element is also being used for getting the IP address and port number for building the UDP endpoint option for the Subscribe EventGroup entry. If no UDP methods are used in the service, this element is also being used for setting the remote address (UDP Endpoint option referenced by the Offer Service entry). If multiple EventGroups of the same Service Instance are subscribed the UDP Socket Connection will be shared and must be set only once.
            container SdClientCapabilityRecord [0..*]  # Sd uses capability records to store arbitrary name/value pairs conveying additional information about the named service. | The following use cases are supported: 1) Key present, with no value (e.g. "passreq" -- password required for this service) 2) Key present, with empty value (e.g. "PlugIns=" server supports plugins, but none are presently installed) 3) Key present, with non-empty value (e.g. "PlugIns=JPEG,MPEG2,MPEG4")
              string SdClientServiceCapabilityRecordKey  # Defines a CapabilityRecord key.
              string SdClientServiceCapabilityRecordValue [0..1]  # Defines the corresponding CapabilityRecord value.
          container SdConsumedMethods [0..1]  # Container element for representing the data path for accessing the server methods.
            symbolic name reference SdClientServiceActivationRef: destination=SoAdRoutingGroup  # Reference to a SoAdRoutingGroupRef to activate/deactivate the data path for the methods.
        container SdClientTimer [0..*]  # This container specifies all timers used by the Service Discovery module for Client Services.
          float SdClientTimerInitialFindDelayMax [0..1]: 0..Inf  # Max value in [s] to delay randomly the transmission of a find message. This parameter is mandatory for ClientService.
          float SdClientTimerInitialFindDelayMin [0..1]: 0..Inf  # Min value in [s] to delay randomly the transmission of a find message. This parameter is mandatory for ClientService.
          float SdClientTimerInitialFindRepetitionsBaseDelay [0..1]: 0..Inf  # The base delay in [s] for find repetitions. Successive finds have an exponential back off delay (1x base delay, 2x base delay, 4x base delay, ...). This parameter is mandatory for ClientService.
          integer SdClientTimerInitialFindRepetitionsMax [0..1]: 0..10  # Configuration for the maximum number of find repetitions. This parameter is mandatory for ClientService.
          float SdClientTimerRequestResponseMaxDelay [0..1]: 0..Inf  # Maximum allowable response delay to entries received by multicast in seconds. This parameter is mandatory for ConsumedEventGroups.
          float SdClientTimerRequestResponseMinDelay [0..1]: 0..Inf  # Minimum allowable response delay to the find message in seconds. This parameter is mandatory for ConsumedEventGroups.
          integer SdClientTimerTTL: 1..16777215  # Time to live for find and subscribe messages.
        container SdInstanceDemEventParameterRefs [0..1]  # Container for the references to DemEventParameter elements which shall be invoked using the API Dem_ReportErrorStatus API in case the corresponding error occurs. The EventId is taken from the referenced DemEventParameter's DemEventId value. The standardized errors are provided in the container and can be extended by vendor specific error references.
          symbolic name reference SD_E_MALFORMED_MSG [0..1]: destination=DemEventParameter  # Reference to the DemEventParameter which shall be issued when the SD Instance received malformed messsage.
          symbolic name reference SD_E_OUT_OF_RES [0..1]: destination=DemEventParameter  # Reference to the DemEventParameter which shall be issued when the SD Instance does not have enough resources to handle client.
          symbolic name reference SD_E_SUBSCR_NACK_RECV [0..1]: destination=DemEventParameter  # Reference to the DemEventParameter which shall be issued when receiving SubscribeEventgroupNack entry.
        container SdInstanceMulticastRxPdu  # This container specifies the received PDU.
          integer SdRxPduId: 0..65535  # ID of the PDU that will be received via the API Sd_SoAdIfRxIndication().
          reference SdRxPduRef: destination=Pdu  # Reference to the "global" Pdu structure to allow harmonization of handle IDs in the COM-Stack.
        container SdInstanceTxPdu  # This container specifies the transmitted PDU.
          reference SdTxPduRef: destination=Pdu  # Reference to the "global" Pdu structure to allow harmonization of handle IDs in the COM-Stack.
        container SdInstanceUnicastRxPdu  # This container specifies the received PDU.
          integer SdRxPduId: 0..65535  # ID of the PDU that will be received via the API Sd_SoAdIfRxIndication().
          reference SdRxPduRef: destination=Pdu  # Reference to the "global" Pdu structure to allow harmonization of handle IDs in the COM-Stack.
        container SdServerService [0..*]  # This container specifies all parameters used by Server services.
          boolean SdServerServiceAutoAvailable: default-value=false  # If existing and set to true, this Service will be set to "Available" on start.
          integer SdServerServiceHandleId: 0..65535, symbolic-name-value=true  # The HandleId by which the BswM can identify this Server Service Instance.
          integer SdServerServiceId: 0..65534  # Id to identify the service. This is unique for the service interface.
          integer SdServerServiceInstanceId: 0..65534  # Configuration parameter to specify Instance Id of the Service implemented by the Server Service.
          integer SdServerServiceMajorVersion: 0..254  # Major version number of the Service as used in SD Entries.
          integer SdServerServiceMinorVersion: 0..4294967294  # Minor version number of the Service as used e.g. in Offer Service entries.
          reference SdServerServiceTcpRef [0..1]: destination=SoAdSocketConnectionGroup  # Reference to SoAdSocketConnectionGroup used for methods. | This is used to access the local IP address and port for building the endpoint option for offers of this service.
          reference SdServerServiceTimerRef: destination=SdServerTimer  # The reference of the SdServerTimer container for this service.
          reference SdServerServiceUdpRef [0..1]: destination=SoAdSocketConnectionGroup  # Reference to SoAdSocketConnectionGroup used for methods. | This is used to access the local IP address and port for building the endpoint option for offers of this service.
          container SdEventHandler [0..*]  # Container Element for representing an EventGroup as part of the Service Instance.
            integer SdEventHandlerEventGroupId: 0..65534  # The EventGroup Id of this EventGroup as a unique identifier of the EventGroup in this service. This identifier is used for EventGroup entries as well.
            integer SdEventHandlerHandleId: 0..65535, symbolic-name-value=true  # The HandleId by which the BswM can identify this EventGroup.
            integer SdEventHandlerMulticastThreshold: 0..65535  # Specifies the number of subscribed clients that trigger the Server to change the transmission of events to Multicast. | If configured to 0 only unicast will be used. If configured to 1 the first client will be already served by multicast. If configured to 2 the first client will be served with unicast and as soon as the second client arrives both will be served by multicast. This does not influence the handling of initial events, which are served using unicast only.
            reference SdEventHandlerTimerRef: destination=SdServerTimer  # The reference of the SdServerTimer container for this EventGroup.
            container SdEventHandlerMulticast [0..1]  # The subcontainer including the Routing Group for Activation of Events sent over Multicast. | The activation ref is also being used for identification of the related Socket Connection in order to find the Multicast Address used in the Multicast Option referenced by the Subscribe EventGroup Ack entry.
              symbolic name reference SdEventActivationRef [0..1]: destination=SoAdRoutingGroup  # Reference to a SoAdRoutingGroup for activation of the data path for a subscribed client (start sending events after subscribe).
              symbolic name reference SdMulticastEventSoConRef [0..1]: destination=SoAdSocketConnection  # Reference to the SoAdSocketConnection representing the multicast data path (UDP).
            container SdEventHandlerTcp [0..1]  # The subcontainer including the Routing Groups for Activation and Trigger Transmit for Events sent over TCP. | The activation ref (or triggering ref if no activation ref exists) is also being used for identification of the related socket connections in order to find the related client by iterating the SdEventHandlerTcp elements (remote address statically configured or automatically set by opening TCP connection before subscription).
              symbolic name reference SdEventActivationRef [0..1]: destination=SoAdRoutingGroup  # Reference to a SoAdRoutingGroup for activation of the data path for a subscribed client (start sending events after subscribe).
              symbolic name reference SdEventTriggeringRef [0..1]: destination=SoAdRoutingGroup  # Reference to a SoAdRoutingGroup that is used for triggered transmit. Triggering is needed to sent out initial events on the server side after a client got subscribed.
            container SdEventHandlerUdp [0..1]  # The subcontainer including the Routing Groups for Activation and Trigger Transmit for Events sent over UDP. | The activation ref (or triggering ref if no activation ref exists) is also being used for identification of the related socket connections in order to set the remote address of the client or find the related client by iterating the SdEventHandlerUdp elements (remote address statically configured or automatically set by method call before subscription).
              symbolic name reference SdEventActivationRef [0..1]: destination=SoAdRoutingGroup  # Reference to a SoAdRoutingGroup for activation of the data path for a subscribed client (start sending events after subscribe).
              symbolic name reference SdEventTriggeringRef [0..1]: destination=SoAdRoutingGroup  # Reference to a SoAdRoutingGroup that is used for triggered transmit. Triggering is needed to sent out initial events on the server side after a client got subscribed.
            container SdServerCapabilityRecord [0..*]  # Sd uses capability records to store arbitrary name/value pairs conveying additional information about the named service. | The following use cases are supported: 1) Key present, with no value (e.g. "passreq" -- password required for this service) 2) Key present, with empty value (e.g. "PlugIns=" server supports plugins, but none are presently installed) 3) Key present, with non-empty value (e.g. "PlugIns=JPEG,MPEG2,MPEG4")
              string SdServerCapabilityRecordKey  # Defines a CapabilityRecord key.
              string SdServerCapabilityRecordValue [0..1]  # Defines the corresponding CapabilityRecord value.
          container SdProvidedMethods [0..1]  # Container element for representing the needed elements of the data path for the methods provided by the service.
            symbolic name reference SdServerServiceActivationRef: destination=SoAdRoutingGroup  # Reference to a SoAdRoutingGroup to activated and deactivate the data path for methods of the service.
          container SdServerCapabilityRecord [0..*]  # Sd uses capability records to store arbitrary name/value pairs conveying additional information about the named service. | The following use cases are supported: 1) Key present, with no value (e.g. "passreq" -- password required for this service) 2) Key present, with empty value (e.g. "PlugIns=" server supports plugins, but none are presently installed) 3) Key present, with non-empty value (e.g. "PlugIns=JPEG,MPEG2,MPEG4")
            string SdServerCapabilityRecordKey  # Defines a CapabilityRecord key.
            string SdServerCapabilityRecordValue [0..1]  # Defines the corresponding CapabilityRecord value.
        container SdServerTimer [0..*]  # This container specifies all timers used by the Service Discovery module for Server Services.
          float SdServerTimerInitialOfferDelayMax [0..1]: 0..Inf  # Max value in [s] to delay randomly the first offer. This parameter is mandatory for ServerService.
          float SdServerTimerInitialOfferDelayMin [0..1]: 0..Inf  # Min value in [s] to delay randomly the first offer. This parameter is mandatory for ServerService.
          float SdServerTimerInitialOfferRepetitionBaseDelay [0..1]: 0..Inf  # The base delay in [s] for offer repetitions. Successive offers have an exponential back off delay (1x base delay, 2x base delay, 4x base delay, ...). This parameter is mandatory for ServerService.
          integer SdServerTimerInitialOfferRepetitionsMax [0..1]: 0..10  # Configure the maximum amount of offer repetition. This parameter is mandatory for ServerService.
          float SdServerTimerOfferCyclicDelay [0..1]: 0..Inf  # Interval between cyclic offers in the main phase. This parameter is mandatory for ServerService.
          float SdServerTimerRequestResponseMaxDelay: 0..Inf  # Maximum allowable response delay to entries received by multicast in seconds.
          float SdServerTimerRequestResponseMinDelay: 0..Inf  # Minimum allowable response delay to entries received by multicast in seconds.
          integer SdServerTimerTTL: 1..16777215  # Time to live for offer service.
    container SdGeneral  # This container lists the general configuration parameters for the Service Discovery module.
      boolean SdDevErrorDetect  # Switches the Default Error Tracer (Det) detection and notification ON or OFF. | * true: enabled (ON). * false: disabled (OFF).
      float SdMainFunctionCycleTime: 1E-4..1  # This parameter defines the cycle time in seconds of the periodic calling of Sd main function.
      boolean SdVersionInfoApi  # Enables and disables the version info API.
  module definition SecOC [0..1]: variants link-time/post-build/pre-compile  # Configuration of the SecOC (SecureOnboardCommunication) module.
    container SecOCGeneral  # Contains the general configuration parameters of the SecOC module.
      boolean SecOCDevErrorDetect  # Switches the Default Error Tracer (Det) detection and notification ON or OFF. | * true: enabled (ON). * false: disabled (OFF).
      float SecOCMainFunctionPeriod: 0..0.255  # Allows to configure the time for the MainFunction (as float in seconds).
      string SecOCMaxAlignScalarType  # The scalar type which has the maximum alignment restrictions on the given platform. This type can be e.g. uint8, uint16 or uint32.
      function name SecOCVerificationStatusCallout [0..*]  # Entry address of the customer specific call out routine which shall be invoked in case of a verification attempt.
      boolean SecOCVersionInfoApi  # If true the SecOC_GetVersionInfo API is available.
      symbolic name reference SecOCNvMBlockDescriptor: destination=NvMBlockDescriptor  # Reference to NVRAM block containing the none volatile data. If this parameter is not configured it means that no NVRAM is used at all.
    container SecOCRxPduProcessing [0..*]  # Contains the parameters to configure the RxPdus to be verified by the SecOC module.
      integer SecOCAuthInfoTxLength: 0..65535  # This parameter defines the length in bits of the authentication code to be included in the payload of the Secured I-PDU.
      integer SecOCDataId: 0..65535  # This parameter defines a unique numerical identifier for the Secured I-PDU.
      integer SecOCFreshnessCounterSyncAttempts [0..1]: 0..65535  # This parameter defines the number of Freshness Counter re-synchronization attempts when a verification failed for a Secured I-PDU. If the value is zero, there will be no additional verification attempt to synchronize with a potentially better fitting Freshness Counter value. This parameter is only applicable if SecOCUseFreshnessTimestamp is FALSE.
      integer SecOCFreshnessTimestampTimePeriodFactor: 0..4294967295  # This parameter defines a factor that specifies the time period for the Freshness Timestamp. It holds a multiplication factor that specifies the concrete meaning of a Freshness Timestamp increment by one on basis of microseconds.
      integer SecOCFreshnessValueId: 0..65535  # This parameter defines the Id of the Freshness Value. | The Freshness Value might be a normal counter or a time value.
      integer SecOCFreshnessValueLength: 0..64  # This parameter defines the complete length in bits of the Freshness Value. As long as the key doesn't change the counter shall not overflow. The length of the counter shall be determined based on the expected life time of the corresponding key and frequency of usage of the counter.
      integer SecOCFreshnessValueTxLength: 0..64  # This parameter defines the length in bits of the Freshness Value to be included in the payload of the Secured I-PDU. This length is specific to the least significant bits of the complete Freshness Counter. If the parameter is 0 no Freshness Value is included in the Secured I-PDU.
      integer SecOCKeyId: 0..65535  # This parameter specifies the local Key identifier of the stored Key used to generate or verify a MAC.
      float SecOCRxAcceptanceWindow [0..1]: 0..Inf  # This parameter defines the maximum allowed deviation in seconds from the expected timestamp for which a Secured I-PDU is still deemed authentic. | This parameter is only applicable if SecOCUseFreshnessTimestamp is TRUE.
      integer SecOCSecondaryFreshnessValueId [0..1]: 0..65535  # This parameter defines the Id of the Secondary Freshness Value. | The Secondary Freshness Value might be a normal counter or a time value.
      boolean SecOCUseFreshnessTimestamp  # This parameter specifies whether the Freshness Value is generated through individual Freshness Counters or by a Timestamps. The value is set to TRUE when Timestamps are used.
      enumeration SecOCVerificationStatusPropagationMode: {BOTH, FAILURE_ONLY, NONE}  # This parameter is used to describe the propagation of the status of each verification attempt from the SecOC module to SWCs.
      choice reference SecOCRxAuthServiceConfigRef: destination=[CalMacVerifyConfig, CalSignatureVerifyConfig, CsmMacVerifyConfig, CsmSignatureVerifyConfig]  # This choice container is used to define which module and which service is used for verification.
      reference SecOCSameBufferPduRef [0..1]: destination=SecOCSameBufferPduCollection  # This reference is used to collect Pdus that are using the same SecOC buffer.
      container SecOCRxAuthenticPduLayer  # This container specifies the Pdu that is transmitted by the SecOC module to the PduR after the Mac was verified.
        reference SecOCRxAuthenticLayerPduRef: destination=Pdu  # Reference to the global Pdu.
      container SecOCRxSecuredPduLayer  # This container specifies the Pdu that is received by the SecOC module from the PduR. For this Pdu the Mac verification is provided.
        integer SecOCRxSecuredLayerPduId: 0..65535, symbolic-name-value=true  # PDU identifier assigned by SecOC module. Used by PduR for SecOC_PduRRxIndication.
        reference SecOCRxSecuredLayerPduRef: destination=Pdu  # Reference to the global Pdu.
    container SecOCSameBufferPduCollection [0..*]  # SecOCBuffer configuration that may be used by a collection of Pdus.
      integer SecOCBufferLength: 0..4294967295  # This parameter defines the Buffer in bytes that is used by the SecOC module.
    container SecOCTxPduProcessing [0..*]  # Contains the parameters to configure the TxPdus to be secured by the SecOC module.
      integer SecOCAuthInfoTxLength: 0..65535  # This parameter defines the length in bits of the authentication code to be included in the payload of the Secured I-PDU.
      integer SecOCAuthenticationRetries: 0..65535  # This parameter defines the additional number of authentication attempts that are to be carried out when the generation of the authentication information failed for a given Secured I-PDU. If zero is set than only one authentication attempt is done.
      integer SecOCDataId: 0..65535  # This parameter defines a unique numerical identifier for the Secured I-PDU.
      integer SecOCFreshnessTimestampTimePeriodFactor: 0..4294967295  # This parameter defines a factor that specifies the time period for the Freshness Timestamp. It holds a multiplication factor that specifies the concrete meaning of a Freshness Timestamp increment by one on basis of microseconds.
      integer SecOCFreshnessValueId: 0..65535  # This parameter defines the Id of the Freshness Value. | The Freshness Value might be a normal counter or a time value.
      integer SecOCFreshnessValueLength: 0..64  # This parameter defines the complete length in bits of the Freshness Value. As long as the key doesn't change the counter shall not overflow. The length of the counter shall be determined based on the expected life time of the corresponding key and frequency of usage of the counter.
      integer SecOCFreshnessValueTxLength: 0..64  # This parameter defines the length in bits of the Freshness Value to be included in the payload of the Secured I-PDU. This length is specific to the least significant bits of the complete Freshness Counter. If the parameter is 0 no Freshness Value is included in the Secured I-PDU.
      integer SecOCKeyId: 0..65535  # This parameter specifies the local Key identifier of the stored Key used to generate or verify a MAC.
      boolean SecOCUseFreshnessTimestamp  # This parameter specifies whether the Freshness Value is generated through individual Freshness Counters or by a Timestamps. The value is set to TRUE when Timestamps are used.
      choice reference SecOCTxAuthServiceConfigRef: destination=[CalMacGenerateConfig, CalSignatureGenerateConfig, CsmMacGenerateConfig, CsmSignatureGenerateConfig]  # This choice container is used to define which module and which service is used for authentication.
      reference SecOCSameBufferPduRef [0..1]: destination=SecOCSameBufferPduCollection  # This reference is used to collect Pdus that are using the same SecOC buffer.
      container SecOCTxAuthenticPduLayer  # This container specifies the Pdu that is received by the SecOC module from the PduR. For this Pdu the Mac generation is provided.
        integer SecOCTxAuthenticLayerPduId: 0..65535, symbolic-name-value=true  # PDU identifier assigned by SecOC module. Used by PduR for SecOC_PduRTransmit.
        reference SecOCTxAuthenticLayerPduRef: destination=Pdu  # Reference to the global Pdu.
      container SecOCTxSecuredPduLayer  # This container specifies the Pdu that is transmitted by the SecOC module to the PduR after the Mac was generated.
        integer SecOCTxSecuredLayerPduId: 0..65535, symbolic-name-value=true  # PDU identifier assigned by SecOC module. Used by PduR for confirmation (SecOC_PduRTxConfirmation) and for TriggerTransmit.
        reference SecOCTxSecuredLayerPduRef: destination=Pdu  # Reference to the global Pdu.
  module definition SoAd [0..1]: variants link-time/post-build/pre-compile  # Configuration of the SoAd (Socket Adaptor) module.
    container SoAdBswModules [0..*]  # Each container describes a specific BSW module that the SoAd shall interface to.
      boolean SoAdIf  # Specifies if the BSW module supports the Communication Interface APIs or not. Value true means that the APIs are supported. A module can have both Communication Interface APIs and Transport Protocol APIs (e.g. the PduR module).
      boolean SoAdIfTriggerTransmit: default-value=false  # Specifies if the BSW module supports the TriggerTransmit API or not. Value true means that the API is supported.
      boolean SoAdIfTxConfirmation  # Specifies if the BSW module supports the TxConfirmation API or not. Value true means that the API is supported.
      boolean SoAdLocalIpAddrAssigmentChg  # Specifies if the BSW module supports the LocalIpAddrAssigmentChg API or not. Value true means that the API is supported.
      boolean SoAdSoConModeChg  # Specifies if the BSW module supports the SoConModeChg API or not. Value true means that the API is supported.
      boolean SoAdTp  # Specifies if the BSW module supports the TransportProtocol APIs or not. Value true means that the APIs are supported. A module can have both Communication Interface APIs and Transport Protocol APIs (e.g. the PduR module).
      boolean SoAdUseCallerInfix: default-value=true  # Specifies if SoAd shall use (TRUE) the infix "SoAd" when calling an upper layer module function or not (FALSE). E.g. if SoAdUseCallerInfix is TRUE for the upper layer "ABC" then SoAd will call ABC_SoAdIfRxIndication() otherwise SoAd would call ABC_IfRxIndication().
      boolean SoAdUseTypeInfix: default-value=true  # Specifies if SoAd shall use (TRUE) the API type infix "Tp" or "If" when calling an upper layer module function or not (FALSE). E.g. if SoAdUseTypeInfix is TRUE for the upper layer "ABC" then SoAd will call ABC_IfRxIndication(), otherwise SoAd would call ABC_RxIndication().
      foreign reference SoAdBswModuleRef: destination-type=ECUC-MODULE-CONFIGURATION-VALUES  # This is a reference to one BSW module's configuration (i.e. not the ECUC parameter definition template). | Example, there could be several configurations of PduR and this reference selects one of them. SoAd has to figure out from the structure of the referenced BSW module's configuration, what kind of upper layer he deals with. In case of a CDD SoAd expects UL-APIs in form of _SoAd<If|Tp><function> and expects CDD Pdu configuration structures according to the Ecu Configuration specification (chapter CDD module\Socket Adaptor). In case it is one of the standardized AUTOSAR BSW modules, the configuration structures and API names for interaction with SoAd are defined in the corresponding SWS.
    container SoAdConfig  # This container contains the configuration parameters and sub containers of the AUTOSAR SoAd module.
      container SoAdPduRoute [0..*]  # Describes the path of a PDU from an upper layer of the SoAd to the socket in the TCP/IP stack for transmission.
        integer SoAdTxPduId: 0..65535, symbolic-name-value=true  # Tx PDU ID of the PDU coming from the PDU Router.
        enumeration SoAdTxUpperLayerType: {IF, TP}  # Specifies the upper layer interface type (must be "IF" in case of multiple PduRoutes).
        reference SoAdTxPduRef: destination=Pdu  # Reference to the global PDU structure
        container SoAdPduRouteDest [1..*]  # Specifies the PDU route destination.
          integer SoAdTxPduHeaderId [0..1]: 0..4294967296  # ID to be sent on the TCP/IP connection if the PDU header option is enabled.
          enumeration SoAdTxUdpTriggerMode [0..1]: {TRIGGER_ALWAYS, TRIGGER_NEVER}  # Specifies whether a PDU triggers the transmission of the nPduUdpTxBuffer. | If this parameter is set to TRIGGER_NEVER, SoAd shall use an nPduUdpTxBuffer for the related socket connection. nPduUdpTxBuffer can only be used for upper layers with IF API, i.e. this parameter shall only be set to TRIGGER_NEVER if all upper layers belonging to the related socket connection have SoAdTxUpperLayerType set to "IF". This parameter is only relevant for UDP connections.
          float SoAdTxUdpTriggerTimeout [0..1]: 0..Inf  # Specifies the timeout in [s] the nPduUdpTxBuffer shall be transmitted at the latest after this PDU is put into the buffer. This optional parameter is only relevant if SoAdTxUdpTriggerMode is TRIGGER_NEVER.
          choice reference SoAdTxSocketConnOrSocketConnBundleRef: destination=[SoAdSocketConnection, SoAdSocketConnectionGroup]  # Choice Reference to a SocketConnection or to a SocketConnectionGroup on which the PDU is to be sent on. The reference to a SocketConnectionGroup shall only be used for upper layers with IF API.
          reference SoAdTxRoutingGroupRef [0..*]: destination=SoAdRoutingGroup  # Reference to the routing group.
      container SoAdRoutingGroup [0..*]  # Each container describes a specific routing group which can be enabled or disabled. A routing group consists of PDUs. Routing of PDUs can either be forwarding of PDUs from the upper layer to a TCP or UDP socket of the TCP/IP stack specified by a SoAdPduRoute or the other way around specified by a SoAdSocketRoute.
        integer SoAdRoutingGroupId: 0..65535, symbolic-name-value=true  # Unique ID of Routing Group
        boolean SoAdRoutingGroupIsEnabledAtInit  # If set to true this routing group will be enabled after initializing the SoAd module (i.e. enabled in the SoAd_Init function).
        boolean SoAdRoutingGroupTxTriggerable: default-value=false  # Specifies if the If-TxPDUs related to the PduRouteDest containers | referenced by this routing group can be triggered via SoAd_IfRoutingGroupTransmit (TRUE) or not (FALSE).
      container SoAdSocketConnectionGroup [1..*]  # Specifies the configuration of a socket connection group, i.e. specifies the socket connections belonging to the group and the parameters which are common for all socket connections of the group. A socket connection specifies how data can be received and transmited via a TCP or UDP socket.
        boolean SoAdPduHeaderEnable  # Enables the transmission of the PDU header (ID, length) on this socket connection. | TRUE: add SoAd PDU header before PDU data FALSE: No SoAd PDU header is used
        boolean SoAdResourceManagementEnable  # Enables the resource management option for this socket. | May not be activated for UDP sockets in receive. TRUE: resource management option enabled FALSE: resource management option disabled
        boolean SoAdSocketAutomaticSoConSetup: default-value=true  # Specifies if the setup of the socket connection shall be done automatically (TRUE) or manually (FALSE) via SoAd_OpenSoCon() and SoAd_CloseSoCon().
        integer SoAdSocketFramePriority [0..1]: 0..7  # Specifies the priority of the Ethernet frame. | If IEEE 802.1Q VLAN Tags are used, the specified priority will be used in the VLAN Tag PCP filed. If this optional parameter is not available the default priority specified in the TcpIp module is used.
        boolean SoAdSocketIpAddrAssignmentChgNotification: default-value=false  # Specifies if the local IP address assignment change notification callback function of the upper layer shall be called if the assignment of the local IP address used by this socket connection changes.
        integer SoAdSocketLocalPort: 0..65535, default-value=0  # Local UDP or TCP port used for this connection. If this parameter set to 0 SoAd requests TcpIp to select an ephemeral port.
        boolean SoAdSocketMsgAcceptanceFilterEnabled: default-value=true  # Specifies if the message acceptance filter is enabled (TRUE) or not (FALSE). | Note: if a wildcard is used in SoAdSocketRemoteAddress AND SoAdSocketUdpListenOnly is FALSE, this parameter must be TRUE. Note: if multiple SoAdSocketConnections are configured for one SoAdSocketConnectionGroup, this parameter must be TRUE.
        boolean SoAdSocketSoConModeChgNotification: default-value=false  # Specifies if the SoCon mode change notification callback function of the upper layer shall be called in case of SoCon mode change.
        integer SoAdSocketTpRxBufferMin [0..1]: 0..65535  # Specifies the amount of data in bytes (PDU data for the upper layer and PDU Header if used) the SoAd shall at least be able to buffer for data reception via each socket connection of the socket connection group and using an upper layer with TP. | Note: in case of a TCP socket where PduHeaderMode is used and an upper layer with IF-API, the required buffer size can be determined automatically.
        symbolic name reference SoAdSocketLocalAddressRef: destination=TcpIpLocalAddr  # Local IP address and interface used for this connection.
        container SoAdSocketConnection [1..*]  # Specifies the socket connection (Id and remote address information). | Note: Parameters which are common to all socket connections of a socket connection group are specified directly at the group.
          integer SoAdSocketId: 0..65535, symbolic-name-value=true  # Socket connection identifier used as SoConId in the interaction with upper layers.
          container SoAdSocketRemoteAddress [0..1]  # Subcontainer of SoAdSocketConnection to specify the remote address (IP address and port) for a socket connection. | If SoAdSocketRemoteAddress is not specified the remote address has to be set by the upper layer via SoAd_SetRemoteAddr().
            string SoAdSocketRemoteIpAddress  # IP address of remote node. The configured address must be of the same TcpIpDomainType (i.e. IPv4 or IPv6) as the TcpIpLocalAddr referred by SoAdSocketLocalAddressRef . | To accept any remote IP address, set SoAdSocketRemoteIpAddress to "ANY". See message acceptance policy for more details.
            integer SoAdSocketRemotePort: 0..65535  # Remote UDP or TCP port used for this connection. | To accept any remote port, set SoAdSocketRemotePort to 0. See message acceptance policy for more details.
        choice container SoAdSocketProtocol  # Specifies the transport protocol and transport protocol specific parameters used for the socket connections of the socket connection group.
          container SoAdSocketTcp [0..1]  # Specifies that TCP is used as transport protocol for the socket connection group and parameters only related to TCP socket connections.
            boolean SoAdSocketTcpImmediateTpTxConfirmation: default-value=false  # If set to FALSE, SoAd notifies the TP upper layer via transmit confirmation after a Tcp Ack has been received. If set to TRUE, SoAd notifies the TP upper layer via transmit confirmation immediately after transmit has been accepted by TcpIp.
            boolean SoAdSocketTcpInitiate  # Specifies the initiator for this TCP connection. It will not be defined for UDP sockets. | TRUE: This TCP connection is initiated by this module. FALSE: This TCP connection is to be initiated in the listen mode.
            boolean SoAdSocketTcpKeepAlive: default-value=false  # Specifies to use the keep-alive mechanism for this connection. It will not be defined for UDP sockets. | TRUE: This TCP connection will use the keep-alive mechanism. FALSE: This TCP connection will not use the keep-alive mechanism. Note: This parameter must not be set to TRUE if TcpIpTcpKeepAliveEnabled is set to FALSE.
            float SoAdSocketTcpKeepAliveInterval [0..1]: 0..Inf  # Specifies the interval in seconds between subsequent keepalive probes.
            integer SoAdSocketTcpKeepAliveProbesMax [0..1]: 0..65535  # Maximum number of times that TCP retransmits an individual data segment before aborting the connection.
            float SoAdSocketTcpKeepAliveTime [0..1]: 0..Inf, default-value=7200  # Specifies the time in seconds between the last data packet sent and the first keepalive probe.
            boolean SoAdSocketTcpNoDelay [0..1]  # Specifies not to use the congestion control mechanism for this connection. It will not be defined for UDP sockets. | TRUE: This TCP connection will NOT use congestion control. FALSE: This TCP connection will use congestion control. If the optional parameter is not enabled, the default behavior configured for TcpIp via the parameter TcpIpTcpNagleEnabled is applied. Note: This parameter must not be set to FALSE if TcpIpTcpNagleEnabled is set to FALSE.
            integer SoAdSocketTcpTxQuota [0..1]: 0..4294967295  # Specifies the maximum amount of bytes (PDU data provided by the upper layer and PDU Header if used) the SoAd may queue for transmission via TCP at the TcpIp module for each socket connection of this socket connection group. | Rationale: prohibits that a socket connection consumes all available transmit buffers at the TcpIp and blocks transmissions via other socket connections. If the optional parameter is not enabled, the amount of data is not limited.
          container SoAdSocketUdp [0..1]  # Specifies that UDP is used as transport protocol for the socket connection group and parameters only related to UDP socket connections.
            float SoAdSocketUdpAliveSupervisionTimeout [0..1]: 0..Inf  # Specifies the time in [s] a UDP socket connection remains in the mode SOAD_SOCON_ONLINE after the latest reception of a frame from the remote peer specified by the remote address. If this optional parameter is not enabled UDP Alive Supervision is deactivated for the related socket connection group.
            boolean SoAdSocketUdpListenOnly: default-value=false  # Specifies if the socket connection group is only used for reception (TRUE) or used for both reception and transmission (FALSE).
            boolean SoAdSocketUdpStrictHeaderLenCheckEnabled: default-value=false  # Specifies if UDP messages shall be dropped (TRUE) if the length of all contained PDUs does not match the length of the whole message or not (FALSE). Shall only be set to TRUE if SoAdPduHeaderEnable is also set to TRUE.
            float SoAdSocketUdpTriggerTimeout [0..1]: 0..Inf  # Specifies the timeout in [s] a nPduUdpTxBuffer is waiting for a PDU with TriggerMode = TRIGGER_ALWAYS, i.e. when the timeout expires the nPduUdpTxBuffer is transmitted. Timer is reset after each UDP transmission. This optional parameter is only relevant if a nPduUdpTxBuffer is used.
            integer SoAdSocketnPduUdpTxBufferMin [0..1]: 0..65535  # Specifies the amount of data in bytes (PDU data provided by the upper layer and PDU Header if used) the SoAd shall be able to buffer for data transmission via this socket connection in case the UDP message shall be buffered for transmission of multiple PDUs per UDP. | Note: in case of a UDP socket and an upper layer with TP API is configured, the required buffer size can be determined automatically. This optional parameter is only relevant if a nPduUdpTxBuffer is used.
      container SoAdSocketRoute [0..*]  # Describes the path of a PDU from a socket in the TCP/IP stack to an upper layer of the SoAd after reception in the TCP/IP Stack.
        integer SoAdRxPduHeaderId [0..1]: 0..4294967296  # ID contained in the packet received on the TCP/IP connection if the PDU header option is enabled.
        choice reference SoAdRxSocketConnOrSocketConnBundleRef: destination=[SoAdSocketConnection, SoAdSocketConnectionGroup]  # Choice Reference to a SocketConnection or to a SocketConnectionGroup on which the PDU was received. The reference to a SocketConnectionGroup shall only be used for upper layers with IF API.
        container SoAdSocketRouteDest  # Describes the upper layer destination PDU for a message received on a TcpIp socket.
          integer SoAdRxPduId [0..1]: 0..65535  # This unique identifier is used for a receive cancellation request from an upper layer of the SoAd.
          enumeration SoAdRxUpperLayerType: {IF, TP}  # Specifies the upper layer interface type (must be "IF" in case of multiple RxPdus).
          reference SoAdRxPduRef: destination=Pdu  # Reference to the global PDU structure
          reference SoAdRxRoutingGroupRef [0..*]: destination=SoAdRoutingGroup  # Reference to the routing group.
    container SoAdGeneral  # This container contains all global configuration parameters of SoAd.
      boolean SoAdDevErrorDetect  # Switches the Default Error Tracer (Det) detection and notification ON or OFF. | * true: enabled (ON). * false: disabled (OFF).
      boolean SoAdIPv6AddressEnabled  # Allows for increased memory allocation to store IPv6 addresses. | TRUE: Enables support for IPv6 addresses FALSE: Only IPv4 addresses are supported
      float SoAdMainFunctionPeriod: 0..Inf  # Determines the frequency at which the SoAd_MainFunction() is called in [s].
      integer SoAdRoutingGroupMax: 0..65535  # Specifies the maximum number of SoAd routing groups. Furthermore it defines the platform type used for RoutingGroupIdType. If SoAdRoutingGroupMax is not greater than 256, an uint8 is used, | otherwise an uint16.
      integer SoAdSoConMax: 0..65535  # Specifies the maximum number of SoAd socket connections. | Furthermore it defines the platform type used for SoAd_SoConIdType. If SoAdSoConMax is not greater than 256, an uint8 is used, otherwise uint16.
      boolean SoAdVersionInfoApi  # Activates the SoAd_GetVersionInfo() API. | TRUE: Enables the SoAd_GetVersionInfo() API. FALSE: SoAd_GetVersionInfo() API is not included.
  module definition TcpIp [0..1]: variants link-time/post-build/pre-compile  # Configuration of the TcpIp (TCP/IP stack) module.
    container TcpIpConfig  # This container contains the configuration parameters and sub containers of the AUTOSAR TcpIp module.
      container TcpIpCtrl [1..*]  # Specifies the EthIf controller used for IP communication and TcpIp errors that shall be reported to DEM.
        integer TcpIpIpFramePrioDefault [0..1]: 0..7, default-value=0  # Specifies the default value for the priority for all outgoing frames. | Note: the value can be changed for each socket individually via TcpIp_ChangeParameter() service. If this optional parameter is not available, 0 is used as default priority.
        reference TcpIpDhcpServerConfigRef [0..1]: destination=TcpIpDhcpServerConfig  # Reference to a TcpIpDhcpServerConfig which shall be used for this controller setting (VLAN).
        symbolic name reference TcpIpEthIfCtrlRef: destination=EthIfController  # Reference to EthIf controller where the IP address shall be assigned.
        container TcpIpCtrlDemEventParameterRefs [0..1]  # This container is a subcontainer of TcpIpCtrl and specifies the references to DemEventParameter elements which shall be invoked using the API Dem_ReportErrorStatus API in case the corresponding TcpIp error occurs for communication on the EthIf Controller. The EventId is taken from the referenced DemEventParameter's DemEventId value. The standardized errors are provided in the container and can be extended by vendor specific error references.
          symbolic name reference TCPIP_E_CONNREFUSED [0..1]: destination=DemEventParameter  # Reference to the DemEventParameter which shall be issued when the error "Connection refusedâ€ has occurred.
          symbolic name reference TCPIP_E_HOSTUNREACH [0..1]: destination=DemEventParameter  # Reference to the DemEventParameter which shall be issued when the error "No route to hostâ€ has occurred.
          symbolic name reference TCPIP_E_PACKETTOBIG [0..1]: destination=DemEventParameter  # Reference to the DemEventParameter which shall be issued when the error "Path does not support frame size" has occurred.
          symbolic name reference TCPIP_E_TIMEDOUT [0..1]: destination=DemEventParameter  # Reference to the DemEventParameter which shall be issued when the error "Operation timed outâ€ has occurred.
        choice container TcpIpIpVXCtrl  # Specifies whether this controller is an Internet Protocol version 4 (IPv4) or Internet Protocol version 6 (IPv4) instance.
          container TcpIpIpV4Ctrl [0..1]  # Specifies an Internet Protocol version 4 (IPv4) instance.
            reference TcpIpArpConfigRef [0..1]: destination=TcpIpArpConfig  # Reference to ARP configuration for this IPv4 instance. | (Multiple IPv4 instances may use the same configuration container but will operate independently)
            reference TcpIpAutoIpConfigRef [0..1]: destination=TcpIpAutoIpConfig  # Reference to AutoIp configuration for this IPv4 instance. | (Multiple IPv4 instances may use the same configuration container but will operate independently)
            reference TcpIpDhcpConfigRef [0..1]: destination=TcpIpDhcpConfig  # Reference to DHCP configuration for this IPv4 instance. | (Multiple IPv4 instances may use the same configuration container but will operate independently)
            reference TcpIpFragmentationConfigRef [0..1]: destination=TcpIpIpFragmentationConfig  # Reference to Fragmentation configuration for this IPv4 instance. | (Multiple IPv4 instances may use the same configuration container but will operate independently)
          container TcpIpIpV6Ctrl [0..1]  # Specifies an Internet Protocol version 6 (IPv6) instance.
            reference TcpIpIpV6DhcpConfigRef [0..1]: destination=TcpIpDhcpV6Config  # Reference to DHCPv6 configuration. | (Multiple IPv6 instances may use the same configuration container but will operate independently)
            reference TcpIpIpV6FragmentationConfigRef [0..1]: destination=TcpIpIpV6FragmentationConfig  # Reference to IPv6 Fragmentation Configuration. | (Multiple IPv6 instances may use the same configuration container but will operate independently)
            reference TcpIpIpV6NdpConfigRef: destination=TcpIpNdpConfig  # Reference to Neighbor Discovery Protocol Configuration. | (Multiple IPv6 instances may use the same configuration container but will operate independently)
            container TcpIpIpV6MtuConfig  # This container specifies the Maximum Transmission Unit parameters for this IPv6 instance.
              integer TcpIpIpV6DefaultMtuSize: 1280..65535, default-value=1500  # Maximum Transmission Unit (MTU) of the link. | [RFC2460 5. Packet Size Issues] "IPv6 requires that every link in the internet have an MTU of 1280 octets or greater. On any link that cannot convey a 1280-octet packet in one piece, link-specific fragmentation and reassembly must be provided at a layer below IPv6. Links that have a configurable MTU (for example, PPP links [RFC-1661]) must be configured to have an MTU of at least 1280 octets; it is recommended that they be configured with an MTU of 1500 octets or greater, to accommodate possible encapsulations (i.e., tunneling) without incurring IPv6-layer fragmentation. From each link to which a node is directly attached, the node must be able to accept packets as large as that link's MTU."
              boolean TcpIpIpV6PathMtuEnabled: default-value=false  # If enabled the IPv6 processes incoming ICMPv6 "Packet Too Big" messages and stores a MTU value for each destination address. | See RFC1981 "Path MTU Discovery for IP version 6" for details about PathMTU.
              float TcpIpIpV6PathMtuTimeout: 1..86400, default-value=600  # If this value is >0 the IpV6 will reset the MTU value stored for each destination after n seconds. | see [RFC1981 5.3. Purging stale PMTU information] Default: 600 seconds (10 minutes)
      container TcpIpDhcpServerConfig [0..*]  # Specifies the configuration parameters of the DHCP Server sub-module.
        string TcpIpDhcpDefaultRouter [0..1]  # IP address of default router (gateway).
        integer TcpIpDhcpNetmask [0..1]: 0..128  # Network mask of IPv4 address or address prefix of IPv6 address in CIDR Notation, i.e. decimal value between 0 and 32 (IPv4) or 0 and 128 (IPv6) that describes the number of significant bits defining the network number or prefix of an IP address.
        symbolic name reference TcpIpDhcpEthIfSwitchRef [0..1]: destination=EthIfSwitch  # Reference to EthIfSwitch representation. | Optional in case the Dhcp server is operating without an Ethernet switch.
        container TcpIpDhcpAddressAssignment [0..*]  # Defines a Ethernet Switch port based IP address assignment.
          string TcpIpDhcpAddressLowerBound  # The lower bound IP address which shall be assigned. | If lower bound and upper bound are identical exactly this IP address shall be assigned.
          string TcpIpDhcpAddressUpperBound  # The upper bound IP address which shall be assigned. | If lower bound and upper bound are identical exactly this IP address shall be assigned.
          symbolic name reference TcpIpDhcpSwitchPortRef [0..1]: destination=EthSwtPort  # Reference to Ethernet Switch port. | Optional in case the Dhcp server is operating without an Ethernet switch.
      container TcpIpIpConfig [0..1]  # Specifies the configuration parameters of the IP (Internet Protocol) sub-module
        container TcpIpIpV4Config [0..1]  # Specifies the configuration parameters of the IPv4 (Internet Protocol version 4) sub-module.
          container TcpIpArpConfig [0..*]  # Specifies the configuration parameters of the ARP (Address Resolution Protocol) sub-module.
            integer TcpIpArpNumGratuitousARPonStartup: 0..255  # Specifies the number of gratuitous ARP replies which shall be sent on assignment of a new IP address.
            boolean TcpIpArpPacketQueueEnabled: default-value=false  # Enables (TRUE) or disables (FALSE) support of the ARP Packet Queue according to IETF RFC 1122, section 2.3.2.2.
            float TcpIpArpTableEntryTimeout: 0..Inf  # Timeout in seconds after which an unused ARP entry is removed.
            integer TcpIpArpTableSizeMax: 0..65535  # Maximum number of entries in the ARP table.
          container TcpIpAutoIpConfig [0..*]  # Specifies the configuration parameters of the Auto-IP (automatic private IP addressing) sub-module.
            float TcpIpAutoIpInitTimeout: 0..Inf  # The time in seconds Auto-IP waits at startup, before beginning with ARP probing. This delay is used to give DHCP time to acquire a lease in case a DHCP server is present.
          container TcpIpDhcpConfig [0..*]  # Specifies the configuration parameters of the DHCPv4. | This container may be referenced by multiple IPv4 instances if they shall use the same configuration. This container may have multiple instances if different configurations are required for different IPv4 instances.
          container TcpIpIcmpConfig [0..1]  # Specifies the configuration parameters of the ICMP (Internet Control Message Protocol) sub-module.
            integer TcpIpIcmpTtl: 0..255  # Default Time-to-live value of outgoing ICMP packets.
            container TcpIpIcmpMsgHandler [0..1]  # This container is a subcontainer of TcpIpIcmpConfig and specifies the configuration parameters for the ICMP message handler.
              string TcpIpIcmpMsgHandlerHeaderFileName: max-length=32, min-length=1  # This parameter specifies the name of the header file containing the definition of the ICMP message handler function.
              function name TcpIpIcmpMsgHandlerName  # This parameter defines the name of the ICMP message handler function <User_IcmpMsgHandler>.
          container TcpIpIpFragmentationConfig [0..*]  # Specifies the configuration parameters of IPv4 packet fragmentation/reassembly. | This container may be referenced by multiple IPv4 instances if they shall use the same configuration. This container may have multiple instances if different configurations are required for different IPv4 instances.
            boolean TcpIpIpFragmentationRxEnabled: default-value=false  # Enables (TRUE) or disables (FALSE) support for reassembling of incoming datagrams that are fragmented according to IETF RFC 815 (IP Datagram Reassembly Algorithms).
            integer TcpIpIpNumFragments [0..1]: 0..255, default-value=0  # Specifies the maximum number of IP fragments per datagram. | Note: this parameter is only relevant if TcpIpIpFragmentationRxEnabled is TRUE.
            integer TcpIpIpNumReassDgrams [0..1]: 0..65535, default-value=3  # Specifies the maximum number of fragmented IP datagrams that can be reassembled in parallel. | Note: this parameter is only relevant if TcpIpIpFragmentationRxEnabled is TRUE.
            float TcpIpIpReassTimeout [0..1]: 0..Inf, default-value=60  # Specifies the timeout in [s] after which an incomplete datagram gets discarded. | Note: this parameter is only relevant if TcpIpIpFragmentationRxEnabled is TRUE.
        container TcpIpIpV6Config [0..1]  # Specifies the configuration parameters of the IPv6 (Internet Protocol version 6) sub-module.
          container TcpIpDhcpV6Config [0..*]  # Specifies the configuration parameters of the DHCPv6. | This container may be referenced by multiple IPv6 instances if they shall use the same configuration. This container may have multiple instances if different configurations are required for different IPv6 instances.
            float TcpIpDhcpV6CnfDelayMax: 0..100, default-value=1  # Maximum delay (s) before sending the first Confirm message. If this value is bigger than the previous minimum delay value a random delay will be chosen from the interval.
            float TcpIpDhcpV6CnfDelayMin: 0..100, default-value=0  # Minimum delay (s) before the first Confirm message will be sent.
            float TcpIpDhcpV6InfDelayMax: 0..100, default-value=1  # Maximum delay (s) before sending the first Information Request message. If this value is bigger than the previous minimum delay value a random delay will be chosen from the interval.
            float TcpIpDhcpV6InfDelayMin: 0..100, default-value=0  # Minimum delay (s) before the first Information Request message will be sent.
            float TcpIpDhcpV6SolDelayMax: 0..100, default-value=1  # Maximum delay (s) before sending the first Solicit message. If this value is bigger than the previous minimum delay value a random delay will be chosen from the interval.
            float TcpIpDhcpV6SolDelayMin: 0..100, default-value=0  # Minimum delay (s) before the first Solicit message will be sent.
          container TcpIpIcmpV6Config  # Specifies the configuration parameters of the ICMPv6 (Internet Control Message Protocol for IPv6) sub-module.
            integer TcpIpIcmpV6EchoDataBufferSize: 0..1452, default-value=64  # Configure the maximum amount of arbitrary data that will be sent back to the sender of an echo request. If the arbitrary data of an incoming echo request is bigger than configured here, the response payload will be truncated.
            boolean TcpIpIcmpV6EchoReplyEnabled: default-value=false  # If enabled, the stack will respond to incoming ICMPv6 Echo Requests (Pings).
            integer TcpIpIcmpV6HopLimit: 0..255  # Default Hop-Limit value of outgoing ICMPv6 packets.
            boolean TcpIpIcmpV6MsgDestinationUnreachableEnabled  # Dis/Enables transmission of Destination Unreachable Messages
            boolean TcpIpIcmpV6MsgParameterProblemEnabled: default-value=true  # If enabled an ICMPv6 parameter problem message will be sent if a received packet has been dropped due to unknown options or headers that are found in the packet. | [RFC2460 4. IPv6 Extension Headers]
            container TcpIpIcmpV6MsgHandler [0..1]  # This container is a subcontainer of TcpIpIcmpConfig and specifies the configuration parameters for the ICMPv6 message handler.
              string TcpIpIcmpV6MsgHandlerHeaderFileName: max-length=32, min-length=1  # This parameter specifies the name of the header file containing the definition of the ICMPv6 message handler function.
              function name TcpIpIcmpV6MsgHandlerName  # This parameter defines the name of the ICMP message handler function <User_IcmpMsgHandler>.
          container TcpIpIpV6FragmentationConfig [0..*]  # Specifies the configuration parameters of IPv6 packet fragmentation/reassembly. | This container may be referenced by multiple IPv6 instances if they shall use the same configuration. This container may have multiple instances if different configurations are required for different IPv6 instances.
            integer TcpIpIpV6ReassemblyBufferCount: 0..255, default-value=2  # Number of buffers that can be used for fragment reassembly. In case of a reassembly error or if not all fragments are received in time this buffer will be blocked until the specified "Fragment Reassembly Timeout" has been exceeded. | A value of 0 disables fragment reassembly. [RFC2460 5. Packet Size Issues] "In order to send a packet larger than a path's MTU, a node may use the IPv6 Fragment header to fragment the packet at the source and have it reassembled at the destination(s). However, the use of such fragmentation is discouraged in any application that is able to adjust its packets to fit the measured path MTU (i.e., down to 1280 octets)."
            integer TcpIpIpV6ReassemblyBufferSize [0..1]: 1500..65535, default-value=1500  # [RFC2460 5. Packet Size Issues] | "A node must be able to accept a fragmented packet that, after reassembly, is as large as 1500 octets. A node is permitted to accept fragmented packets that reassemble to more than 1500 octets."the measured path MTU (i.e., down to 1280 octets)."
            integer TcpIpIpV6ReassemblySegmentCount [0..1]: 255..1, default-value=5  # Specifies the maximum number of consecutive data segments that can be managed in each reassembly buffer. If all fragments are received in order, only one segment will be needed. | To deal with fragments received out of order this value should be configured bigger than 1.
            float TcpIpIpV6ReassemblyTimeout [0..1]: 0.001..100, default-value=60  # [RFC2460 4.5 Fragment Header] | Default: 60 seconds
            integer TcpIpIpV6TxFragmentBufferCount: 1..1000, default-value=2  # These buffers will be used if the IpV6 receives packets from the upper layer that do not fit into the MTU and thus must be fragmented. | A value of 0 disables tx fragmentation. If the upper layer transmits packets that do not fit into the link or path MTU, the IpV6 will split-up the packet into fragments. see "Enable Fragment Reassembly"
            integer TcpIpIpV6TxFragmentBufferSize [0..1]: 1500..65535, default-value=1500  # Size of each fragment tx buffer in bytes
          container TcpIpNdpConfig [1..*]  # Specifies the configuration parameters of the Neighbor Discovery Protocol for IPv6 | This container may be referenced by multiple IPv6 instances if they shall use the same configuration. This container may have multiple instances if different configurations are required for different IPv6 instances.
            container TcpIpNdpArNudConfig [0..1]  # Specifies the configuration parameters for NDP Address Resolution and Neighbor Unreachability Detection.
              float TcpIpNdpDefaultReachableTime: 0..120, default-value=30  # Configuration of the ReachableTime (s) specified in [RFC4861 6.3.2. Host Variables]. | "The time a neighbor is considered reachable after receiving a reachability confirmation." If "TcpIpNdpDynamicReachableTimeEnabled" is checked, this value may be reconfigured based on received Router Advertisements. Default: REACHABLE_TIME = 30 seconds
              float TcpIpNdpDefaultRetransTimer: 0..60, default-value=1  # Configures the default value (s) for the RetransTimer variable specified in [RFC4861 6.3.2. Host Variables]. | "The time between retransmissions of Neighbor Solicitation messages to a neighbor when resolving the address or when probing the reachability of a neighbor." If "TcpIpNdpDynamicRetransTimeEnabled" is checked, this value may be reconfigured based on received Router Advertisements. Default: RETRANS_TIMER = 1 second
              float TcpIpNdpDelayFirstProbeTime: 0..60, default-value=5  # Delay before sending the first NUD probe in (s). | [RFC4861 7.3.3. Node Behavior] Default: DELAY_FIRST_PROBE_TIME = 5 seconds
              integer TcpIpNdpMaxNeighborCacheSize: 1..254, default-value=5  # Maximum number of entries in the neighbor cache. | [RFC4861 5.1. Conceptual Data Structures]
              integer TcpIpNdpMaxRandomFactor: 0..100, default-value=15  # Maximum random factor used for randomization | [RFC4861 10. Protocol Constants] Default: 15 (MAX_RANDOM_FACTOR = 1.5)
              integer TcpIpNdpMinRandomFactor: 0..100, default-value=5  # Minimum random factor used for randomization | [RFC4861 10. Protocol Constants] Default: 5 (MIN_RANDOM_FACTOR = 0.5)
              boolean TcpIpNdpNeighborUnreachabilityDetectionEnabled: default-value=true  # Neighbor Unreachability Detection is used to remove unused entries from the neighbor cache. This feature is a basic feature of NDP and should be turned on.
              integer TcpIpNdpNumMulticastSolicitations: 0..255, default-value=3  # Maximum number of multicast solicitations that will be sent when performing address resolution. | [RFC4861 7.2.2. Sending Neighbor Solicitations] Default: MAX_MULTICAST_SOLICIT = 3
              integer TcpIpNdpNumUnicastSolicitations: 0..255, default-value=3  # Maximum number of unicast solicitations that will be sent when performig Neighbor Unreachability Detection. | [RFC4861 7.3.3. Node Behavior] Default: MAX_UNICAST_SOLICIT = 3
              boolean TcpIpNdpPacketQueueEnabled: default-value=true  # Enables (TRUE) or disables (FALSE) support of a NDP Packet Queue according to IETF RFC 4861, section 7.2.2.
              boolean TcpIpNdpRandomReachableTimeEnabled: default-value=true  # If enabled the value of ReachableTime will be multiplied with a random value between MIN_RANDOM_FACTOR and MAX_RANDOM_FACTOR in order to prevent multiple nodes from transmitting at exactly the same time | [RFC4861 6.3.2. Host Variables / ReachableTime]
            container TcpIpNdpPrefixRouterDiscoveryConfig [0..1]  # Specifies the configuration parameters for NDP Prefix and Router Discovery.
              integer TcpIpNdpDefaultRouterListSize: 2..254, default-value=2  # Maximum number of default router entries. | [RFC4861 5.1. Conceptual Data Structures]
              integer TcpIpNdpDestinationCacheSize: 1..254, default-value=5  # Maximum number of entries in the destination cache. | [RFC4861 5.1. Conceptual Data Structures]
              boolean TcpIpNdpDynamicHopLimitEnabled: default-value=true  # If enabled the default hop limit may be reconfigured based on received Router Advertisements. | [RFC4861 6.3.4. Processing Received Router Advertisements]
              boolean TcpIpNdpDynamicMtuEnabled: default-value=false  # Allow dynamic reconfiguration of link MTU via Router Advertisements. | [RFC4861 4.6.4. MTU]
              boolean TcpIpNdpDynamicReachableTimeEnabled: default-value=true  # If enabled the default Reachable Time value may be reconfigured based on received Router Advertisements. | [RFC4861 6.3.4. Processing Received Router Advertisements] Default: Enabled
              boolean TcpIpNdpDynamicRetransTimeEnabled: default-value=true  # If enabled the default Retransmit Timer value may be reconfigured based on received Router Advertisements. | [RFC4861 6.3.4. Processing Received Router Advertisements] Default: Enabled
              float TcpIpNdpMaxRtrSolicitationDelay: 0.001..60, default-value=1  # Maximum delay before the first Router Solicitation will be sent after interface initialization in (s). | [RFC4861 6.3.7. Sending Router Solicitations] Default: MAX_RTR_SOLICITATION_DELAY = 1 second
              integer TcpIpNdpMaxRtrSolicitations: 0..255, default-value=3  # Maximum number of Router Solicitations that will be sent before the first Router Advertisement has been received. | 0 = No Router Solicitations will be sent. This has no impact on handling Router Advertisements. [RFC4861 6.3.7. Sending Router Solicitations] Default: MAX_RTR_SOLICITATIONS = 3 transmissions
              integer TcpIpNdpPrefixListSize: 1..254, default-value=5  # Maximum number of entries in the on-link prefix list. | [RFC4861 5.1. Conceptual Data Structures]
              boolean TcpIpNdpRndRtrSolicitationDelayEnabled: default-value=true  # If enabled the first router solicitation will be delayed randomly from [0...MAX_RTR_SOLICITATION_DELAY]. Otherwise the first router solicitation will be sent after exactly MAX_RTR_SOLICITATION_DELAY milliseconds. | [RFC4861 6.3.7. Sending Router Solicitations] Default: Enabled
              float TcpIpNdpRtrSolicitationInterval: 0.001..60, default-value=4  # Interval between consecutive Router Solicitations in (s). | [RFC4861 6.3.7. Sending Router Solicitations] Default: RTR_SOLICITATION_INTERVAL = 4 seconds
            container TcpIpNdpSlaacConfig [0..1]  # Specifies the configuration parameters for StateLess Address AutoConfiguration.
              integer TcpIpNdpSlaacDadNumberOfTransmissions: 0..254, default-value=1  # Number of Neighbor Solicitations that have to be unanswered in order to set an autoconfigurated address to PREFERRED (usable) state. | [RFC4861 5.1. Node Configuration Variables] Default: DupAddrDetectTransmits = 1 Setting this value to 0 turns off DAD.
              float TcpIpNdpSlaacDadRetransmissionDelay: 0..10, default-value=1  # Sets the maximum value for the address configuration delay (s). | According to [RFC4861 5.4.2. Sending Neighbor Solicitation Messages] this value should be the same as MAX_RTR_SOLICITATION_DELAY. Default: MAX_RTR_SOLICITATION_DELAY = 1 second
              boolean TcpIpNdpSlaacDelayEnabled: default-value=false  # If enabled transmission of the first DAD Neighbor Solicitation will be delayed by a random value from [0...MAX_DAD_DELAY]. | "This serves to alleviate congestion when many nodes start up on the link at the same time, such as after a power failure, and may help to avoid race conditions when more than one node is trying to solicit for the same address at the same time." "The delay will avoid similar congestion when multiple nodes are going to configure addresses by receiving the same single multicast router advertisement." [RFC4861 5.4.2. Sending Neighbor Solicitation Messages] Default: True
              boolean TcpIpNdpSlaacOptimisticDadEnabled: default-value=false  # Enable Optimistic Duplicate Address Detection (DAD) according to RFC4429.
      container TcpIpLocalAddr [1..*]  # Specifies the local IP (Internet Protocol) addresses used for IP communication.
        integer TcpIpAddrId: 0..65535, symbolic-name-value=true  # IP address table identifier assigned by TCP/IP stack.
        enumeration TcpIpAddressType: {TCPIP_MULTICAST, TCPIP_UNICAST}  # Address type.
        enumeration TcpIpDomainType: {TCPIP_AF_INET, TCPIP_AF_INET6}  # Address family.
        reference TcpIpCtrlRef: destination=TcpIpCtrl  # Reference to a TcpIpCtrl specifying the EthIf Controller where the IP address shall be assigned and DEM errors that shall be reported in case of an error on this controller.
        container TcpIpAddrAssignment [1..*]  # This container is a subcontainer of TcpIpLocalAddr and specifies the assignment policy for the IP address.
          enumeration TcpIpAssignmentLifetime [0..1]: {TCPIP_FORGET, TCPIP_STORE}, default-value=TCPIP_FORGET  # Defines the lifetime of a dynamically fetched IP address. | If TcpIpAssignmentMethod = TCPIP_STATIC then TcpIpAssignmentLifetime shall be omitted.
          enumeration TcpIpAssignmentMethod: {TCPIP_DHCP, TCPIP_IPV6_ROUTER, TCPIP_LINKLOCAL, TCPIP_LINKLOCAL_DOIP, TCPIP_STATIC}  # Method of address assignment
          integer TcpIpAssignmentPriority: 1..3  # Priority of assignment (1 is highest). If a new address from an assignment method with a higher priority is available, it overwrites the IP address previously assigned by an assignment method with a lower priority.
          enumeration TcpIpAssignmentTrigger: {TCPIP_AUTOMATIC, TCPIP_MANUAL}  # Trigger of address assignment.
        container TcpIpStaticIpAddressConfig [0..1]  # This container is a subcontainer of TcpIpLocalAddr and specifies a static IP address including directly related parameters.
          string TcpIpDefaultRouter [0..1]  # IP address of default router (gateway)
          integer TcpIpNetmask [0..1]: 0..128  # Network mask of IPv4 address or address prefix of IPv6 address in CIDR Notation, i.e. decimal value between 0 and 32 (IPv4) or 0 and 128 (IPv6) that describes the number of significant bits defining the network number or prefix of an IP address.
          string TcpIpStaticIpAddress  # Static IP Address. | To specify any IP address for a certain EthIfCtrl, â€œANYâ€ has to be set as wildcard. See TcpIp_Bind() for more details.
      container TcpIpNvmBlock [0..1]  # Configuration of optional usage of Nvm in case the TcpIp module requires non volatile memory in the Ecu to store information (e.g. IP Address received via DHCP and shall be stored).
        symbolic name reference TcpIpNvmBlockDescriptorRef: destination=NvMBlockDescriptor  # Reference to the Nvm block description in the Nvm module configuration.
      container TcpIpPhysAddrConfig [0..1]  # Specifies the physical address configuration.
        container TcpIpPhysAddrChgHandler [0..1]  # This container is a subcontainer of TcpIpPhysAddrConfig and | specifies the configuration parameters for physical address change handler.
          string TcpIpPhysAddrChgHandlerHeaderFileName: max-length=32, min-length=1  # This parameter specifies the name of the header file containing the definition of the physical address change handler function.
          function name TcpIpPhysAddrChgHandlerName  # This parameter defines the name of the physical address change function <Up>_PhysAddrTableChg.
      container TcpIpSocketOwnerConfig  # Specifies the upper layer modules of TcpIp using the socket API.
        container TcpIpSocketOwner [1..*]  # This container is a subcontainer of TcpIpSocketOwnerConfig and specifies an upper layer of TcpIp that uses the socket API.
          string TcpIpSocketOwnerCopyTxDataName [0..1]  # This parameter defines the name of the <Up_CopyTxData> function of the TcpIpSocketOwner module. The function name shall only be configurable if TcpIpSocketOwnerUpperLayerType is set to CDD.
          string TcpIpSocketOwnerHeaderFileName [0..1]  # This parameter specifies the name of the header file containing the definition of the TcpIpSocketOwner module functions. The header file name shall only be configurable if TcpIpSocketOwnerUpperLayerType is set to CDD.
          string TcpIpSocketOwnerLocalIpAddrAssignmentChgName [0..1]  # This parameter defines the name of the <Up_LocalIpAddrAssignmentChg> function of the TcpIpSocketOwner module. The function name shall only be configurable if TcpIpSocketOwnerUpperLayerType is set to CDD.
          string TcpIpSocketOwnerRxIndicationName [0..1]  # This parameter defines the name of the <Up_RxIndication> function of the TcpIpSocketOwner module. The function name shall only be configurable if TcpIpSocketOwnerUpperLayerType is set to CDD.
          string TcpIpSocketOwnerTcpAcceptedName [0..1]  # This parameter defines the name of the <Up_TcpAccepted> function of the TcpIpSocketOwner module. The function name shall only be configurable if TcpIpSocketOwnerUpperLayerType is set to CDD.
          string TcpIpSocketOwnerTcpConnectedName [0..1]  # This parameter defines the name of the <Up_TcpConnected> function of the TcpIpSocketOwner module. The function name shall only be configurable if TcpIpSocketOwnerUpperLayerType is set to CDD.
          function name TcpIpSocketOwnerTcpIpEventName [0..1]  # This parameter defines the name of the <Up_TcpIpEvent> function of the TcpIpSocketOwner module. The function name shall only be configurable if TcpIpSocketOwnerUpperLayerType is set to CDD.
          string TcpIpSocketOwnerTxConfirmationName [0..1]  # This parameter defines the name of the <Up_TxConfirmation> function of the TcpIpSocketOwner module. The function name shall only be configurable if TcpIpSocketOwnerUpperLayerType is set to CDD.
          enumeration TcpIpSocketOwnerUpperLayerType: {CDD, SOAD}  # This parameter specifies the type of the upper layer module.
      container TcpIpTcpConfig [0..1]  # Specifies the configuration parameters of the TCP (Transmission Control Protocol) sub-module.
        boolean TcpIpTcpCongestionAvoidanceEnabled  # Enables (TRUE) or disables (FALSE) support of TCP congestion avoidance algorithm according to IETF RFC 5681.
        boolean TcpIpTcpFastRecoveryEnabled  # Enables (TRUE) or disables (FALSE) support of TCP Fast Recovery according to IETF RFC 5681.
        boolean TcpIpTcpFastRetransmitEnabled  # Enables (TRUE) or disables (FALSE) support of TCP Fast Retransmission according to IETF RFC 5681.
        float TcpIpTcpFinWait2Timeout: 0..Inf  # Timeout in [s] to receive a FIN from the remote node (after this node has initiated connection termination), i.e. maximum time waiting in FINWAIT-2 for a connection termination request from the remote TCP.
        boolean TcpIpTcpKeepAliveEnabled: default-value=false  # Enables (TRUE) or disables (FALSE) TCP Keep Alive Probes according to IETF RFC 1122 chapter 4.2.3.6
        float TcpIpTcpKeepAliveInterval: 0..Inf  # Specifies the interval in [s] between subsequent keepalive probes.
        integer TcpIpTcpKeepAliveProbesMax: 0..65535  # Maximum number of times that a TCP Keep Alive is retransmitted before the connection is closed.
        float TcpIpTcpKeepAliveTime: 0..Inf, default-value=7200  # Specifies the time in [s] between the last data packet sent (simple ACKs are not considered data) and the first keepalive probe. Note: Setting this configuration parameter to a value smaller or equal to the value of TcpIpMainFunctionPeriod results in the transmission of keep alive probes within every MainFunction cycle.
        integer TcpIpTcpMaxRtx [0..1]: 0..255  # Maximum number of times that a TCP segment is retransmitted before the TCP connection is closed. This parameter is only valid if TcpIpTcpRetransmissionTimeout is configured. | Note: This parameter also applies for FIN retransmissions.
        float TcpIpTcpMsl: 0..Inf  # Maximum segment lifetime in [s]. | (Note: TIME-WAIT = 2 x TcpIpTcpMsl â€“ to ensure that the remote node received the acknowledgment to its connection termination request.)
        boolean TcpIpTcpNagleEnabled  # Enables (TRUE) or disables (FALSE) support of Nagleâ€™s algorithm according to IETF RFC 896. If enabled the Nagleâ€™s algorithm is activated per default for all TCP sockets, but can be deactivated via TcpIp_ChangeParameter() API.
        integer TcpIpTcpReceiveWindowMax: 0..65535  # Default value of maximum receive window in bytes.
        float TcpIpTcpRetransmissionTimeout [0..1]: 0.001..Inf  # Timeout in [s] before an unacknowledged TCP segment is sent again. | If the timeout is disabled or set to INF, no TCP segments shall be retransmitted.
        boolean TcpIpTcpSlowStartEnabled  # Enables (TRUE) or disables (FALSE) support of TCP slow start algorithm according to IETF RFC 5681.
        integer TcpIpTcpSynMaxRtx: 0..255  # Maximum number of times that a TCP SYN is retransmitted. | Note: SYN will be retried after TcpIpTcpRetransmissionTimeout. The connection will be dropped if no matching connection request has been received after the last TCP SYN has been sent and TcpIpTcpRetransmissionTimeout has been expired.
        float TcpIpTcpSynReceivedTimeout: 0..Inf  # Timeout in [s] to complete a remotely initiated TCP connection establishment, i.e. maximum time waiting in SYN-RECEIVED for a confirming connection request acknowledgment after having both received and sent a connection request.
        integer TcpIpTcpTtl: 0..255  # Default Time-to-live value of outgoing TCP packets.
      container TcpIpUdpConfig [0..1]  # Specifies the configuration parameters of the UDP (User Datagram Protocol) sub-module
        integer TcpIpUdpTtl: 0..255  # Default Time-to-live value of outgoing UDP packets.
    container TcpIpGeneral  # This container is a subcontainer of TcpIp and specifies the general configuration parameters of the TCP/IP stack.
      integer TcpIpBufferMemory: 0..4294967295  # Memory size in bytes reserved for TCP/IP buffers.
      boolean TcpIpDevErrorDetect  # Switches the Default Error Tracer (Det) detection and notification ON or OFF. | * true: enabled (ON). * false: disabled (OFF).
      boolean TcpIpDhcpServerEnabled  # Enables (TRUE) or disables (FALSE) the DHCP (Dynamic Host Configuration Protocol) Server.
      float TcpIpMainFunctionPeriod: 0..Inf  # Period of TcpIp_MainFunction in [s].
      boolean TcpIpResetIpAssignmentApi  # Enables/disables the API TcpIp_ResetIpAssignment of a DHCP-client.
      enumeration TcpIpScalabilityClass: {SC1, SC2, SC3}  # In order to customize the TcpIp Stack to the specific needs of the user it can be scaled according to the scalability classes.
      boolean TcpIpTcpEnabled  # Enables (TRUE) or disabled (FALSE) support of TCP (Transmission Control Protocol).
      integer TcpIpTcpSocketMax: 0..65535  # Maximum number of TCP sockets
      boolean TcpIpUdpEnabled  # Enables (TRUE) or disabled (FALSE) support of UDP (User Datagram Protocol)
      integer TcpIpUdpSocketMax: 0..65535  # Maximum number of UDP sockets.
      boolean TcpIpVersionInfoApi  # If true the TcpIp_GetVersionInfo API is available.
      container TcpIpIpV4General  # This container is a subcontainer of TcpIp and specifies the general configuration parameters of the TCP/IP stack for IPv4
        boolean TcpIpArpEnabled  # Enables (TRUE) or disables (FALSE) support of ARP (Address Resolution Protocol).
        boolean TcpIpAutoIpEnabled  # Enables (TRUE) or disables (FALSE) the Auto-IP (automatic private IP addressing) sub-module.
        boolean TcpIpDhcpClientEnabled  # Enables (TRUE) or disables (FALSE) the DHCP (Dynamic Host Configuration Protocol) Client.
        boolean TcpIpIcmpEnabled  # Enables (TRUE) or disabled (FALSE) support of ICMP (Internet Control Message Protocol).
        boolean TcpIpIpV4Enabled  # Enables (TRUE) or disables (FALSE) support of IPv4 (Internet Protocol version 4).
        integer TcpIpLocalAddrIpv4EntriesMax: 0..255  # Maximum number of LocalAddr table entries for IPv4.
        boolean TcpIpPathMtuDiscoveryEnabled  # Enables (TRUE) or disables (FALSE) the discovery of the maximum transmission unit on a path according to IETF RfC 1191.
      container TcpIpIpV6General  # This container is a subcontainer of TcpIp and specifies the general configuration parameters of the TCP/IP stack for IPv6.
        boolean TcpIpDhcpV6ClientEnabled  # Enables (TRUE) or disables (FALSE) the DHCPv6 (Dynamic Host Configuration Protocol for IPv6) Client.
        boolean TcpIpIpV6Enabled  # Enables (TRUE) or disables (FALSE) support of IPv6 (Internet Protocol version 6).
        boolean TcpIpIpV6PathMtuDiscoveryEnabled  # Enables (TRUE) or disables (FALSE) Path MTU Discovery support for IPv6 according to IETF RFC 1981.
        integer TcpIpLocalAddrIpv6EntriesMax: 0..255  # Maximum number of LocalAddr table entries for IPv6.
        boolean TcpIpNdpAddressResolutionUnrechabilityDetectionEnabled  # Enables (TRUE) or disables (FALSE) support of Address Resoultion and Neighbor Unreachability Detetion via NDP.
        boolean TcpIpNdpPrefixAndRouterDiscoveryEnabled  # Enables (TRUE) or disables (FALSE) support of Prefix and Router Discovery via NDP.
  module definition StbM [0..1]: variants pre-compile  # Configuration of the Synchronized Time-base Manager (StbM) module.
    container StbMGeneral  # This container holds the general parameters of the Synchronized Time-base Manager
      boolean StbMDevErrorDetect  # Switches the Default Error Tracer (Det) detection and notification ON or OFF. | * true: enabled (ON). * false: disabled (OFF).
      boolean StbMGetCurrentTimeExtendedAvailable [0..1]  # This allows to define whether an additional variant of the API GetCurrentTime with a 64 bit argument is provided.
      float StbMMainFunctionPeriod: 1E-6..Inf  # Schedule period of the main function StbM_MainFunction. Unit: [s].
      boolean StbMVersionInfo  # Activate/Deactivate the version information API (StbM_GetVersionInfo). True: version information API activated False: version information API deactivated.
    container StbMSynchronizedTimeBase [1..*]  # Synchronized time.base collects the information about a specific time-base provider within the system.
      boolean StbMIsSystemWideGlobalTimeMaster  # This parameter shall be set to true for a global time master that acts as a system-wide source of time information with respect to global time. | It is possible that several global time masters exist that have set this parameter set to true because the global time masters exist once per global time domain and one ECU may start several global time domains on different busses it is connected to.
      enumeration StbMStoreTimebaseNonVolatile [0..1]: {NO_STORAGE, STORAGE_AT_SHUTDOWN}  # This allows for specifying that the timebase shall be stored in the NvRam
      float StbMSyncLossThreshold [0..1]: 0..Inf  # This represents the minimum delta between the time value in two sync messages for which the sync loss flag is set. Unit: seconds.
      float StbMSyncLossTimeout [0..1]: 0..Inf  # This attribute describes the timeout for the situation that the time synchronization gets lost in the scope of the time domain. Unit: seconds
      integer StbMSynchronizedTimeBaseIdentifier: 0..65535, symbolic-name-value=true  # Identification of a synchronized time-base via a unique identifier.
      reference StbMEthGlobalTimeDomainRef [0..1]: destination=EthTSynGlobalTimeDomain  # Optional sub container in case a local time shall be accessed on an Ethernet bus.
      reference StbMLocalTimeRef [0..1]: destination=OsCounter  # This represents an optional sub-container in case a local time shall be accessed. | In this case, the designated OS counter has to be configured properly, meaning: * the counter is directly driven by a HW timer. * the counter's OsCounterTicksPerBase is one tick in x nanoseconds (ns).
      reference StbMOffsetTimeBase [0..1]: destination=StbMSynchronizedTimeBase  # This is the reference to the Synchronized Time-Base this Offset Time-Base is based on. This reference makes the containing StbMSynchronizedTimeBase an Offset Time-Base.
    container StbMTriggeredCustomer [0..*]  # The triggered customer is directly triggered by the Synchronized Time-base Manager by getting synchronized with the current (global) definition of time and passage of time.
      integer StbMTriggeredCustomerPeriod: 0..4294967295  # The triggering period of the triggered customer, called by the StbM_MainFunction. | The period is documented in microseconds.
      reference StbMOSScheduleTableRef: destination=OsScheduleTable  # Mandatory reference to synchronized OS ScheduleTable, which will be explicitly synchronized by the StbM.
      symbolic name reference StbMSynchronizedTimeBaseRef: destination=StbMSynchronizedTimeBase  # Mandatory reference to the required synchronized time-base.
  module definition EthIf [0..1]: variants link-time/post-build/pre-compile  # Configuration of the EthIf (Ethernet Interface) module.
    container EthIfConfigSet: multiple-configuration-container=true  # Collecting container for all parameters with post-build configuration classes.
      container EthIfController [1..*]  # This container contains the configuration of EthIfController.
        integer EthIfCtrlIdx: 0..255, set at link in variant link-time / post-build in variant post-build / pre-compile in variant pre-compile, symbolic-name-value=true  # This parameter provides a zero-based consecutive index of the Ethernet Communication Controllers. Upper layer BSW modules and the EthIf itself use this index to identify a Ethernet CC.
        integer EthIfCtrlMtu: 64..9000, set at link in variant link-time / post-build in variant post-build / pre-compile in variant pre-compile  # Specifies the maximum transmission unit (MTU) of the EthIfCtrl in [bytes]. | Note: in case a VLAN tag is used for the EthIfCtrl, the MTU is 4 bytes smaller than the maximum payload size of an Ethernet frame which can be transmitted on the network.
        integer EthIfMaxTxBufsTotal: 1..255, set at pre-compile  # Limits the total number of transmit buffers.
        integer EthIfVlanId [0..1]: 0..4095, set at link in variant link-time / post-build in variant post-build / pre-compile in variant pre-compile  # A virtual-LAN is identified by this attribute according to IEEE 802.1Q.
        symbolic name reference EthIfEthCtrlRef: set at link in variant link-time / post-build in variant post-build / pre-compile in variant pre-compile, destination=EthCtrlConfig  # Reference to a Controller, which is handled by a specific Driver. This reference is unique for the ECU.
        symbolic name reference EthIfEthTrcvRef: set at link in variant link-time / post-build in variant post-build / pre-compile in variant pre-compile, destination=EthTrcvConfig  # Reference to a Ethernet Transceiver.
      container EthIfFrameOwnerConfig [1..*]  # Configuration of Ethernet frame owner
        integer EthIfFrameType: 0..65535, set at link in variant link-time / post-build in variant post-build / pre-compile in variant pre-compile  # Selects the Ethernet frame type.
        integer EthIfOwner: 0..255, set at link in variant link-time / post-build in variant post-build / pre-compile in variant pre-compile  # Selects the owner of an Ethernet frame type. The owner is a zero based index into the callback function configuration 'EthIfRxIndicationConfig'. I.e. an Ethernet frame of type IPv4 (0x800) at index 0 will call the first callback function configured in 'EthIfRxIndicationConfig'.
      container EthIfRxIndicationConfig [1..*]  # Configuration of receive callback functions.
        function name EthIfRxIndicationFunction: set at link in variant link-time / post-build in variant post-build / pre-compile in variant pre-compile  # Specifies receive indication callback function.
      container EthIfTrcvLinkStateChgConfig [1..*]  # Specifies link state change callback function
        function name EthIfTrcvLinkStateChgFunction: set at link in variant link-time / post-build in variant post-build / pre-compile in variant pre-compile  # Specifies link state change callback function
      container EthIfTxConfirmationConfig [1..*]  # Configuration of transmit indication callback functions.
        function name EthIfTxConfirmationFunction: set at link in variant link-time / post-build in variant post-build / pre-compile in variant pre-compile  # Specifies transmit indication callback function
    container EthIfGeneral  # This container contains the general configuration parameters of the Ethernet Interface.
      boolean EthIfDevErrorDetect: set at pre-compile  # Enables / Disables development error detection.
      boolean EthIfEnableRxInterrupt: set at pre-compile  # Enables / Disables receive interrupt.
      boolean EthIfEnableTxInterrupt: set at pre-compile  # Enables / Disables the transmit interrupt.
      boolean EthIfGetBaudRate: set at pre-compile  # Enables / Disables GetBaudRate API.
      boolean EthIfGetCounterState: set at pre-compile  # Enables / Disables GetCounterState API.
      float EthIfMainFunctionPeriod: 0..Inf, set at pre-compile  # Specifies the period of main function EthIf_MainFunctionRx and EthIf_MainFunctionTx in seconds. Ethernet Interface does not require this information but the BSW scheduler.
      float EthIfMainFunctionRxTimeout: 0..Inf, set at pre-compile  # Timeout in seconds after which the EthIf stops to receive frames in an EthIfMainFunctionRx period.
      integer EthIfMaxTrcvsTotal: 1..255, set at pre-compile  # Limits the total number of transceivers.
      string EthIfPublicCddHeaderFile [0..*]: set at pre-compile, max-length=32, min-length=1  # Defines header files for callback functions which shall be included in case of CDDs. Range of characters is 1.. 32.
      integer EthIfRxIndicationIterations: 0..65535, set at pre-compile  # Maximum number of Ethernet frames per Ethernet controller polled from the Ethernet driver within EthIf_MainFunctionRx.
      boolean EthIfStartAutoNegotiation: set at pre-compile  # Enables / Disables StartAutoNegotiation API.
      integer EthIfTrcvLinkStateChgMainReload: 1..255, set at pre-compile  # Specifies the frequency of transceiver link state change checks in each | period of main function EthIf_MainFunctionTx.
      boolean EthIfVersionInfoApi: set at pre-compile  # Enables / Disables version info API
      boolean EthIfVersionInfoApiMacro: set at pre-compile  # Enables / Disables version info API macro implementation.
  module definition Eth [0..*]: variants link-time/post-build/pre-compile  # Configuration of the Eth (Ethernet Driver) module.
    container EthConfigSet  # This container contains the configuration parameters and sub containers of the AUTOSAR Eth module.
      container EthCtrlConfig [1..*]  # Configuration of the individual controller
        boolean EthCtrlEnableMii  # Enables / Disables Media Independent Interface (MII) for transceiver access
        boolean EthCtrlEnableRxInterrupt  # Enables / Disables receive interrupt
        boolean EthCtrlEnableTxInterrupt  # Enables / Disables transmit interrupt
        integer EthCtrlIdx: 0..255, symbolic-name-value=true  # Specifies the instance ID of the configured controller.
        string EthCtrlPhyAddress [0..1]: max-length=17, min-length=17  # Specifies the unique 48-bit physical address (MAC address) of the controller in network byte order. | Regular Expression: [0-9a-fA-F]{2}[[:-][0-9a-fA-F]{2}]{5}
        integer EthCtrlRxBufLenByte: 0..1522  # Limits the maximum receive buffer length (frame length) in bytes.
        integer EthCtrlTxBufLenByte: 0..1522  # Limits the maximum transmit buffer length (frame length) in bytes.
        integer EthRxBufTotal: 0..255  # Configures the number of receive buffers.
        integer EthTxBufTotal: 0..255  # Configures the number of transmit buffers.
        container EthDemEventParameterRefs [0..1]  # Container for the references to DemEventParameter elements which shall be invoked using the API Dem_ReportErrorStatus in case the corresponding error occurs. The EventId is taken from the referenced DemEventParameter's DemEventId value. The standardized errors are provided in the container and can be extended by vendor specific error references.
          symbolic name reference ETH_E_ACCESS [0..1]: destination=DemEventParameter  # Reference to the DemEventParameter which shall be issued when the error "Controller access failed" has occured.
          symbolic name reference ETH_E_ALIGNMENT [0..1]: destination=DemEventParameter  # Reference to the DemEventParameter which shall be issued when the error "Alignment Error" has occured.
          symbolic name reference ETH_E_CRC [0..1]: destination=DemEventParameter  # Reference to the DemEventParameter which shall be issued when the error "CRC Failure" has occured.
          symbolic name reference ETH_E_LATECOLLISION [0..1]: destination=DemEventParameter  # Reference to the DemEventParameter which shall be issued when the error "Late Collisions" has occured.
          symbolic name reference ETH_E_MULTIPLECOLLISION [0..1]: destination=DemEventParameter  # Reference to the DemEventParameter which shall be issued when the error "Multiple Collisions" has occured.
          symbolic name reference ETH_E_OVERSIZEFRAME [0..1]: destination=DemEventParameter  # Reference to the DemEventParameter which shall be issued when the error "Oversized Frame" has occured.
          symbolic name reference ETH_E_RX_FRAMES_LOST [0..1]: destination=DemEventParameter  # Reference to the DemEventParameter which shall be issued when the error "receive frames lost" has occured.
          symbolic name reference ETH_E_SINGLECOLLISION [0..1]: destination=DemEventParameter  # Reference to the DemEventParameter which shall be issued when the error "Single Collisions" has occured.
          symbolic name reference ETH_E_UNDERSIZEFRAME [0..1]: destination=DemEventParameter  # Reference to the DemEventParameter which shall be issued when the error "Undersized Frame" has occured.
    container EthGeneral  # General configuration of Ethernet Driver module
      boolean EthDevErrorDetect  # Switches the Default Error Tracer (Det) detection and notification ON or OFF. | * true: enabled (ON). * false: disabled (OFF).
      boolean EthGetDropCountApi  # Enables / Disables Eth_GetDropCount API.
      boolean EthGetEtherStatsApi  # Enables / Disables Eth_GetEtherStats API.
      boolean EthGlobalTimeSupport  # Enables/Disables the GlobalTime APIs used amongst others by Global Time Synchronization over Ethernet.
      integer EthIndex: 0..255  # Specifies the InstanceId of this module instance. If only one instance is present it shall have the Id 0.
      float EthMainFunctionPeriod: 0..Inf  # Specifies the period of main function Eth_MainFunction in seconds. Ethernet driver does not require this information but the BSW scheduler.
      integer EthMaxCtrlsSupported: 1..255  # Limits the total number of supported controllers.
      boolean EthUpdatePhysAddrFilter: default-value=false  # Enables/Disables optional API Eth_UpdatePhysAddrFilter.
      boolean EthVersionInfoApi  # Enables / Disables version info API
      container EthCtrlOffloading  # Configuration of hardware offloading features.
        boolean EthCtrlEnableOffloadChecksumICMP  # Enables / Disables hardware offloading for ICMP checksums.
        boolean EthCtrlEnableOffloadChecksumIPv4  # Enables / Disables hardware offloading for IPv4 checksums.
        boolean EthCtrlEnableOffloadChecksumTCP  # Enables / Disables hardware offloading for TCP checksums.
        boolean EthCtrlEnableOffloadChecksumUDP  # Enables / Disables hardware offloading for UDP checksums.
