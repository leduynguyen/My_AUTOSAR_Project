AUTOSAR XML (schema 4-2-2)
package /ArcCore/EcucDefs/zynq
  module definition Mcu [0..1]: refined-module-def=Mcu, variants post-build/pre-compile  # Configuration of the Mcu (Microcontroller Unit) module.
    container McuGeneralConfiguration  # This container contains the configuration (parameters) of the MCU driver.
      boolean McuDevErrorDetect: set at pre-compile  # Pre-processor switch for enabling the development error detection and reporting.
      boolean McuGetRamStateApi: set at pre-compile  # Pre-processor switch to enable/disable the API Mcu_GetRamState. | (e.g. If the H/W does not support the functionality, this parameter can be used to disable the Api).
      boolean McuInitClock: set at pre-compile, default-value=1  # If this parameter is set to FALSE, the clock initialization has to be disabled from the MCU driver. This concept applies when there are some write once clock registers and a bootloader is present. If this parameter is set to TRUE, the MCU driver is responsible of the clock initialization.
      boolean McuNoPll: set at pre-compile, default-value=0  # This parameter shall be set True, if the H/W does not have a PLL or the PLL circuitry is enabled after the power on without S/W intervention. In this case MCU_DistributePllClock has to be disabled and MCU_GetPllStatus has to return MCU_PLL_STATUS_UNDEFINED. Otherwise this parameters has to be set False
      boolean McuPerformResetApi: set at pre-compile  # Pre-processor switch to enable / disable the use of the function Mcu_PerformReset()
      boolean McuVersionInfoApi: set at pre-compile  # Pre-processor switch to enable / disable the API to read out the modules version information.
    container McuModuleConfiguration: multiple-configuration-container=true  # This container contains the configuration (parameters) of the MCU driver
      enumeration McuClockSrcFailureNotification: {DISABLED, ENABLED}, set at post-build in variant post-build / pre-compile in variant pre-compile  # Enables/Disables clock failure notification. In case this feature is not supported by HW the setting should be disabled.
      integer McuNumberOfMcuModes: 1..255, set at post-build in variant post-build / pre-compile in variant pre-compile  # This parameter shall represent the number of Modes available for the MCU. | calculationFormula = Number of configured McuModeSettingConf
      integer McuRamSectors: 0..4294967295, set at post-build in variant post-build / pre-compile in variant pre-compile  # This parameter shall represent the number of RAM sectors available for the MCU. | calculationFormula = Number of configured McuRamSectorSettingConf
      integer McuResetSetting [0..1]: 1..255, set at pre-compile  # This parameter relates to the MCU specific reset configuration. This applies to the function Mcu_PerformReset, which performs a microcontroller reset using the hardware feature of the microcontroller.
      reference ArcDefaultClockRef: set at pre-compile in variant pre-compile / post-build in variant post-build, origin=ARCCORE_ECUC, destination=McuClockSettingConfig  # This parameter contains a reference to the default clock that will be used at initialization
      container McuClockSettingConfig [1..*]  # This container contains the configuration (parameters) for the Clock settings of the MCU. Please see MCU031 for more information on the MCU clock settings.
        integer McuClockSettingId: 0..255, set at post-build in variant post-build / pre-compile in variant pre-compile, symbolic-name-value=true  # The Id of this McuClockSettingConfig to be used as argument for the API call "Mcu_InitClock".
        container McuClockReferencePoint [1..*]  # This container defines a reference point in the Mcu Clock tree. It defines the frequency which then can be used by other modules as an input value. Lower multiplicity is 1, as even in the simplest case (only one frequency is used), there is one frequency to be defined.
          float McuClockReferencePointFrequency: 0..Inf, scope=ECU, set at post-build in variant post-build / pre-compile in variant pre-compile  # This is the frequency for the specific instance of the McuClockReferencePoint container. It shall be given in Hz.
        container ArcPLLSettings  # PLL Settings
          integer ARM_PLL_FDIV: set at pre-compile, origin=ARCCORE_ECUC  # Provide the feedback divisor for the PLL. Note: Before changing this value, the PLL must first be bypassed and then put into reset mode. Refer to the Zynq-7000 TRM, UG585, Clocks chapter for P/RES/CNT values for the PLL.
          integer ARM_PLL_LOCK_CNT: set at pre-compile, origin=ARCCORE_ECUC  # Drive the LOCK_CNT[9:0] input of the PLL to set the number of clock cycles the PLL needs to have clkref and clkfb aligned with a certain window before syaing locked.
          integer ARM_PLL_CP: set at pre-compile, origin=ARCCORE_ECUC  # Drive the PLL_CP[3:0] input of the PLL to set the PLL charge pump control
          integer ARM_PLL_RES: set at pre-compile, origin=ARCCORE_ECUC  # Drive the PLL_RES[3:0] input of the PLL to set the PLL loop filter resistor control
          integer IO_PLL_FDIV: set at pre-compile, origin=ARCCORE_ECUC  # Provide the feedback divisor for the PLL. Note: Before changing this value, the PLL must first be bypassed and then put into reset mode. Refer to the Zynq-7000 TRM, UG585, Clocks chapter for P/RES/CNT values for the PLL.
          integer IO_PLL_LOCK_CNT: set at pre-compile, origin=ARCCORE_ECUC  # Drive the LOCK_CNT[9:0] input of the PLL to set the number of clock cycles the PLL needs to have clkref and clkfb aligned with a certain window before syaing locked.
          integer IO_PLL_CP: set at pre-compile, origin=ARCCORE_ECUC  # Drive the PLL_CP[3:0] input of the PLL to set the PLL charge pump control
          integer IO_PLL_RES: set at pre-compile, origin=ARCCORE_ECUC  # Drive the PLL_RES[3:0] input of the PLL to set the PLL loop filter resistor control
        container ArcClockSettings  # PLL Settings
          integer LQSPI_DIVISOR: set at pre-compile, origin=ARCCORE_ECUC  # Divisor for Quad SPI source clock.
          integer GEM0_DIVISOR: set at pre-compile, origin=ARCORE_ECUC  # First divisor for Ethernet controller 0 source clock.
          integer SMC_DIVISOR: set at pre-compile, origin=ARCCORE_ECUC  # Divisor for SMC source clock.
          integer SDIO_DIVISOR: set at pre-compile, origin=ARCCORE_ECUC  # Provides the divisor used to divide the source clock to generate the required generated clock frequency.
          integer SPI_DIVISOR: set at pre-compile, origin=ARCCORE_ECUC  # Provides the divisor used to divide the source clock to generate the required generated clock frequency.
          integer CPU_DIVISOR: 1.., set at pre-compile, origin=ARCCORE_ECUC  # Frequency divisor for the CPU clock source.
          integer UART_DIVISOR: set at pre-compile, origin=ARCCORE_ECUC  # Divisor for UART Controller source clock.
          integer CAN_DIVISOR1: set at pre-compile, origin=ARCCORE_ECUC  # Provides the divisor used to divide the source clock to generate the required generated clock frequency. Second cascade divider.
          integer PCAP_DIVISOR: set at pre-compile, origin=ARCCORE_ECUC  # Divisor for PCAP source clock.
          integer CAN_DIVISOR: set at pre-compile, origin=ARCCORE_ECUC, symbolic-name-value=true  # Provides the divisor used to divide the source clock to generate the required generated clock frequency. First cascade divider
          integer CAN_MIOCLK_CTRL: set at pre-compile, origin=ARCCORE_ECUC, default-value=0  # Value for the CAN_MIOCLK_CTRL register.
          integer GEM0_DIVISOR1: set at pre-compile, origin=ARCORE_ECUC  # Second divisor for Ethernet controller 0 source clock.
          integer GEM1_DIVISOR: set at pre-compile, origin=ARCORE_ECUC  # First divisor for Ethernet controller 0 source clock.
          integer GEM1_DIVISOR1: set at pre-compile, origin=ARCORE_ECUC  # Second divisor for Ethernet controller 0 source clock.
          boolean CAN_CLKACT: set at pre-compile in variant pre-compile / post-build in variant post-build, origin=ARCCORE_ECUC, default-value=0  # CAN 0 Reference Clock active: 0: Clock is disabled 1: Clock is enabled | true: Alarm debug, false: No alarm debug
          boolean CAN_CLKACT1: set at pre-compile in variant pre-compile / post-build in variant post-build, origin=ARCCORE_ECUC, default-value=0  # CAN 1 Reference Clock active: 0: Clock is disabled 1: Clock is enabled | true: Alarm debug, false: No alarm debug
          boolean CPU_1XCLKACT: set at pre-compile in variant pre-compile / post-build in variant post-build, origin=ARCCORE_ECUC, default-value=0  # CPU_1x Clock control | true: Alarm debug, false: No alarm debug
          boolean CPU_2XCLKACT: set at pre-compile in variant pre-compile / post-build in variant post-build, origin=ARCCORE_ECUC, default-value=0  # CPU_2x Clock control | true: Alarm debug, false: No alarm debug
          boolean CPU_3OR2XCLKACT: set at pre-compile in variant pre-compile / post-build in variant post-build, origin=ARCCORE_ECUC, default-value=0  # CPU_3x2x Clock control: 0: disable, 1: enable | true: Alarm debug, false: No alarm debug
          boolean CPU_6OR4XCLKACT: set at pre-compile in variant pre-compile / post-build in variant post-build, origin=ARCCORE_ECUC, default-value=0  # CPU_6x4x Clock control: 0: disable, 1: enable | true: Alarm debug, false: No alarm debug
          boolean GEM0_CLKACT: set at pre-compile in variant pre-compile / post-build in variant post-build, origin=ARCCORE_ECUC, default-value=0  # Ethernet Controller Reference Clock control | true: Alarm debug, false: No alarm debug
          boolean GEM1_CLKACT: set at pre-compile in variant pre-compile / post-build in variant post-build, origin=ARCCORE_ECUC, default-value=0  # Ethernet Controller Reference Clock control | true: Alarm debug, false: No alarm debug
          boolean SPI_CLKACT: set at pre-compile in variant pre-compile / post-build in variant post-build, origin=ARCCORE_ECUC, default-value=0  # SPI 0 reference clock active: 0: Clock is disabled 1: Clock is enabled | true: Alarm debug, false: No alarm debug
          boolean SPI_CLKACT1: set at pre-compile, origin=ARCCORE_ECUC, default-value=0  # SPI 1 reference clock active: 0: Clock is disabled 1: Clock is enabled | true: Alarm debug, false: No alarm debug
          boolean UART_CLKACT: set at pre-compile in variant pre-compile / post-build in variant post-build, origin=ARCCORE_ECUC, default-value=0  # UART 0 reference clock active: 0: Clock is disabled 1: Clock is enabled | true: Alarm debug, false: No alarm debug
          boolean UART_CLKACT1: set at pre-compile in variant pre-compile / post-build in variant post-build, origin=ARCCORE_ECUC, default-value=0  # UART 1 reference clock active: 0: Clock is disabled 1: Clock is enabled | true: Alarm debug, false: No alarm debug
          boolean LQSPI_CLKACT: set at pre-compile in variant pre-compile / post-build in variant post-build, origin=ARCCORE_ECUC, default-value=0  # Alarm debug | true: Alarm debug, false: No alarm debug
          boolean SDIO_CLKACT1: set at pre-compile in variant pre-compile / post-build in variant post-build, origin=ARCCORE_ECUC, default-value=0  # SDIO Controller 1 Clock control. 0: disable, 1: enable | true: Alarm debug, false: No alarm debug
          boolean SDIO_CLKACT: set at pre-compile in variant pre-compile / post-build in variant post-build, origin=ARCCORE_ECUC, default-value=0  # SDIO Controller 0 Clock control. 0: disable, 1: enable | true: Alarm debug, false: No alarm debug
          boolean SMC_CLKACT: set at pre-compile in variant pre-compile / post-build in variant post-build, origin=ARCCORE_ECUC, default-value=0  # SMC Reference Clock control 0: disable, 1: enable | true: Alarm debug, false: No alarm debug
          boolean PCAP_CLKACT: set at pre-compile in variant pre-compile / post-build in variant post-build, origin=ARCCORE_ECUC, default-value=0  # Clock active: 0: Clock is disabled 1: Clock is enabled | true: Alarm debug, false: No alarm debug
          boolean CPU_PERI_CLKACT: set at pre-compile in variant pre-compile / post-build in variant post-build, origin=ARCCORE_ECUC, default-value=0  # Clock active: 0: Clock is disabled 1: Clock is enabled | true: Alarm debug, false: No alarm debug
          enumeration GEM0_RCLK_CTRL: {UNSET, MIO, EMIO}, set at post-build in variant post-build / pre-compile in variant pre-compile  # Selects the source of controller Rx Clock
          enumeration GEM1_RCLK_CTRL: {UNSET, EMIO, MIO}, set at post-build in variant post-build / pre-compile in variant pre-compile  # Selects the source of controller Rx Clock
          boolean GEM0_RCLK_CLKACT: set at pre-compile in variant pre-compile / post-build in variant post-build, origin=ARCCORE_ECUC, default-value=0  # Ethernet Controller Rx Clock control | true: Alarm debug, false: No alarm debug
          boolean GEM1_RCLK_CLKACT: set at pre-compile in variant pre-compile / post-build in variant post-build, origin=ARCCORE_ECUC, default-value=0  # Ethernet Controller Rx Clock control | true: Alarm debug, false: No alarm debug
      container McuDemEventParameterRefs [0..1]  # Container for the references to DemEventParameter elements which shall be invoked using the API Dem_ReportErrorStatus API in case the corresponding error occurs. The EventId is taken from the referenced DemEventParameter's DemEventId symbolic name. The standardized errors are provided in the container and can be extended by vendor specific error references.
        symbolic name reference MCU_E_CLOCK_FAILURE [0..1]: set at pre-compile, destination=DemEventParameter  # Reference to configured DEM event to report "Clock source failure".
      container McuModeSettingConf [1..*]  # This container contains the configuration (parameters) for the Mode setting of the MCU. Please see MCU035 for more information on the MCU mode settings.
        integer McuMode: 0..255, set at post-build in variant post-build / pre-compile in variant pre-compile, symbolic-name-value=true  # The parameter represents the MCU Mode settings.
      container McuRamSectorSettingConf [0..*]  # This container contains the configuration (parameters) for the RAM Sector setting. Please see MCU030 for more information on RAM sec-tor settings.
        integer McuRamDefaultValue: 0..255, set at post-build in variant post-build / pre-compile in variant pre-compile  # This parameter shall represent the Data pre-setting to be initialized
        integer McuRamSectionBaseAddress: 0..4294967295, set at post-build in variant post-build / pre-compile in variant pre-compile  # This parameter shall represent the MCU RAM section base address
        integer McuRamSectionSize: 0..4294967295, set at post-build in variant post-build / pre-compile in variant pre-compile  # This parameter represents the MCU RAM Section size in bytes.
    container McuPublishedInformation  # Container holding all MCU specific published information parameters
      container McuResetReasonConf [1..*]  # This container contains the configuration for the different type of reset reason that can be retrieved from Mcu_GetResetReason Api.
        integer McuResetReason: 0..255, scope=ECU, set at published-information, symbolic-name-value=true  # The parameter represents the different type of reset that a Micro supports. This parameter is referenced by the parameter EcuMResetReason in the ECU State manager module.
