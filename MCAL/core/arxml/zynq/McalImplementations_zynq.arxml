AUTOSAR XML (schema 4-2-2)
package /ArcCore/Implementations/zynq
  12 x bsw implementation, all with programming-language=C, vendor-id=60, ar-release-version=4.1.2:
    Adc: sw-version=2.0.0, used-code-generator=generators::mcal::zynq::Adc::main, vendor-specific-module-def=Adc
    Can: sw-version=5.0.0, used-code-generator=generators::mcal::zynq::Can::main, vendor-specific-module-def=Can
    Dio: sw-version=5.0.0, used-code-generator=generators::mcal::zynq::Dio::main, vendor-specific-module-def=Dio
    Gpt: sw-version=3.0.0, used-code-generator=generators::mcal::zynq::Gpt::main, vendor-specific-module-def=Gpt
    Mcu: sw-version=2.0.0, used-code-generator=generators::mcal::zynq::Mcu::main, vendor-specific-module-def=Mcu
    Pwm: sw-version=2.1.0, used-code-generator=generators::mcal::zynq::Pwm::main, vendor-specific-module-def=Pwm
    Port: sw-version=5.0.1, used-code-generator=generators::mcal::zynq::Port::main, vendor-specific-module-def=Port
    Icu: sw-version=2.0.0, used-code-generator=generators::mcal::zynq::Icu::main, vendor-specific-module-def=Icu
    Spi: sw-version=2.0.0, used-code-generator=generators::mcal::zynq::Spi::main, vendor-specific-module-def=Spi
    Wdg: sw-version=2.0.0, used-code-generator=generators::mcal::zynq::Wdg::main, vendor-specific-module-def=Wdg
    Eth: sw-version=1.0.0, used-code-generator=generators::generic::Eth::main, vendor-specific-module-def=Eth
    Lin: sw-version=2.1.1, used-code-generator=generators::mcal::zynq::Lin::main, vendor-specific-module-def=Lin
