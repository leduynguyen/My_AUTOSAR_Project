AUTOSAR XML (schema 4-2-2)
package /ArcCore/Implementations/jacinto5
  8 x bsw implementation, all with ar-release-version=4.1.2:
    Pwm: programming-language=C, sw-version=2.1.0, used-code-generator=generators::mcal::jacinto::Pwm::main, vendor-specific-module-def=Pwm
    Port: sw-version=5.0.1, used-code-generator=generators::mcal::jacinto::Port::main, vendor-id=60, vendor-specific-module-def=Port
    Dio: programming-language=C, sw-version=5.0.0, used-code-generator=generators::mcal::jacinto::Dio::main, vendor-specific-module-def=Dio
    Mcu: programming-language=C, sw-version=2.0.0, used-code-generator=generators::mcal::jacinto::Mcu::main, vendor-specific-module-def=Mcu
    Can: programming-language=C, sw-version=5.0.0, used-code-generator=generators::mcal::jacinto::Can::main, vendor-specific-module-def=Can
    Gpt: programming-language=C, sw-version=3.0.0, used-code-generator=generators::mcal::jacinto::Gpt::main, vendor-id=60, vendor-specific-module-def=Gpt
    Adc: programming-language=C, sw-version=2.0.0, used-code-generator=generators::mcal::jacinto::Adc::main, vendor-id=60, vendor-specific-module-def=Adc
    Spi: programming-language=C, sw-version=2.0.0, used-code-generator=generators::mcal::jacinto::Spi::main, vendor-specific-module-def=Spi
