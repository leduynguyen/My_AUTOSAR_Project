AUTOSAR XML (schema 4-2-2)
package /ArcCore/EcucDefs/jacinto
  module definition Eth [0..*]: refined-module-def=Eth, variants link-time/post-build/pre-compile  # Configuration of the Eth (Ethernet Driver) module.
    container EthConfigSet: multiple-configuration-container=true  # All included containers and parameters that may be part of a multiple configuration set.
      container EthCtrlConfig [1..*]  # Configuration of the individual controller
        boolean EthCtrlEnableMii: set at pre-compile, default-value=1  # Enables / Disables Media Independent Interface (MII) for transceiver access
        boolean EthCtrlEnableRxInterrupt: set at pre-compile, default-value=1  # Enables / Disables receive interrupt
        boolean EthCtrlEnableTxInterrupt: set at pre-compile, default-value=1  # Enables / Disables transmit interrupt
        integer EthCtrlIdx: 0..255, scope=ECU, set at link in variant link-time / post-build in variant post-build / pre-compile in variant pre-compile, symbolic-name-value=true  # Specifies the instance ID of the configured controller.
        string EthCtrlPhyAddress [0..1]: set at link in variant link-time / post-build in variant post-build / pre-compile in variant pre-compile, max-length=17, min-length=17  # Specifies the unique 48-bit physical address (MAC address) of the controller in network byte order. | Regular Expression: [0-9a-fA-F]{2}[[:-][0-9a-fA-F]{2}]{5}
        integer EthCtrlRxBufLenByte: 0..1522, set at link in variant link-time / post-build in variant post-build / pre-compile in variant pre-compile  # Limits the maximum receive buffer length (frame length) in bytes.
        integer EthCtrlTxBufLenByte: 0..1522, set at link in variant link-time / post-build in variant post-build / pre-compile in variant pre-compile  # Limits the maximum transmit buffer length (frame length) in bytes.
        integer EthRxBufTotal: 0..255, set at link in variant link-time / post-build in variant post-build / pre-compile in variant pre-compile  # Configures the number of receive buffers.
        integer EthTxBufTotal: 0..255, set at link in variant link-time / post-build in variant post-build / pre-compile in variant pre-compile  # Configures the number of transmit buffers.
        enumeration ArcEthControllerHwUnit: {GMAC_SW_PORT1, GMAC_SW_PORT2}, set at pre-compile, origin=ARCCORE_ECUC  # Determines the hardware unit.
        enumeration ArcEthControllerHwSpeed: {MBPS_100, MBPS_10}, set at pre-compile, origin=ARCCORE_ECUC  # Determines the HW communication speed
        boolean ArcEthCtrlEnableRxChecksumOffload: set at pre-compile, default-value=1  # Enables / Disables Hardware checksum offload mechanism, if disabled controller will not verify checksum
        boolean ArcEthCtrlEnableTxChecksumOffload: set at pre-compile, default-value=1  # Enables / Disables Hardware checksum offload mechanism, When disabled controller will not generate checksum
        boolean ArcEthCtrlDiscardRxFCS: set at pre-compile, default-value=1  # Enables/disables Rx FCS, FCS is discarded when copied for the received buffers if this is enabled
        enumeration ArcEthControllerHwMIIMode: {RMII, MII, RGMII}, set at pre-compile, origin=ARCCORE_ECUC  # Selection of MII mode of the controller
        container EthDemEventParameterRefs [0..1]  # Container for the references to DemEventParameter elements which shall be invoked using the API Dem_ReportErrorStatus in case the corresponding error occurs. The EventId is taken from the referenced DemEventParameter's DemEventId value. The standardized errors are provided in the container and can be extended by vendor specific error references.
          symbolic name reference ETH_E_ACCESS [0..1]: set at link in variant link-time / post-build in variant post-build / pre-compile in variant pre-compile, destination=DemEventParameter  # Reference to the DemEventParameter which shall be issued when the error "Controller access failed" has occured.
    container EthGeneral  # General configuration of Ethernet Driver module
      boolean EthDevErrorDetect: set at pre-compile, default-value=1  # Enables / Disables development error detection.
      integer EthIndex: 0..255, set at pre-compile  # Specifies the InstanceId of this module instance. If only one instance is present it shall have the Id 0.
      integer EthMaxCtrlsSupported: 1..255, set at pre-compile  # Limits the total number of supported controllers.
      boolean EthUpdatePhysAddrFilter: set at pre-compile, default-value=false  # Enables/Disables optional API Eth_UpdatePhysAddrFilter.
      boolean EthVersionInfoApi: set at pre-compile, default-value=0  # Enables / Disables version info API
      integer ArcEthCpu1xclkValue: 0..540, set at link in variant link-time / post-build in variant post-build / pre-compile in variant pre-compile  # cpu_1xclk speed in MHz, MDC clock division is set according to this value, please round this to nearest decimal value
