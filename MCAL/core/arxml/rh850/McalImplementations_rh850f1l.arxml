AUTOSAR XML (schema 4-2-2)
package /ArcCore/Implementations/rh850f1l
  11 x bsw implementation, all with programming-language=C, vendor-id=60:
    Can: sw-version=5.0.0, used-code-generator=generators::mcal::rh850::Can::main, ar-release-version=4.1.3, vendor-specific-module-def=Can
    Fr: sw-version=1.0.0, used-code-generator=generators::mcal::rh850::Fr::main, ar-release-version=4.0.3, vendor-specific-module-def=Fr
    Port: sw-version=5.0.1, used-code-generator=generators::mcal::rh850::Port_f1x::main, ar-release-version=4.1.2, vendor-specific-module-def=Port
    Dio: sw-version=5.0.0, used-code-generator=generators::mcal::rh850::Dio::main, ar-release-version=4.1.2, vendor-specific-module-def=Dio
    Gpt: sw-version=3.0.0, used-code-generator=generators::mcal::rh850::Gpt::main, ar-release-version=4.1.3, vendor-specific-module-def=Gpt
    Mcu: sw-version=2.0.0, used-code-generator=generators::mcal::rh850::Mcu_f1l::main, ar-release-version=4.1.2, vendor-specific-module-def=Mcu
    Eth: sw-version=1.0.0, used-code-generator=generators::generic::Eth::main, ar-release-version=4.0.3, vendor-specific-module-def=Eth
    Wdg: sw-version=2.0.0, used-code-generator=generators::mcal::rh850::Wdg::main, ar-release-version=4.1.3, vendor-specific-module-def=Wdg
    Adc: sw-version=2.0.0, used-code-generator=generators::mcal::rh850::Adc::main, ar-release-version=4.1.3, vendor-specific-module-def=Adc
    Spi: sw-version=2.0.0, used-code-generator=generators::mcal::rh850::Spi::main, ar-release-version=4.1.3, vendor-specific-module-def=Spi
    Pwm: sw-version=2.1.0, used-code-generator=generators::mcal::rh850::Pwm::main, ar-release-version=4.1.3, vendor-specific-module-def=Pwm
