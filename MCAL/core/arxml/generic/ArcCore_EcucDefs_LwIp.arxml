AUTOSAR XML (schema 4-2-2)
package /ArcCore/EcucDefs/Generic
  module definition LwIp [0..1]: variants pre-compile  # Configuration of the LwIp module
    container LwIpGeneral  # Configuration of DHCP and AutoIP options
      boolean LwIpDhcp: set at pre-compile, origin=ARC_ECUC, default-value=1  # This parameter indicates whether DHCP is used or not
      boolean LwIpAutoIp: set at pre-compile, origin=ARC_ECUC, default-value=0  # This parameter indicates whether AutoIP is used or not
      string LwIpIPAddress: set at pre-compile  # This parameter sets the IP address e.g. 192.168.0.5
      string LwIpNetmask: set at pre-compile  # This parameter sets the netmask e.g. 255.255.255.0
      string LwIpEthernetMacAddress: set at pre-compile  # This parameter sets the Ethernet MAC address. E.g. 00-00-00-00-00-06
      string LwIpGateway: set at pre-compile  # This parameter sets the gateway address e.g. 192.168.0.1
    container LwIpAdvanced  # Advanced memory management
      integer LwIpMempNumNetConn: default-value=6  # MEMP_NUM_NETCONN: the number of struct netconns. This must be increased if you add more sockets then default is supported by config.
      integer LwIpPoolSize: default-value=10  # PBUF_POOL_SIZE: the number of buffers in the pbuf pool.
      integer LwIpMemSize: default-value=1600  # MEM_SIZE: the size of the heap memory. If the application will send a lot of data that needs to be copied, this should be set high.
      integer LwIpMempNumPBuf: default-value=10  # MEMP_NUM_PBUF: the number of memp struct pbufs. If the application sends a lot of data out of ROM (or other static memory), this should be set high.
package /ArcCore/EcucDefs/Generic/Implementations
  bsw implementation LwIp: programming-language=C, sw-version=1.0.0, used-code-generator=generators::generic::LwIp::main, vendor-id=60, ar-release-version=4.0.3, vendor-specific-module-def=LwIp
