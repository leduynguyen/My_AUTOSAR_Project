AUTOSAR XML (schema 4-2-2)
standard types defined: boolean, uint8, uint16, uint32, sint8, sint16, sint32, float32, float64, void, sint64, uint64
package /ArcCore/Platform/BaseTypes
  base type utf8: category=FIXED_LENGTH, base-type-size=8, base-type-encoding=UTF-8, native-declaration=uint8
  base type ucs2: category=FIXED_LENGTH, base-type-size=16, base-type-encoding=UCS-2, native-declaration=uint16
package /ArcCore/Platform/ImplementationDataTypes
  8 x impl type, all with category=DATA_REFERENCE:
    ConstVoidPtr: sw-pointer-target-props={target-category=VALUE, base-type=BaseTypes/void, sw-impl-policy=CONST}
    VoidPtr: sw-pointer-target-props={target-category=VALUE, base-type=BaseTypes/void}
    uint16Ptr: sw-pointer-target-props={target-category=TYPE_REFERENCE, implementation-data-type=ImplementationDataTypes/uint16}
    constUint32Ptr: sw-pointer-target-props={target-category=TYPE_REFERENCE, implementation-data-type=ImplementationDataTypes/uint32, sw-impl-policy=CONST}
    constUint8Ptr: sw-pointer-target-props={target-category=TYPE_REFERENCE, implementation-data-type=ImplementationDataTypes/uint8, sw-impl-policy=CONST}
    uint32Ptr: sw-pointer-target-props={target-category=TYPE_REFERENCE, implementation-data-type=ImplementationDataTypes/uint32}
    uint8Ptr: sw-pointer-target-props={target-category=TYPE_REFERENCE, implementation-data-type=ImplementationDataTypes/uint8}
    constUint16Ptr: sw-pointer-target-props={target-category=TYPE_REFERENCE, implementation-data-type=ImplementationDataTypes/uint16, sw-impl-policy=CONST}
package /AUTOSAR/Platform/ImplementationDataTypes
  10 x impl type:
    ConstVoidPtr: category=DATA_REFERENCE, sw-pointer-target-props={target-category=VALUE, base-type=BaseTypes/void, sw-impl-policy=CONST}
    VoidPtr: category=DATA_REFERENCE, sw-pointer-target-props={target-category=VALUE, base-type=BaseTypes/void}
    constUint16Ptr: category=DATA_REFERENCE, sw-pointer-target-props={target-category=TYPE_REFERENCE, implementation-data-type=ImplementationDataTypes/uint16, sw-impl-policy=CONST}
    constUint32Ptr: category=DATA_REFERENCE, sw-pointer-target-props={target-category=TYPE_REFERENCE, implementation-data-type=ImplementationDataTypes/uint32, sw-impl-policy=CONST}
    constUint8Ptr: category=DATA_REFERENCE, sw-pointer-target-props={target-category=TYPE_REFERENCE, implementation-data-type=ImplementationDataTypes/uint8, sw-impl-policy=CONST}
    uint16Ptr: category=DATA_REFERENCE, sw-pointer-target-props={target-category=TYPE_REFERENCE, implementation-data-type=ImplementationDataTypes/uint16}
    uint32Ptr: category=DATA_REFERENCE, sw-pointer-target-props={target-category=TYPE_REFERENCE, implementation-data-type=ImplementationDataTypes/uint32}
    uint8Ptr: category=DATA_REFERENCE, sw-pointer-target-props={target-category=TYPE_REFERENCE, implementation-data-type=ImplementationDataTypes/uint8}
    utf8: category=VALUE, base-type=BaseTypes/utf8, type-emitter=Platform_Types.h
    ucs2: category=VALUE, base-type=BaseTypes/ucs2, type-emitter=Platform_Types.h
package /AUTOSAR_Platform/ImplementationDataTypes
  10 x impl type:
    constUint16Ptr: category=DATA_REFERENCE, sw-pointer-target-props={target-category=TYPE_REFERENCE, implementation-data-type=ImplementationDataTypes/uint16, sw-impl-policy=CONST}
    constUint32Ptr: category=DATA_REFERENCE, sw-pointer-target-props={target-category=TYPE_REFERENCE, implementation-data-type=ImplementationDataTypes/uint32, sw-impl-policy=CONST}
    constUint8Ptr: category=DATA_REFERENCE, sw-pointer-target-props={target-category=TYPE_REFERENCE, implementation-data-type=ImplementationDataTypes/uint8, sw-impl-policy=CONST}
    ConstVoidPtr: category=DATA_REFERENCE, sw-pointer-target-props={target-category=VALUE, base-type=BaseTypes/void, sw-impl-policy=CONST}
    ucs2: category=VALUE, base-type=BaseTypes/ucs2, type-emitter=Platform_Types.h
    uint16Ptr: category=DATA_REFERENCE, sw-pointer-target-props={target-category=TYPE_REFERENCE, implementation-data-type=ImplementationDataTypes/uint16}
    uint32Ptr: category=DATA_REFERENCE, sw-pointer-target-props={target-category=TYPE_REFERENCE, implementation-data-type=ImplementationDataTypes/uint32}
    uint8Ptr: category=DATA_REFERENCE, sw-pointer-target-props={target-category=TYPE_REFERENCE, implementation-data-type=ImplementationDataTypes/uint8}
    utf8: category=VALUE, base-type=BaseTypes/utf8, type-emitter=Platform_Types.h
    VoidPtr: category=DATA_REFERENCE, sw-pointer-target-props={target-category=VALUE, base-type=BaseTypes/void}
package /AUTOSAR_Platform/BaseTypes
  base type utf8: category=FIXED_LENGTH, base-type-size=8, base-type-encoding=UTF-8, native-declaration=uint8
  base type ucs2: category=FIXED_LENGTH, base-type-size=16, base-type-encoding=UCS-2, native-declaration=uint16
